#ifdef WAVESHARE_S3_TUBES_REMOTE

// AI: below section was generated by an AI
// Attribution: uses Arduino_GFX, SensorLib, XPowersLib, and WLED Tubes APIs
// following the Waveshare ESP32-S3-Touch-AMOLED-2.16 vendor documentation.

#include "wled.h"

#undef BLACK
#undef BLUE
#undef GREEN
#undef CYAN
#undef RED
#undef MAGENTA
#undef YELLOW
#undef WHITE
#undef ORANGE
#undef PURPLE
#undef DARKGREY

#include <Arduino_GFX_Library.h>
#include <SensorQMI8658.hpp>
#include <touch/TouchDrvCST92xx.h>
#include <XPowersLib.h>

#ifdef TUBES_S3_FIELD_OS
#include "../Tubes/s3_field_api.h"
#include "../Tubes/device_report_protocol.h"
#endif

namespace {
constexpr int8_t DISPLAY_CS = 12;
constexpr int8_t DISPLAY_SCLK = 38;
constexpr int8_t DISPLAY_SDIO0 = 4;
constexpr int8_t DISPLAY_SDIO1 = 5;
constexpr int8_t DISPLAY_SDIO2 = 6;
constexpr int8_t DISPLAY_SDIO3 = 7;
constexpr int8_t DISPLAY_RESET = 39;
constexpr int8_t PERIPHERAL_SDA = 15;
constexpr int8_t PERIPHERAL_SCL = 14;
constexpr int8_t TOUCH_IRQ = 11;
constexpr int8_t TOUCH_RESET = 40;
constexpr int16_t DISPLAY_WIDTH = 480;
constexpr int16_t DISPLAY_HEIGHT = 480;
constexpr uint32_t SAMPLE_INTERVAL_MS = 1000;
constexpr uint32_t PREVIEW_INTERVAL_MS = 50;
#ifdef TUBES_S3_FIELD_OS
constexpr uint32_t MICROPHONE_PREVIEW_INTERVAL_MS = 100;
constexpr uint8_t FIELD_OS_DEFAULT_BRIGHTNESS = 255;
constexpr uint32_t FIELD_OS_IDLE_TIMEOUT_MS = 30000;
constexpr uint32_t BATTERY_PULSE_INTERVAL_MS = 80;
constexpr uint32_t BATTERY_PULSE_CYCLE_MS = 2400;
constexpr uint8_t FIELD_OS_BATTERY_ONLY_BRIGHTNESS = 32;
constexpr int16_t FIELD_OS_HEADER_HEIGHT = 64;
constexpr int16_t FIELD_OS_STRIP_TOP = FIELD_OS_HEADER_HEIGHT;
constexpr int16_t FIELD_OS_STRIP_HEIGHT = 32;
constexpr int16_t FIELD_OS_APP_TOP = FIELD_OS_STRIP_TOP + FIELD_OS_STRIP_HEIGHT;
#else
constexpr uint8_t SMOKE_DEFAULT_BRIGHTNESS = 160;
#endif

volatile bool touchInterruptPending = false;

void IRAM_ATTR handleTouchInterrupt() {
  touchInterruptPending = true;
}

Arduino_ESP32QSPI displayBus(DISPLAY_CS, DISPLAY_SCLK, DISPLAY_SDIO0, DISPLAY_SDIO1,
                             DISPLAY_SDIO2, DISPLAY_SDIO3);
Arduino_CO5300 display(&displayBus, DISPLAY_RESET, 0, false, DISPLAY_WIDTH, DISPLAY_HEIGHT);
TouchDrvCST92xx touch;
SensorQMI8658 imu;
XPowersPMU pmu;

#ifdef TUBES_S3_FIELD_OS
enum class FieldViewId : uint8_t {
  Home,
  Patterns,
  Beats,
  Mesh,
  Colors,
  Update,
};

class WaveshareS3FieldOs : public Usermod {
private:
  struct Rect {
    int16_t x;
    int16_t y;
    int16_t width;
    int16_t height;

    bool contains(int16_t px, int16_t py) const {
      return px >= x && py >= y && px < x + width && py < y + height;
    }
  };

  struct ButtonComponent {
    Rect bounds;
    uint16_t color;
    const __FlashStringHelper *label;
  };

  struct DeviceCard {
    uint16_t id;
    uint16_t version;
    uint16_t uplinkId;
    uint32_t ageSeconds;
    const char *kind;

    DeviceCard(uint16_t id, uint16_t version, uint16_t uplinkId,
               uint32_t ageSeconds, const char *kind)
        : id(id), version(version), uplinkId(uplinkId), ageSeconds(ageSeconds), kind(kind) {}
  };

  static constexpr uint8_t GRADIENT_MAX_STOPS = 8;
  static constexpr uint8_t GRADIENT_PRESET_COUNT = 8;
  static constexpr uint8_t GRADIENT_PRESET_MIN_SATURATION = 144;
  static constexpr uint8_t GRADIENT_PRESET_MAX_SATURATION = 232;
  static constexpr uint8_t GRADIENT_PRESET_MIN_VALUE = 208;
  static constexpr uint8_t GRADIENT_PRIMARY_HUE_RADIUS = 22;

  // AI: below section was generated by an AI
  struct GradientPreset {
    uint8_t count = 0;
    uint8_t anchorIndex = 0;
    TubesS3GradientStop stops[GRADIENT_MAX_STOPS] = {};
  };

  struct HarmonyControl {
    constexpr HarmonyControl(uint8_t position = 0, int16_t hueOffset = 0,
                             uint8_t saturation = 0, uint8_t value = 0)
        : position(position), hueOffset(hueOffset), saturation(saturation), value(value) {}

    uint8_t position;
    int16_t hueOffset;
    uint8_t saturation;
    uint8_t value;
  };

  struct HarmonySample {
    constexpr HarmonySample(int16_t hueOffset = 0, uint8_t saturation = 0,
                            uint8_t value = 0)
        : hueOffset(hueOffset), saturation(saturation), value(value) {}

    int16_t hueOffset;
    uint8_t saturation;
    uint8_t value;
  };
  // AI: end

  bool displayReady = false;
  bool touchReady = false;
  bool pmuReady = false;
  bool microphoneReady = false;
  bool nextSendFailed = false;
  bool touchDown = false;
  bool screenOn = true;
  bool usbPresent = false;
  bool charging = false;
  int16_t batteryPercent = -1;
  uint16_t batteryMv = 0;
  uint32_t lastActivityMs = 0;
  uint32_t lastBatterySampleMs = 0;
  uint32_t lastPmuPollMs = 0;
  uint32_t lastPreviewMs = 0;
  uint32_t lastBatteryPulseMs = 0;
  uint8_t selectedGradientStop = 1;
  uint8_t gradientStopCount = 3;
  TubesS3GradientStop gradientStops[GRADIENT_MAX_STOPS] = {
    {0, 0xFF3A7A}, {128, 0x7A5CFF}, {255, 0x28D7D0}
  };
  GradientPreset gradientPresets[GRADIENT_PRESET_COUNT] = {};
  bool drawnTempoListening = false;
  uint8_t drawnBeatOverlayChoice = UINT8_MAX;
  uint8_t drawnNextBeatOverlayChoice = UINT8_MAX;

  static constexpr uint16_t COLOR_BACKGROUND = 0x0863;
  static constexpr uint16_t COLOR_SURFACE = 0x10E7;
  static constexpr uint16_t COLOR_SURFACE_RAISED = 0x194A;
  static constexpr uint16_t COLOR_PRIMARY = 0x64FF;
  static constexpr uint16_t COLOR_MINT = 0x5F56;
  static constexpr uint16_t COLOR_AMBER = 0xFDC8;
  static constexpr uint16_t COLOR_MUTED = 0x8C51;
  static constexpr uint16_t COLOR_BEAT = 0x2104;
  static constexpr uint16_t COLOR_DOWNBEAT = 0x4A49;

  static uint16_t rgb565(uint32_t color) {
    // Production colors stay RGB888 until this existing color-depth conversion.
    // This is not gamma or brightness scaling.
    const uint8_t red = color >> 16;
    const uint8_t green = color >> 8;
    const uint8_t blue = color;
    return static_cast<uint16_t>(((red & 0xF8) << 8) | ((green & 0xFC) << 3) | (blue >> 3));
  }

  // CO5300 drops one-pixel transparent writes, so TubeOS uses Arduino_GFX's
  // built-in scaled font and always supplies a background color.
  // https://github.com/moononournation/Arduino_GFX/issues/780
  void setDetailFont() {
    display.setFont(nullptr);
    display.setTextSize(2);
  }

  void setBodyFont() {
    display.setFont(nullptr);
    display.setTextSize(2);
  }

  void setAppFont() {
    display.setFont(nullptr);
    display.setTextSize(3);
  }

  void setHeaderFont() {
    display.setFont(nullptr);
    display.setTextSize(5);
  }

  // Initializes the Waveshare ES7210 for its two onboard microphones. The register
  // sequence follows Waveshare's 16 kHz slave-mode reference implementation:
  // https://github.com/waveshareteam/ESP32-S3-Touch-AMOLED-2.16/tree/main/examples/arduino/06_ES7210
  bool writeEs7210(uint8_t reg, uint8_t value) {
    Wire.beginTransmission(0x40);
    Wire.write(reg);
    Wire.write(value);
    return Wire.endTransmission() == 0;
  }

  bool readEs7210(uint8_t reg, uint8_t &value) {
    Wire.beginTransmission(0x40);
    Wire.write(reg);
    if (Wire.endTransmission(false) != 0 || Wire.requestFrom(0x40, 1U) != 1)
      return false;
    value = Wire.read();
    return true;
  }

  bool initializeMicrophones() {
    bool ok = true;
    ok &= writeEs7210(0x00, 0xFF);
    ok &= writeEs7210(0x00, 0x41);
    ok &= writeEs7210(0x01, 0x1F);
    ok &= writeEs7210(0x09, 0x30);
    ok &= writeEs7210(0x0A, 0x30);
    ok &= writeEs7210(0x40, 0xC3);
    ok &= writeEs7210(0x41, 0x70);
    ok &= writeEs7210(0x42, 0x70);
    ok &= writeEs7210(0x02, 0xC1);
    ok &= writeEs7210(0x07, 0x20);
    ok &= writeEs7210(0x04, 0x01);
    ok &= writeEs7210(0x05, 0x00);
    // Waveshare's 16-bit reference sets SDP_INTERFACE1[7:5] to 0b011.
    // A value of 0x80 selects 32-bit samples and leaves the ESP32 reading empty slots.
    ok &= writeEs7210(0x11, 0x60);
    ok &= writeEs7210(0x12, 0x00);
    ok &= writeEs7210(0x43, 0x10);
    ok &= writeEs7210(0x44, 0x10);
    ok &= writeEs7210(0x45, 0x1E);
    ok &= writeEs7210(0x46, 0x1E);
    ok &= writeEs7210(0x4B, 0x00);
    ok &= writeEs7210(0x4C, 0x00);
    ok &= writeEs7210(0x01, 0x00);
    ok &= writeEs7210(0x06, 0x00);
    ok &= writeEs7210(0x47, 0x00);
    ok &= writeEs7210(0x48, 0x00);
    ok &= writeEs7210(0x49, 0x00);
    ok &= writeEs7210(0x4A, 0x00);
    const uint8_t registers[] = {0x01, 0x02, 0x11, 0x4B, 0x4C};
    const uint8_t expected[] = {0x00, 0xC1, 0x60, 0x00, 0x00};
    for (uint8_t i = 0; i < sizeof(registers); i++) {
      uint8_t actual = 0;
      const bool read = readEs7210(registers[i], actual);
      ok &= read && actual == expected[i];
    }
    return ok;
  }

  uint16_t batteryPulseColor(uint32_t now) const {
    const uint16_t phase = static_cast<uint32_t>(now % BATTERY_PULSE_CYCLE_MS) * 510
        / BATTERY_PULSE_CYCLE_MS;
    const uint8_t triangle = phase <= 255 ? phase : 510 - phase;
    const uint8_t brightness = 188 + static_cast<uint16_t>(triangle) * 67 / 255;
    return rgb565((static_cast<uint32_t>(brightness) << 16)
        | (static_cast<uint32_t>(brightness) << 8) | brightness);
  }

  void drawBatteryIcon(uint16_t color, bool showChargingSymbol,
                       uint16_t background = COLOR_BACKGROUND) {
    constexpr int16_t iconX = 405;
    constexpr int16_t iconY = 14;
    constexpr int16_t iconWidth = 58;
    constexpr int16_t iconHeight = 34;
    display.fillRect(iconX - 2, iconY - 2, 77, iconHeight + 4, background);
    display.drawRoundRect(iconX, iconY, iconWidth, iconHeight, 5, color);
    display.fillRect(iconX + iconWidth, iconY + 9, 6, 16, color);
    const int16_t levelWidth = batteryPercent < 0 ? 0
        : static_cast<int16_t>((iconWidth - 8) * batteryPercent / 100);
    if (levelWidth > 0)
      display.fillRect(iconX + 4, iconY + 4, levelWidth, iconHeight - 8, color);
    if (!showChargingSymbol) return;

    // A high-contrast bolt remains visible at every state of charge.
    display.fillTriangle(iconX + 31, iconY + 5, iconX + 20, iconY + 19,
                         iconX + 30, iconY + 19, RGB565_WHITE);
    display.fillTriangle(iconX + 27, iconY + 15, iconX + 38, iconY + 15,
                         iconX + 24, iconY + 29, RGB565_WHITE);
  }

  void drawBattery() {
    display.fillRect(385, 0, 95, FIELD_OS_HEADER_HEIGHT, COLOR_BACKGROUND);
    drawBatteryIcon(usbPresent ? COLOR_MINT : batteryPulseColor(millis()), usbPresent);
  }

  void drawBatteryOnlyScreen() {
    display.fillScreen(RGB565_BLACK);
    drawBatteryIcon(usbPresent ? COLOR_MINT : batteryPulseColor(millis()), usbPresent,
                    RGB565_BLACK);
  }

  void drawHeader() {
    display.fillRect(0, 0, DISPLAY_WIDTH, FIELD_OS_HEADER_HEIGHT, COLOR_BACKGROUND);
    display.setTextWrap(false);
    display.setTextColor(RGB565_WHITE, COLOR_BACKGROUND);
    setHeaderFont();
    display.setCursor(14, 12);
    display.print(F("tubeOS"));
    TubesS3FieldStatus status;
    tubesS3ReadStatus(status);
    setAppFont();
    display.setTextColor(COLOR_MUTED, COLOR_BACKGROUND);
    display.setCursor(220, 24);
    display.printf("%04X v%u", status.localNodeId, status.tubesVersion);
    drawBattery();
  }

  void drawChrome(const __FlashStringHelper *, bool) {
    display.fillScreen(COLOR_BACKGROUND);
    drawHeader();
    stripComponent.draw(0, FIELD_OS_STRIP_TOP, DISPLAY_WIDTH, FIELD_OS_STRIP_HEIGHT, true);
  }

  void drawButton(const ButtonComponent &button) {
    const Rect &bounds = button.bounds;
    display.fillRoundRect(bounds.x, bounds.y, bounds.width, bounds.height, 20, button.color);
    display.setTextColor(RGB565_WHITE, button.color);
    setAppFont();
    int16_t textX = 0;
    int16_t textY = 0;
    uint16_t textWidth = 0;
    uint16_t textHeight = 0;
    display.getTextBounds(button.label, 0, 0, &textX, &textY, &textWidth, &textHeight);
    display.setCursor(bounds.x + (bounds.width - textWidth) / 2 - textX,
                      bounds.y + (bounds.height - textHeight) / 2 - textY);
    display.print(button.label);
  }

  void drawHomeContent() {
    drawButton({{20, 128, 210, 150}, COLOR_PRIMARY, F("Patterns")});
    drawButton({{250, 128, 210, 150}, COLOR_SURFACE_RAISED, F("Beats")});
    drawButton({{20, 294, 210, 150}, COLOR_SURFACE_RAISED, F("Colors")});
    drawButton({{250, 294, 210, 150}, COLOR_SURFACE_RAISED, F("Mesh")});
  }

  // Persistent Strip observes WLED's canonical, completed logical framebuffer.
  // The null bus supplies geometry only; it must not become a second pixel store.
  // A small display-only glow models diffusion through a tube without changing
  // the canonical pixels used by the pattern engine or mesh.
  class Strip {
  public:
    void draw(int16_t x, int16_t y, int16_t width, int16_t height, bool = false) {
      TubesS3FieldStatus status;
      tubesS3ReadStatus(status);
      uint32_t colors[TUBES_S3_PREVIEW_PIXELS];
      uint32_t diffused[TUBES_S3_PREVIEW_PIXELS];
      const bool validTopology = ::strip.getLengthTotal() >= TUBES_S3_PREVIEW_PIXELS;
      // draw() runs periodically, so this samples the previous completed show frame.
      for (size_t i = 0; i < TUBES_S3_PREVIEW_PIXELS; i++)
        colors[i] = validTopology ? ::strip.getPixelColor(i) : 0;
      for (size_t i = 0; i < TUBES_S3_PREVIEW_PIXELS; i++)
        diffused[i] = diffusePixel(colors, i);
      const uint8_t beat = status.beat & 0x0F;
      const int16_t laneTop = height * 3 / 4;
      for (int16_t row = 0; row < height; row++) {
        for (int16_t column = 0; column < width; column++) {
          if (row < laneTop) {
            const uint32_t sourceQ8 = width > 1
                ? static_cast<uint32_t>(column)
                    * ((TUBES_S3_PREVIEW_PIXELS - 1U) << 8) / (width - 1)
                : 0;
            frame[row * width + column] = rgb565(interpolatePixel(diffused, sourceQ8));
            continue;
          }
          const uint8_t segment = static_cast<uint32_t>(column) * 16 / width;
          frame[row * width + column] = segment == beat
              ? RGB565_WHITE
              : segment % 4 == 0 ? COLOR_DOWNBEAT : COLOR_BEAT;
        }
      }
      // One opaque transfer avoids the CO5300's missing-column behavior on narrow writes.
      display.draw16bitRGBBitmap(x, y, frame, width, height);
    }
  private:
    static uint8_t channel(uint32_t color, uint8_t shift) {
      return static_cast<uint8_t>(color >> shift);
    }

    static uint8_t scaledChannel(uint32_t color, uint8_t shift, uint8_t scale) {
      return static_cast<uint16_t>(channel(color, shift)) * scale / 255U;
    }

    static uint32_t diffusePixel(const uint32_t *colors, size_t pixel) {
      uint8_t red = 0;
      uint8_t green = 0;
      uint8_t blue = 0;
      for (int8_t offset = -2; offset <= 2; offset++) {
        const int16_t source = static_cast<int16_t>(pixel) + offset;
        if (source < 0 || source >= TUBES_S3_PREVIEW_PIXELS) continue;
        const uint8_t distance = abs(offset);
        const uint8_t scale = distance == 0 ? 255 : distance == 1 ? 112 : 48;
        const uint32_t color = colors[source];
        red = max(red, scaledChannel(color, 16, scale));
        green = max(green, scaledChannel(color, 8, scale));
        blue = max(blue, scaledChannel(color, 0, scale));
      }
      return (static_cast<uint32_t>(red) << 16)
          | (static_cast<uint32_t>(green) << 8) | blue;
    }

    static uint32_t interpolatePixel(const uint32_t *colors, uint32_t sourceQ8) {
      size_t left = sourceQ8 >> 8;
      if (left >= TUBES_S3_PREVIEW_PIXELS) left = TUBES_S3_PREVIEW_PIXELS - 1U;
      size_t right = left + 1U;
      if (right >= TUBES_S3_PREVIEW_PIXELS) right = TUBES_S3_PREVIEW_PIXELS - 1U;
      const uint8_t fraction = sourceQ8 & 0xFF;
      const uint16_t inverse = 256U - fraction;
      const uint8_t red = (channel(colors[left], 16) * inverse
          + channel(colors[right], 16) * fraction) >> 8;
      const uint8_t green = (channel(colors[left], 8) * inverse
          + channel(colors[right], 8) * fraction) >> 8;
      const uint8_t blue = (channel(colors[left], 0) * inverse
          + channel(colors[right], 0) * fraction) >> 8;
      return (static_cast<uint32_t>(red) << 16)
          | (static_cast<uint32_t>(green) << 8) | blue;
    }

    uint16_t frame[DISPLAY_WIDTH * FIELD_OS_STRIP_HEIGHT] = {};
  };

  Strip stripComponent;

  void setScreenOn(bool enabled) {
    if (!displayReady || screenOn == enabled) return;
    screenOn = enabled;
    if (!screenOn) {
      display.setBrightness(FIELD_OS_BATTERY_ONLY_BRIGHTNESS);
      drawBatteryOnlyScreen();
      return;
    }
    display.displayOn();
    display.setBrightness(FIELD_OS_DEFAULT_BRIGHTNESS);
    lastActivityMs = millis();
    viewManager.redraw();
  }

  void samplePower(uint32_t now, bool force = false) {
    if (!pmuReady || (!force && now - lastBatterySampleMs < SAMPLE_INTERVAL_MS)) return;
    lastBatterySampleMs = now;
    const bool wasUsbPresent = usbPresent;
    const bool nextUsbPresent = pmu.isVbusIn();
    const bool nextCharging = pmu.isCharging();
    const uint16_t nextBatteryMv = pmu.getBattVoltage();
    const int16_t nextBatteryPercent = pmu.isBatteryConnect()
        ? constrain(static_cast<int16_t>(pmu.getBatteryPercent()), 0, 100) : -1;
    const bool changed = nextUsbPresent != usbPresent || nextCharging != charging
        || nextBatteryPercent != batteryPercent || nextBatteryMv != batteryMv;
    usbPresent = nextUsbPresent;
    charging = nextCharging;
    batteryMv = nextBatteryMv;
    batteryPercent = nextBatteryPercent;
    if (wasUsbPresent && !usbPresent) lastActivityMs = now;
    if (!wasUsbPresent && usbPresent && !screenOn) setScreenOn(true);
    if (changed && displayReady) {
      if (screenOn) drawBattery();
      else drawBatteryIcon(usbPresent ? COLOR_MINT : batteryPulseColor(millis()),
                           usbPresent, RGB565_BLACK);
    }
  }

  void handlePowerKey() {
    if (!pmuReady) return;
    const uint32_t now = millis();
    if (now - lastPmuPollMs < 25) return;
    lastPmuPollMs = now;
    pmu.getIrqStatus();
    if (pmu.isPekeyShortPressIrq()) {
      lastActivityMs = now;
      setScreenOn(!screenOn);
    }
    pmu.clearIrqStatus();
  }

  void tickShell(uint32_t now) {
    handlePowerKey();
    samplePower(now);
    if (!screenOn) {
      if (!usbPresent && now - lastBatteryPulseMs >= BATTERY_PULSE_INTERVAL_MS) {
        lastBatteryPulseMs = now;
        drawBatteryIcon(batteryPulseColor(now), false, RGB565_BLACK);
      }
      return;
    }
    if (!usbPresent && now - lastActivityMs >= FIELD_OS_IDLE_TIMEOUT_MS) {
      setScreenOn(false);
      return;
    }
    if (!usbPresent && now - lastBatteryPulseMs >= BATTERY_PULSE_INTERVAL_MS) {
      lastBatteryPulseMs = now;
      drawBatteryIcon(batteryPulseColor(now), false);
    }
    if (now - lastPreviewMs >= PREVIEW_INTERVAL_MS) {
      lastPreviewMs = now;
      stripComponent.draw(0, FIELD_OS_STRIP_TOP, DISPLAY_WIDTH, FIELD_OS_STRIP_HEIGHT);
    }
  }

  static uint8_t patternChoiceId(uint8_t index) {
    static constexpr uint8_t choices[] = {
      20, 22, 25, 26, 28, 30, 33, 35, 40, 44, 47, 50
    };
    return choices[index % (sizeof(choices) / sizeof(choices[0]))];
  }

  static const __FlashStringHelper *patternChoiceLabel(uint8_t index) {
    switch (index) {
      case 0: return F("Wave");
      case 1: return F("Pulse");
      case 2: return F("Chase");
      case 3: return F("Aurora");
      case 4: return F("Twinkle");
      case 5: return F("Scanner");
      case 6: return F("Fire");
      case 7: return F("Noise");
      case 8: return F("Lake");
      case 9: return F("Burst");
      case 10: return F("Popcorn");
      default: return F("Pacifica");
    }
  }

  // Draws a compact motion signature so patterns can be recognized before reading the label.
  void drawPatternTile(uint8_t index, const TubesS3FieldStatus &status) {
    constexpr int16_t tileWidth = 142;
    constexpr int16_t tileHeight = 76;
    const int16_t x = 20 + (index % 3) * 149;
    const int16_t y = 148 + (index / 3) * 82;
    const uint8_t patternId = patternChoiceId(index);
    const bool isNext = patternId == status.nextPatternId;
    const bool isCurrent = patternId == status.patternId;
    const uint16_t background = isNext ? COLOR_PRIMARY
        : isCurrent ? COLOR_MINT : COLOR_SURFACE_RAISED;
    display.fillRoundRect(x, y, tileWidth, tileHeight, 12, background);
    for (uint8_t bar = 0; bar < 6; bar++) {
      const int16_t barHeight = 6 + ((index * 7 + bar * 11) % 23);
      display.fillRoundRect(x + 12 + bar * 20, y + 34 - barHeight,
                            12, barHeight, 4,
                            isNext || isCurrent ? RGB565_WHITE : COLOR_MUTED);
    }
    display.setTextColor(RGB565_WHITE, background);
    setDetailFont();
    const __FlashStringHelper *label = patternChoiceLabel(index);
    int16_t textX = 0;
    int16_t textY = 0;
    uint16_t textWidth = 0;
    uint16_t textHeight = 0;
    display.getTextBounds(label, 0, 0, &textX, &textY, &textWidth, &textHeight);
    display.setCursor(x + (tileWidth - textWidth) / 2 - textX, y + 50);
    display.print(label);
  }

  void drawPatternsContent(bool) {
    TubesS3FieldStatus status;
    tubesS3ReadStatus(status);
    display.fillRect(0, FIELD_OS_APP_TOP, DISPLAY_WIDTH,
                     DISPLAY_HEIGHT - FIELD_OS_APP_TOP, COLOR_BACKGROUND);
    setDetailFont();
    display.setTextColor(nextSendFailed ? RGB565_RED : COLOR_MUTED, COLOR_BACKGROUND);
    display.setCursor(20, 110);
    if (nextSendFailed) display.print(F("COULD NOT SET PATTERN"));
    else display.printf("CURRENT %02u    NEXT %02u", status.patternId, status.nextPatternId);
    for (uint8_t index = 0; index < 12; index++)
      drawPatternTile(index, status);
  }

  static bool meshBefore(const TubesS3PeerStatus &candidate, const TubesS3PeerStatus &prior) {
    if (candidate.rssiKnown != prior.rssiKnown) return candidate.rssiKnown;
    if (candidate.rssiKnown && candidate.latestRssi != prior.latestRssi)
      return candidate.latestRssi > prior.latestRssi;
    return candidate.nodeId < prior.nodeId;
  }

  static uint32_t mixRevision(uint32_t value, uint32_t field) {
    return (value ^ field) * 16777619UL;
  }

  uint32_t patternsRevision(const TubesS3FieldStatus &status) {
    uint32_t value = mixRevision(status.patternId, status.nextPatternId);
    value = mixRevision(value, status.currentPatternPhrase);
    value = mixRevision(value, status.nextPatternPhrase);
    return value;
  }

  static const __FlashStringHelper *beatOverlayLabel(uint8_t choice) {
    switch (choice) {
      case 0: return F("Off");
      case 1: return F("Stream");
      case 2: return F("Boom");
      case 3: return F("Spring");
      case 4: return F("Ripple");
      case 5: return F("Puddle");
      case 6: return F("Falls");
      case 7: return F("Center");
      default: return F("Orbit");
    }
  }

  // Draws a rhythmic signature for each curated audio overlay choice.
  void drawBeatOverlayTile(uint8_t choice, const TubesS3FieldStatus &status) {
    constexpr int16_t tileWidth = 142;
    constexpr int16_t tileHeight = 78;
    const int16_t x = 20 + (choice % 3) * 149;
    const int16_t y = 210 + (choice / 3) * 86;
    const bool isNext = choice == status.nextBeatOverlayChoice;
    const bool isCurrent = choice == status.beatOverlayChoice;
    const uint16_t background = isNext ? COLOR_PRIMARY
        : isCurrent ? COLOR_MINT : COLOR_SURFACE_RAISED;
    display.fillRoundRect(x, y, tileWidth, tileHeight, 12, background);
    const uint16_t glyphColor = isNext || isCurrent ? RGB565_WHITE : COLOR_MUTED;
    if (choice == 0) {
      display.fillRoundRect(x + 34, y + 26, 74, 7, 3, glyphColor);
    } else {
      for (uint8_t bar = 0; bar < 7; bar++) {
        const int16_t barHeight = 5 + ((choice * 9 + bar * 7) % 23);
        display.fillRoundRect(x + 13 + bar * 17, y + 35 - barHeight,
                              10, barHeight, 3, glyphColor);
      }
    }
    display.setTextColor(RGB565_WHITE, background);
    setDetailFont();
    const __FlashStringHelper *label = beatOverlayLabel(choice);
    int16_t textX = 0;
    int16_t textY = 0;
    uint16_t textWidth = 0;
    uint16_t textHeight = 0;
    display.getTextBounds(label, 0, 0, &textX, &textY, &textWidth, &textHeight);
    display.setCursor(x + (tileWidth - textWidth) / 2 - textX, y + 52);
    display.print(label);
  }

  void drawMicrophonePanel(const TubesS3FieldStatus &status) {
    const Rect bounds = {150, 112, 230, 78};
    const uint16_t background = COLOR_SURFACE_RAISED;
    display.fillRoundRect(bounds.x, bounds.y, bounds.width, bounds.height, 20, background);
    display.setTextColor(status.tempoLocked ? COLOR_MINT : RGB565_WHITE, background);
    setAppFont();
    display.setCursor(status.bpm < 100 ? 211 : status.bpm < 1000 ? 202 : 193, 116);
    display.printf("%u BPM", status.bpm);
    for (uint8_t bin = 0; bin < TUBES_S3_MICROPHONE_BINS; bin++) {
      const int16_t x = 168 + bin * 16;
      display.fillRoundRect(x, 153, 12, 26, 3, COLOR_BEAT);
      const uint8_t level = status.tempoListening && status.microphoneActive
          ? status.microphoneSpectrum[bin] : 0;
      const int16_t height = static_cast<uint16_t>(level) * 26 / 255;
      if (height > 0)
        display.fillRoundRect(x, 179 - height, 12, height, 3,
                              bin < 4 ? COLOR_PRIMARY : bin < 8 ? COLOR_MINT : COLOR_AMBER);
    }
    display.fillRoundRect(163, 183, 204, 4, 2, COLOR_BEAT);
    const int16_t volumeWidth = status.tempoListening && status.microphoneActive
        ? static_cast<uint16_t>(status.microphoneLevel) * 204 / 255 : 0;
    if (volumeWidth > 0) display.fillRoundRect(163, 183, volumeWidth, 4, 2, RGB565_WHITE);
  }

  void drawBeatsContent(bool full) {
    TubesS3FieldStatus status;
    tubesS3ReadStatus(status);
    const bool controlsChanged = status.tempoListening != drawnTempoListening
        || status.beatOverlayChoice != drawnBeatOverlayChoice
        || status.nextBeatOverlayChoice != drawnNextBeatOverlayChoice;
    if (full || controlsChanged) {
      display.fillRect(0, FIELD_OS_APP_TOP, DISPLAY_WIDTH,
                       DISPLAY_HEIGHT - FIELD_OS_APP_TOP, COLOR_BACKGROUND);
      drawButton({{20, 112, 120, 78},
                  status.tempoListening ? COLOR_MINT : COLOR_SURFACE_RAISED,
                  F("Listen")});
      drawMicrophonePanel(status);
      drawButton({{390, 112, 70, 78}, COLOR_AMBER, F("1")});
      for (uint8_t choice = 0; choice < 9; choice++)
        drawBeatOverlayTile(choice, status);
    } else {
      drawMicrophonePanel(status);
    }
    drawnTempoListening = status.tempoListening;
    drawnBeatOverlayChoice = status.beatOverlayChoice;
    drawnNextBeatOverlayChoice = status.nextBeatOverlayChoice;
  }

  uint32_t beatsRevision(const TubesS3FieldStatus &status) {
    uint32_t value = mixRevision(status.tempoListening, status.beatOverlayChoice);
    value = mixRevision(value, status.nextBeatOverlayChoice);
    value = mixRevision(value, status.bpm);
    if (!status.tempoListening) return value;
    value = mixRevision(value, status.microphoneActive);
    value = mixRevision(value, status.microphoneLevel);
    for (uint8_t bin = 0; bin < TUBES_S3_MICROPHONE_BINS; bin++)
      value = mixRevision(value, status.microphoneSpectrum[bin]);
    return value;
  }

  void drawDeviceCard(int16_t y, const DeviceCard &device,
                      uint16_t color = COLOR_SURFACE_RAISED) {
    display.fillRoundRect(20, y, 440, 62, 10, color);
    display.setTextColor(RGB565_WHITE, color);
    setDetailFont();
    display.setCursor(34, y + 5);
    display.printf("%s", device.kind);
    if (device.id) display.printf(" | %04X", device.id);
    else display.print(F(" | UNKNOWN"));
    display.print(F(" | "));
    if (device.version) display.printf("v%u", device.version);
    else display.print(F("UNKNOWN"));
    display.setTextColor(COLOR_MUTED, color);
    display.setCursor(34, y + 32);
    if (device.uplinkId) display.printf("UPLINK: %04X", device.uplinkId);
    else display.print(F("UPLINK: NONE"));
    if (device.ageSeconds != UINT32_MAX)
      display.printf(" | HEARD: %lus AGO", device.ageSeconds);
  }

  void drawMeshContent() {
    TubesS3FieldStatus status;
    tubesS3ReadStatus(status);
    display.fillRect(0, FIELD_OS_APP_TOP, DISPLAY_WIDTH,
                     DISPLAY_HEIGHT - FIELD_OS_APP_TOP, COLOR_BACKGROUND);
    TubesS3PeerStatus sorted[4];
    size_t shown = 0;
    const uint32_t now = millis();
    for (size_t i = 0; i < status.peerCount; i++) {
      TubesS3PeerStatus candidate;
      if (!tubesS3ReadPeer(i, candidate) || candidate.nodeId == status.localNodeId
          || now - candidate.lastSeenMs > 60000) continue;
      if (shown == 4 && !meshBefore(candidate, sorted[3])) continue;
      size_t position = shown < 4 ? shown++ : 3;
      while (position > 0 && meshBefore(candidate, sorted[position - 1])) {
        if (position < 4) sorted[position] = sorted[position - 1];
        position--;
      }
      if (position < 4) sorted[position] = candidate;
    }
    if (shown == 0) {
      display.setTextColor(RGB565_WHITE, COLOR_BACKGROUND);
      setDetailFont();
      display.setCursor(24, 116);
      display.println(F("No Tubes heard in 60 seconds."));
    }
    for (size_t i = 0; i < shown; i++) {
      const TubesS3PeerStatus &peer = sorted[i];
      drawDeviceCard(106 + i * 70, {peer.nodeId, peer.tubesVersion, peer.uplinkId,
                     (now - peer.lastSeenMs) / 1000, "TUBES DEVICE"});
    }
    drawButton({{120, 408, 240, 56}, COLOR_PRIMARY, F("Update")});
  }

  static uint32_t blendColor(uint32_t first, uint32_t second, uint8_t amount) {
    const uint8_t inverse = 255 - amount;
    const uint8_t red = ((first >> 16) * inverse + (second >> 16) * amount) / 255;
    const uint8_t green = (((first >> 8) & 0xFF) * inverse
        + ((second >> 8) & 0xFF) * amount) / 255;
    const uint8_t blue = ((first & 0xFF) * inverse + (second & 0xFF) * amount) / 255;
    return (static_cast<uint32_t>(red) << 16)
        | (static_cast<uint32_t>(green) << 8) | blue;
  }

  static uint32_t gradientColor(const TubesS3GradientStop *stops, uint8_t count,
                                uint8_t position) {
    if (stops == nullptr || count == 0)
      return 0;
    if (count == 1 || position <= stops[0].position)
      return stops[0].color;
    for (uint8_t stop = 1; stop < count; stop++) {
      if (position > stops[stop].position) continue;
      const uint8_t span = stops[stop].position - stops[stop - 1].position;
      const uint8_t amount = span == 0 ? 255
          : static_cast<uint16_t>(position - stops[stop - 1].position) * 255 / span;
      return blendColor(stops[stop - 1].color, stops[stop].color, amount);
    }
    return stops[count - 1].color;
  }

  static uint8_t gradientBrightness(uint8_t index) {
    static constexpr uint8_t levels[4] = {88, 144, 200, 255};
    return levels[index % 4];
  }

  // AI: below section was generated by an AI
  static uint8_t shiftedHue(uint8_t hue, int16_t shift) {
    return static_cast<uint8_t>(static_cast<int16_t>(hue) + shift);
  }

  // Pushes plain primaries toward nearby expressive hues without moving the anchor.
  static uint8_t shapeCompanionHue(uint8_t hue, uint8_t variation) {
    static constexpr uint8_t primaryHues[3] = {0, 85, 171};
    for (uint8_t primary : primaryHues) {
      int16_t difference = static_cast<int16_t>(hue) - primary;
      if (difference > 127) difference -= 256;
      if (difference < -128) difference += 256;
      if (difference <= -GRADIENT_PRIMARY_HUE_RADIUS
          || difference >= GRADIENT_PRIMARY_HUE_RADIUS)
        continue;
      const int8_t direction = difference < 0 ? -1
          : difference > 0 ? 1 : ((variation & 1) ? 1 : -1);
      return shiftedHue(primary, direction * GRADIENT_PRIMARY_HUE_RADIUS);
    }
    return hue;
  }

  static uint8_t presetSaturation(uint8_t saturation) {
    if (saturation < GRADIENT_PRESET_MIN_SATURATION)
      return GRADIENT_PRESET_MIN_SATURATION;
    if (saturation > GRADIENT_PRESET_MAX_SATURATION)
      return GRADIENT_PRESET_MAX_SATURATION;
    return saturation;
  }

  static uint8_t presetValue(uint8_t value) {
    if (value < GRADIENT_PRESET_MIN_VALUE)
      return GRADIENT_PRESET_MIN_VALUE;
    return value;
  }

  // Changes perceived brightness while preserving the selected stop's hue.
  static uint32_t setColorBrightness(uint32_t color, uint8_t brightness) {
    const uint8_t red = color >> 16;
    const uint8_t green = color >> 8;
    const uint8_t blue = color;
    const uint8_t peak = max(red, max(green, blue));
    if (peak == 0)
      return static_cast<uint32_t>(brightness) * 0x010101UL;
    return (static_cast<uint32_t>(red) * brightness / peak << 16)
        | (static_cast<uint32_t>(green) * brightness / peak << 8)
        | static_cast<uint32_t>(blue) * brightness / peak;
  }

  // Maps RGB to FastLED's circular hue scale so preset companions rotate with the anchor.
  static uint8_t colorHue(uint32_t color) {
    const uint8_t red = color >> 16;
    const uint8_t green = color >> 8;
    const uint8_t blue = color;
    const uint8_t high = max(red, max(green, blue));
    const uint8_t low = min(red, min(green, blue));
    const uint8_t range = high - low;
    if (range == 0)
      return 0;
    if (high == red)
      return static_cast<uint8_t>(43 * static_cast<int16_t>(green - blue) / range);
    if (high == green)
      return static_cast<uint8_t>(85 + 43 * static_cast<int16_t>(blue - red) / range);
    return static_cast<uint8_t>(171 + 43 * static_cast<int16_t>(red - green) / range);
  }

  static uint32_t colorFromHsv(uint8_t hue, uint8_t saturation, uint8_t value) {
    CRGB color;
    hsv2rgb_spectrum(CHSV(hue, saturation, value), color);
    return (static_cast<uint32_t>(color.r) << 16)
        | (static_cast<uint32_t>(color.g) << 8) | color.b;
  }

  static uint8_t hueFromPaletteX(int16_t x) {
    return static_cast<uint32_t>(constrain(x, 20, 459) - 20) * 255 / 439;
  }

  static int16_t gradientStopX(const Rect &bounds, uint8_t position) {
    const int16_t drawableWidth = bounds.width - 9;
    if (drawableWidth <= 0) return bounds.x;
    return bounds.x + 4 + static_cast<uint32_t>(position) * drawableWidth / 255;
  }

  static int16_t interpolateSigned(int16_t first, int16_t second, uint8_t amount) {
    return first + static_cast<int32_t>(second - first) * amount / 255;
  }

  static uint8_t interpolateByte(uint8_t first, uint8_t second, uint8_t amount) {
    return first + static_cast<int16_t>(second - first) * amount / 255;
  }

  // Evaluates an explicitly directed hue path; signed offsets preserve its chosen arc.
  static HarmonySample sampleHarmony(const HarmonyControl *controls, uint8_t count,
                                     uint8_t position) {
    if (controls == nullptr || count == 0)
      return {};
    if (count == 1 || position <= controls[0].position)
      return {controls[0].hueOffset, controls[0].saturation, controls[0].value};
    for (uint8_t control = 1; control < count; control++) {
      if (position > controls[control].position) continue;
      const HarmonyControl &first = controls[control - 1];
      const HarmonyControl &second = controls[control];
      const uint8_t span = second.position - first.position;
      const uint8_t linearAmount = span == 0 ? 255
          : static_cast<uint16_t>(position - first.position) * 255 / span;
      const uint8_t easedAmount = ease8InOutCubic(linearAmount);
      return {
        interpolateSigned(first.hueOffset, second.hueOffset, easedAmount),
        interpolateByte(first.saturation, second.saturation, easedAmount),
        interpolateByte(first.value, second.value, easedAmount)
      };
    }
    const HarmonyControl &last = controls[count - 1];
    return {last.hueOffset, last.saturation, last.value};
  }

  // Finds the output sample that can move to the anchor without crossing its neighbors.
  static uint8_t nearestSamplePosition(const uint8_t *positions, uint8_t count,
                                       uint8_t target) {
    uint8_t nearest = 0;
    uint8_t nearestDistance = 255;
    for (uint8_t stop = 0; stop < count; stop++) {
      const uint8_t position = positions[stop];
      const uint8_t distance = position > target ? position - target : target - position;
      if (distance >= nearestDistance) continue;
      nearest = stop;
      nearestDistance = distance;
    }
    return nearest;
  }

  // Samples an HSV harmony into the RGB stops understood by every Tubes generation.
  void writeHarmonyPreset(uint8_t presetIndex, const HarmonyControl *controls,
                          uint8_t controlCount, const uint8_t *samplePositions,
                          uint32_t anchor) {
    if (presetIndex >= GRADIENT_PRESET_COUNT || controls == nullptr
        || controlCount < 2 || samplePositions == nullptr)
      return;
    const uint8_t anchorPosition = gradientStops[selectedGradientStop].position;
    const uint8_t anchorIndex = nearestSamplePosition(
        samplePositions, GRADIENT_MAX_STOPS, anchorPosition);
    const HarmonySample anchorSample = sampleHarmony(
        controls, controlCount, anchorPosition);
    const uint8_t anchorHue = colorHue(anchor);
    GradientPreset &preset = gradientPresets[presetIndex];
    preset.count = GRADIENT_MAX_STOPS;
    preset.anchorIndex = anchorIndex;
    for (uint8_t stop = 0; stop < preset.count; stop++) {
      preset.stops[stop].position = stop == anchorIndex
          ? anchorPosition : samplePositions[stop];
      if (stop == anchorIndex) {
        preset.stops[stop].color = anchor;
        continue;
      }
      const HarmonySample sample = sampleHarmony(
          controls, controlCount, preset.stops[stop].position);
      const uint8_t sampledHue = shiftedHue(
          anchorHue, sample.hueOffset - anchorSample.hueOffset);
      const uint8_t hue = shapeCompanionHue(sampledHue, presetIndex + stop);
      preset.stops[stop].color = colorFromHsv(
          hue, presetSaturation(sample.saturation), presetValue(sample.value));
    }
  }

  // Builds eight color-theory compositions without ordering colors by wheel angle.
  void regenerateGradientPresets() {
    if (selectedGradientStop >= gradientStopCount)
      selectedGradientStop = gradientStopCount ? gradientStopCount - 1 : 0;
    // Adobe Color supplies the hue relationships. HSV sampling follows tinygradient,
    // while clustered transition samples follow the easing-gradients technique.
    // https://color.adobe.com/create/color-wheel
    // https://github.com/mistic100/tinygradient
    // https://github.com/larsenwork/postcss-easing-gradients
    static constexpr uint8_t smoothSamples[GRADIENT_MAX_STOPS] = {
      0, 36, 72, 109, 146, 182, 219, 255
    };
    static constexpr HarmonyControl analogousControls[5] = {
      {0, -38, 210, 238}, {58, 16, 232, 255}, {122, 52, 188, 246},
      {184, -18, 220, 252}, {255, 12, 200, 235}
    };
    static constexpr uint8_t accentedMonochromaticSamples[GRADIENT_MAX_STOPS] = {
      0, 48, 88, 104, 120, 136, 148, 255
    };
    static constexpr HarmonyControl accentedMonochromaticControls[7] = {
      {0, 0, 232, 255}, {88, 6, 176, 232}, {100, 6, 214, 248},
      {120, 128, 226, 252}, {132, 128, 188, 236}, {148, -6, 220, 248},
      {255, 2, 188, 238}
    };
    static constexpr uint8_t complementarySamples[GRADIENT_MAX_STOPS] = {
      0, 48, 100, 116, 128, 140, 196, 255
    };
    static constexpr HarmonyControl complementaryControls[6] = {
      {0, 0, 232, 255}, {104, 14, 190, 238}, {116, 8, 220, 248},
      {140, 128, 224, 252}, {152, 128, 184, 232}, {255, 116, 214, 248}
    };
    static constexpr uint8_t splitComplementarySamples[GRADIENT_MAX_STOPS] = {
      0, 68, 92, 104, 154, 178, 224, 255
    };
    static constexpr HarmonyControl splitComplementaryControls[7] = {
      {0, 0, 232, 255}, {68, 18, 196, 238}, {80, 10, 220, 248},
      {104, 106, 214, 252}, {154, 116, 184, 234}, {178, 150, 226, 248},
      {255, 140, 194, 240}
    };
    static constexpr uint8_t compoundSamples[GRADIENT_MAX_STOPS] = {
      0, 52, 64, 116, 128, 180, 192, 255
    };
    static constexpr HarmonyControl compoundControls[8] = {
      {0, 0, 230, 255}, {52, 26, 202, 242}, {64, 134, 220, 250},
      {116, 120, 184, 232}, {128, -18, 226, 252}, {180, -30, 196, 240},
      {192, 150, 218, 248}, {255, 138, 188, 236}
    };
    static constexpr uint8_t triadicSamples[GRADIENT_MAX_STOPS] = {
      0, 58, 68, 126, 136, 194, 204, 255
    };
    static constexpr HarmonyControl triadicControls[8] = {
      {0, 0, 232, 255}, {58, 18, 196, 238}, {68, 78, 224, 250},
      {126, 100, 186, 234}, {136, 180, 216, 248}, {194, 164, 226, 252},
      {204, -12, 190, 236}, {255, 6, 220, 246}
    };
    static constexpr uint8_t tetradicSamples[GRADIENT_MAX_STOPS] = {
      0, 50, 60, 112, 122, 174, 184, 255
    };
    static constexpr HarmonyControl tetradicControls[8] = {
      {0, 0, 232, 255}, {50, 18, 198, 238}, {60, 118, 220, 250},
      {112, 140, 184, 232}, {122, 58, 226, 252}, {174, 44, 194, 240},
      {184, 202, 216, 246}, {255, 184, 188, 234}
    };
    static constexpr uint8_t kulerCustomSamples[GRADIENT_MAX_STOPS] = {
      0, 52, 62, 116, 126, 180, 190, 255
    };
    static constexpr HarmonyControl kulerCustomControls[8] = {
      {0, 0, 232, 255}, {52, 28, 188, 238}, {62, 122, 224, 248},
      {116, 136, 178, 232}, {126, -24, 218, 252}, {180, -12, 204, 240},
      {190, 76, 226, 246}, {255, 88, 190, 255}
    };
    const uint32_t anchor = gradientStops[selectedGradientStop].color;
    writeHarmonyPreset(0, analogousControls, 5, smoothSamples, anchor);
    writeHarmonyPreset(
        1, accentedMonochromaticControls, 7, accentedMonochromaticSamples, anchor);
    writeHarmonyPreset(2, complementaryControls, 6, complementarySamples, anchor);
    writeHarmonyPreset(
        3, splitComplementaryControls, 7, splitComplementarySamples, anchor);
    writeHarmonyPreset(4, compoundControls, 8, compoundSamples, anchor);
    writeHarmonyPreset(5, triadicControls, 8, triadicSamples, anchor);
    writeHarmonyPreset(6, tetradicControls, 8, tetradicSamples, anchor);
    writeHarmonyPreset(7, kulerCustomControls, 8, kulerCustomSamples, anchor);
  }
  // AI: end

  void queueGradient() {
    if (!tubesS3ScheduleGradient(gradientStops, gradientStopCount))
      Serial.println(F("TubeOS: gradient queue rejected"));
  }

  void drawGradientPreview(const Rect &bounds, const TubesS3GradientStop *stops,
                           uint8_t count) {
    display.fillRoundRect(bounds.x, bounds.y, bounds.width, bounds.height, 12,
                          COLOR_SURFACE_RAISED);
    if (stops == nullptr || count == 0)
      return;
    constexpr int16_t sliceWidth = 8;
    for (int16_t offset = 4; offset < bounds.width - 4; offset += sliceWidth) {
      const int16_t remaining = bounds.width - 4 - offset;
      const int16_t width = remaining < sliceWidth ? remaining : sliceWidth;
      const uint8_t position = static_cast<uint32_t>(offset - 4) * 255
          / (bounds.width - 9);
      display.fillRect(bounds.x + offset, bounds.y + 4, width,
                       bounds.height - 8, rgb565(gradientColor(stops, count, position)));
    }
  }

  void drawCurrentGradientStops(const Rect &previewBounds) {
    for (uint8_t stop = 0; stop < gradientStopCount; stop++) {
      const bool selected = selectedGradientStop == stop;
      const int16_t x = gradientStopX(previewBounds, gradientStops[stop].position);
      display.fillCircle(x, 162, selected ? 14 : 10,
                         selected ? RGB565_WHITE : COLOR_MUTED);
      display.fillCircle(x, 162, selected ? 9 : 6,
                         rgb565(gradientStops[stop].color));
    }
  }

  void selectGradientStopAt(int16_t x) {
    const Rect previewBounds = {20, 106, 440, 36};
    uint8_t nearest = 0;
    uint16_t nearestDistance = UINT16_MAX;
    for (uint8_t stop = 0; stop < gradientStopCount; stop++) {
      const int16_t stopX = gradientStopX(previewBounds, gradientStops[stop].position);
      const uint16_t distance = x > stopX ? x - stopX : stopX - x;
      if (distance >= nearestDistance) continue;
      nearest = stop;
      nearestDistance = distance;
    }
    selectedGradientStop = nearest;
  }

  void applyGradientPreset(uint8_t preset) {
    const GradientPreset &selectedPreset = gradientPresets[preset % GRADIENT_PRESET_COUNT];
    if (selectedPreset.count < 2)
      return;
    gradientStopCount = selectedPreset.count;
    for (uint8_t stop = 0; stop < gradientStopCount; stop++)
      gradientStops[stop] = selectedPreset.stops[stop];
    selectedGradientStop = selectedPreset.anchorIndex < gradientStopCount
        ? selectedPreset.anchorIndex : gradientStopCount - 1;
    queueGradient();
  }

  void drawColorsContent() {
    display.fillRect(0, FIELD_OS_APP_TOP, DISPLAY_WIDTH,
                     DISPLAY_HEIGHT - FIELD_OS_APP_TOP, COLOR_BACKGROUND);
    const Rect previewBounds = {20, 106, 440, 36};
    drawGradientPreview(previewBounds, gradientStops, gradientStopCount);
    drawCurrentGradientStops(previewBounds);

    display.fillRoundRect(20, 192, 440, 46, 10, COLOR_SURFACE_RAISED);
    constexpr int16_t hueSliceWidth = 8;
    for (int16_t x = 24; x < 456; x += hueSliceWidth) {
      const int16_t width = min(hueSliceWidth, static_cast<int16_t>(456 - x));
      display.fillRect(x, 196, width, 38,
                       rgb565(colorFromHsv(hueFromPaletteX(x), 255, 255)));
    }

    for (uint8_t level = 0; level < 4; level++) {
      const uint32_t color = setColorBrightness(
          gradientStops[selectedGradientStop].color, gradientBrightness(level));
      display.fillRoundRect(20 + level * 110, 252, 105, 42, 10, rgb565(color));
    }

    for (uint8_t preset = 0; preset < GRADIENT_PRESET_COUNT; preset++) {
      const int16_t x = 20 + (preset % 4) * 110;
      const int16_t y = 312 + (preset / 4) * 64;
      drawGradientPreview({x, y, 105, 52}, gradientPresets[preset].stops,
                          gradientPresets[preset].count);
    }
  }

  void drawUpdateContent() {
    display.fillRect(20, 104, 440, 376, COLOR_BACKGROUND);
#ifdef TUBES_S3_FIRMWARE_CARRIER
    TubesS3FieldStatus status;
    tubesS3ReadStatus(status);
    display.setTextColor(COLOR_MUTED, COLOR_BACKGROUND);
    setBodyFont();
    display.setCursor(24, 112);
    display.println(F("THIS S3 UPDATE CARRIER"));
    drawDeviceCard(136, {status.localNodeId, status.tubesVersion, status.uplinkId,
                        UINT32_MAX, "THIS DEVICE"});
    display.setTextColor(COLOR_MUTED, COLOR_BACKGROUND);
    setDetailFont();
    display.setCursor(24, 204);
    display.println(F("EMBEDDED v47 FIRMWARE"));
    for (size_t index = 0; index < tubesS3CarrierArtifactCount(); index++) {
      TubesS3CarrierArtifact artifact;
      const int16_t y = 232 + index * 38;
      display.fillRoundRect(20, y, 440, 32, 8, COLOR_SURFACE_RAISED);
      display.setTextColor(RGB565_WHITE, COLOR_SURFACE_RAISED);
      setDetailFont();
      display.setCursor(32, y + 7);
      if (!tubesS3ReadCarrierArtifact(index, artifact)) {
        display.print(F("ARTIFACT UNAVAILABLE"));
      } else {
        if (artifact.family == TubeHardwareDig2Go) display.print(F("DIG2GO"));
        else if (artifact.family == TubeHardwareAthomC3) display.print(F("ATHOM C3"));
        else display.print(F("UNKNOWN TARGET"));
        if (artifact.variant == TubeVariantStandard) display.print(F(" | STANDARD | v"));
        else display.print(F(" | VARIANT UNKNOWN | v"));
        display.print(artifact.release);
      }
    }
    drawButton({{20, 316, 150, 46}, COLOR_PRIMARY, F("Scan")});
    TubesS3CarrierStatus carrier;
    tubesS3ReadCarrierStatus(carrier);
    setDetailFont();
    display.setTextColor(COLOR_MUTED, COLOR_BACKGROUND);
    display.setCursor(190, 332);
    display.printf("Carrier state %u  |  release %u\n", carrier.state, carrier.release);
    display.setCursor(24, 372);
    display.println(F("DISCOVERED UPDATE TARGETS"));
    const size_t count = tubesS3CarrierTargetCount();
    display.setTextColor(RGB565_WHITE, COLOR_BACKGROUND);
    if (count == 0) {
      setBodyFont();
      display.setCursor(24, 412);
      display.println(F("NO DEVICES NEARBY"));
    }
    for (size_t index = 0; index < count && index < 2; index++) {
      TubesS3CarrierTarget target;
      if (!tubesS3ReadCarrierTarget(index, target)) continue;
      const int16_t y = 400 + index * 66;
      drawDeviceCard(y, {target.nodeId, target.release, target.uplinkId,
                     (millis() - target.lastSeenMs) / 1000,
                     target.family == 1 ? "DIG2GO" : "C3"});
    }
#else
    display.setTextColor(COLOR_MUTED, COLOR_BACKGROUND);
    setBodyFont();
    display.setCursor(36, 136);
    display.println(F("Carrier build required"));
    setDetailFont();
    display.setCursor(36, 178);
    display.println(F("This build has no embedded device images."));
#endif
  }

  class FieldView {
  public:
    FieldView(WaveshareS3FieldOs &owner, FieldViewId id,
              const __FlashStringHelper *title, uint32_t refreshMs)
        : owner(owner), viewId(id), viewTitle(title), refreshIntervalMs(refreshMs) {}
    virtual ~FieldView() = default;

    FieldViewId id() const { return viewId; }
    void render(bool full) {
      if (full) owner.drawChrome(viewTitle, viewId != FieldViewId::Home);
      renderContent(full);
      lastRefreshMs = millis();
      lastRevision = revision();
    }
    virtual FieldViewId tap(int16_t, int16_t) { return viewId; }
    virtual void tick(uint32_t now) {
      if (refreshIntervalMs && now - lastRefreshMs >= refreshIntervalMs) {
        lastRefreshMs = now;
        const uint32_t nextRevision = revision();
        if (nextRevision != lastRevision) render(false);
      }
    }

  protected:
    WaveshareS3FieldOs &owner;
    virtual void renderContent(bool full) = 0;
    uint32_t lastRefreshMs = 0;
    virtual uint32_t revision() { return 0; }

  private:
    FieldViewId viewId;
    const __FlashStringHelper *viewTitle;
    uint32_t refreshIntervalMs;
    uint32_t lastRevision = 0;
  };

  class HomeView final : public FieldView {
  public:
    explicit HomeView(WaveshareS3FieldOs &owner)
        : FieldView(owner, FieldViewId::Home, F("Tubes Field OS"), 0) {}
    FieldViewId tap(int16_t x, int16_t y) override {
      if (Rect{20, 128, 210, 150}.contains(x, y)) return FieldViewId::Patterns;
      if (Rect{250, 128, 210, 150}.contains(x, y)) return FieldViewId::Beats;
      if (Rect{20, 294, 210, 150}.contains(x, y)) return FieldViewId::Colors;
      if (Rect{250, 294, 210, 150}.contains(x, y)) return FieldViewId::Mesh;
      return FieldViewId::Home;
    }
  protected:
    void renderContent(bool) override { owner.drawHomeContent(); }
  };

  class PatternsView final : public FieldView {
  public:
    explicit PatternsView(WaveshareS3FieldOs &owner)
        : FieldView(owner, FieldViewId::Patterns, F("Patterns"), SAMPLE_INTERVAL_MS) {}
    FieldViewId tap(int16_t x, int16_t y) override {
      if (x >= 20 && x < 460 && y >= 148 && y < 470) {
        const uint8_t column = (x - 20) / 149;
        const uint8_t row = (y - 148) / 82;
        if (column < 3 && row < 4) {
          const uint8_t index = row * 3 + column;
          owner.nextSendFailed = !tubesS3SelectPattern(owner.patternChoiceId(index));
          owner.drawPatternsContent(false);
        }
      }
      return FieldViewId::Patterns;
    }
  protected:
    void renderContent(bool full) override { owner.drawPatternsContent(full); }
    uint32_t revision() override {
      TubesS3FieldStatus status;
      tubesS3ReadStatus(status);
      return owner.patternsRevision(status);
    }
  };

  class BeatsView final : public FieldView {
  public:
    explicit BeatsView(WaveshareS3FieldOs &owner)
        : FieldView(owner, FieldViewId::Beats, F("Beats"), MICROPHONE_PREVIEW_INTERVAL_MS) {}
    FieldViewId tap(int16_t x, int16_t y) override {
      if (Rect{20, 112, 120, 78}.contains(x, y)) {
        TubesS3FieldStatus status;
        tubesS3ReadStatus(status);
        tubesS3SetTempoListening(!status.tempoListening);
        owner.drawBeatsContent(false);
      } else if (Rect{390, 112, 70, 78}.contains(x, y)) {
        tubesS3TapDownbeat();
      } else if (x >= 20 && x < 460 && y >= 210 && y < 468) {
        const uint8_t column = (x - 20) / 149;
        const uint8_t row = (y - 210) / 86;
        if (column < 3 && row < 3) {
          tubesS3SelectBeatOverlay(row * 3 + column);
          owner.drawBeatsContent(false);
        }
      }
      return FieldViewId::Beats;
    }
  protected:
    void renderContent(bool full) override { owner.drawBeatsContent(full); }
    uint32_t revision() override {
      TubesS3FieldStatus status;
      tubesS3ReadStatus(status);
      return owner.beatsRevision(status);
    }
  };

  class MeshView final : public FieldView {
  public:
    explicit MeshView(WaveshareS3FieldOs &owner)
        : FieldView(owner, FieldViewId::Mesh, F("Mesh"), SAMPLE_INTERVAL_MS) {}
    FieldViewId tap(int16_t x, int16_t y) override {
      if (Rect{120, 408, 240, 56}.contains(x, y)) return FieldViewId::Update;
      return FieldViewId::Mesh;
    }
  protected:
    void renderContent(bool) override { owner.drawMeshContent(); }
    uint32_t revision() override {
      TubesS3FieldStatus status;
      tubesS3ReadStatus(status);
      uint32_t value = owner.mixRevision(status.localNodeId, status.tubesVersion);
      value = owner.mixRevision(value, status.uplinkId);
      for (size_t index = 0; index < status.peerCount; index++) {
        TubesS3PeerStatus peer;
        if (!tubesS3ReadPeer(index, peer)) continue;
        value = owner.mixRevision(value, peer.nodeId);
        value = owner.mixRevision(value, peer.uplinkId);
        value = owner.mixRevision(value, peer.tubesVersion);
        value = owner.mixRevision(value, (millis() - peer.lastSeenMs) / 5000);
      }
      return value;
    }
  };

  class ColorsView final : public FieldView {
  public:
    explicit ColorsView(WaveshareS3FieldOs &owner)
        : FieldView(owner, FieldViewId::Colors, F("Colors"), 0) {}
    FieldViewId tap(int16_t x, int16_t y) override {
      if (y >= 142 && y < 184) {
        owner.selectGradientStopAt(x);
        owner.regenerateGradientPresets();
      } else if (x >= 20 && x < 460 && y >= 192 && y < 238) {
        owner.gradientStops[owner.selectedGradientStop].color = owner.colorFromHsv(
            owner.hueFromPaletteX(x), 255, 255);
        owner.regenerateGradientPresets();
        owner.queueGradient();
      } else if (x >= 20 && x < 460 && y >= 252 && y < 294) {
        const uint8_t level = (x - 20) / 110;
        owner.gradientStops[owner.selectedGradientStop].color = owner.setColorBrightness(
            owner.gradientStops[owner.selectedGradientStop].color,
            owner.gradientBrightness(level));
        owner.regenerateGradientPresets();
        owner.queueGradient();
      } else if (x >= 20 && x < 460 && y >= 312 && y < 428) {
        const uint8_t column = (x - 20) / 110;
        const uint8_t row = (y - 312) / 64;
        if (column < 4 && row < 2)
          owner.applyGradientPreset(row * 4 + column);
      }
      owner.drawColorsContent();
      return FieldViewId::Colors;
    }
  protected:
    void renderContent(bool) override { owner.drawColorsContent(); }
  };

  class UpdateView final : public FieldView {
  public:
    explicit UpdateView(WaveshareS3FieldOs &owner)
        : FieldView(owner, FieldViewId::Update, F("Update"), SAMPLE_INTERVAL_MS) {}
    FieldViewId tap(int16_t x, int16_t y) override {
#ifdef TUBES_S3_FIRMWARE_CARRIER
      if (Rect{20, 252, 150, 60}.contains(x, y)) {
        tubesS3ScanCarrierTargets();
      } else if (y >= 326) {
        const size_t index = (y - 332) / 66;
        TubesS3CarrierTarget target;
        if (tubesS3ReadCarrierTarget(index, target))
          tubesS3ArmCarrier(target.mac, target.family, target.variant, target.release);
      }
#endif
      return FieldViewId::Update;
    }
  protected:
    void renderContent(bool) override { owner.drawUpdateContent(); }
    uint32_t revision() override {
#ifdef TUBES_S3_FIRMWARE_CARRIER
      TubesS3CarrierStatus carrier;
      tubesS3ReadCarrierStatus(carrier);
      uint32_t value = owner.mixRevision(carrier.state, carrier.release);
      const size_t count = tubesS3CarrierTargetCount();
      value = owner.mixRevision(value, count);
      for (size_t index = 0; index < count; index++) {
        TubesS3CarrierTarget target;
        if (!tubesS3ReadCarrierTarget(index, target)) continue;
        value = owner.mixRevision(value, target.nodeId);
        value = owner.mixRevision(value, target.uplinkId);
        value = owner.mixRevision(value, target.release);
        value = owner.mixRevision(value, (millis() - target.lastSeenMs) / 5000);
      }
      return value;
#else
      return 0;
#endif
    }
  };

  class ViewManager {
  public:
    ViewManager(WaveshareS3FieldOs &owner, HomeView &home, PatternsView &patterns,
                BeatsView &beats, MeshView &mesh, ColorsView &colors, UpdateView &update)
        : owner(owner), home(home), patterns(patterns), beats(beats), mesh(mesh),
          colors(colors), update(update), active(&home) {}

    void begin() { active->render(true); }
    void redraw() { active->render(true); }
    void tick(uint32_t now) { active->tick(now); }
    void tap(int16_t x, int16_t y) {
      if (y < FIELD_OS_HEADER_HEIGHT) {
        if (active->id() != FieldViewId::Home) navigate(FieldViewId::Home);
        return;
      }
      const FieldViewId destination = active->tap(x, y);
      if (destination != active->id()) navigate(destination);
    }

  private:
    void navigate(FieldViewId id) {
      active = view(id);
      active->render(true);
    }
    FieldView *view(FieldViewId id) {
      switch (id) {
        case FieldViewId::Patterns: return &patterns;
        case FieldViewId::Beats: return &beats;
        case FieldViewId::Mesh: return &mesh;
        case FieldViewId::Colors: return &colors;
        case FieldViewId::Update: return &update;
        case FieldViewId::Home: default: return &home;
      }
    }

    WaveshareS3FieldOs &owner;
    HomeView &home;
    PatternsView &patterns;
    BeatsView &beats;
    MeshView &mesh;
    ColorsView &colors;
    UpdateView &update;
    FieldView *active;
  };

  HomeView homeView;
  PatternsView patternsView;
  BeatsView beatsView;
  MeshView meshView;
  ColorsView colorsView;
  UpdateView updateView;
  ViewManager viewManager;

public:
  WaveshareS3FieldOs()
      : homeView(*this), patternsView(*this), beatsView(*this), meshView(*this),
        colorsView(*this), updateView(*this),
        viewManager(*this, homeView, patternsView, beatsView, meshView, colorsView,
                    updateView) {}

  void setup() override {
    Wire.begin(PERIPHERAL_SDA, PERIPHERAL_SCL);
    microphoneReady = initializeMicrophones();
    pmuReady = pmu.begin(Wire, AXP2101_SLAVE_ADDRESS, PERIPHERAL_SDA, PERIPHERAL_SCL);
    if (pmuReady) {
      pmu.disableTSPinMeasure();
      pmu.enableBattDetection();
      pmu.enableBattVoltageMeasure();
      pmu.enableVbusVoltageMeasure();
      pmu.disableIRQ(XPOWERS_AXP2101_ALL_IRQ);
      pmu.clearIrqStatus();
      pmu.enableIRQ(XPOWERS_AXP2101_PKEY_SHORT_IRQ);
      pmu.setPowerKeyPressOnTime(XPOWERS_POWERON_128MS);
      pmu.setPowerKeyPressOffTime(XPOWERS_POWEROFF_10S);
      pmu.enableLongPressShutdown();
      pmu.setLongPressPowerOFF();
      samplePower(millis(), true);
    }
    displayReady = display.begin();
    if (displayReady) {
      display.setBrightness(
#ifdef TUBES_S3_FIELD_OS
        FIELD_OS_DEFAULT_BRIGHTNESS
#else
        SMOKE_DEFAULT_BRIGHTNESS
#endif
      );
      display.setTextWrap(false);
    }
    pinMode(TOUCH_RESET, OUTPUT);
    digitalWrite(TOUCH_RESET, LOW);
    delay(10);
    digitalWrite(TOUCH_RESET, HIGH);
    delay(50);
    pinMode(TOUCH_IRQ, INPUT_PULLUP);
    touchReady = touch.begin(Wire, CST92XX_SLAVE_ADDRESS, PERIPHERAL_SDA, PERIPHERAL_SCL);
    if (touchReady) {
      touch.setMaxCoordinates(DISPLAY_WIDTH, DISPLAY_HEIGHT);
      touchInterruptPending = false;
      attachInterrupt(TOUCH_IRQ, handleTouchInterrupt, FALLING);
    }
    lastActivityMs = millis();
    regenerateGradientPresets();
    if (displayReady) viewManager.begin();
  }

  void loop() override {
    if (touchReady && touchInterruptPending) {
      touchInterruptPending = false;
      int16_t x = -1;
      int16_t y = -1;
      const bool pressed = touch.getPoint(&x, &y, 1) > 0;
      if (screenOn && pressed) {
        lastActivityMs = millis();
        if (!touchDown) viewManager.tap(x, y);
      }
      touchDown = pressed;
    }
    if (!displayReady) return;
    const uint32_t now = millis();
    tickShell(now);
    if (screenOn) viewManager.tick(now);
  }

  bool handleButton(uint8_t b) override {
    return b < WLED_MAX_BUTTONS;
  }

  void addToJsonInfo(JsonObject &root) override {
    JsonObject user = root[F("u")];
    if (user.isNull()) user = root.createNestedObject(F("u"));
    JsonArray fieldOs = user.createNestedArray(F("S3 field OS"));
    fieldOs.add(displayReady ? F("display OK") : F("display FAIL"));
    fieldOs.add(touchReady ? F("touch OK") : F("touch FAIL"));
    fieldOs.add(pmuReady ? F("PMU OK") : F("PMU FAIL"));
    fieldOs.add(microphoneReady ? F("microphones OK") : F("microphones FAIL"));
  }
};

static WaveshareS3FieldOs waveshareS3FieldOs;
REGISTER_USERMOD(waveshareS3FieldOs);
#else

class WaveshareS3PeripheralSmoke : public Usermod {
private:
  bool displayReady = false;
  bool touchReady = false;
  bool pmuReady = false;
  bool imuReady = false;
  uint8_t displayBrightness =
#ifdef TUBES_S3_FIELD_OS
    FIELD_OS_DEFAULT_BRIGHTNESS;
#else
    SMOKE_DEFAULT_BRIGHTNESS;
#endif
  uint32_t lastSample = 0;
  int16_t touchX = -1;
  int16_t touchY = -1;
  uint16_t batteryMv = 0;
  bool usbPresent = false;
  bool charging = false;
  float accelX = 0.0f;
  float accelY = 0.0f;
  float accelZ = 0.0f;

  // Samples only board-local peripherals and never enters a Tubes transport path.
  void samplePeripherals() {
    if (pmuReady) {
      batteryMv = pmu.getBattVoltage();
      usbPresent = pmu.isVbusIn();
      charging = pmu.isCharging();
    }

    if (imuReady) imu.getAccelerometer(accelX, accelY, accelZ);

  }

  // Consumes the CST9217's falling-edge notification before its short IRQ pulse is lost.
  void sampleTouch() {
    if (!touchReady || !touchInterruptPending) return;
    touchInterruptPending = false;
    int16_t x = -1;
    int16_t y = -1;
    if (touch.getPoint(&x, &y, 1) > 0) {
      touchX = x;
      touchY = y;
    }
  }

  // Paints a stable diagnostic surface intended for first hardware bring-up.
  void drawStatus() {
    if (!displayReady) return;

    display.fillScreen(RGB565_BLACK);
    display.setCursor(12, 14);
    display.setTextColor(RGB565_CYAN);
    display.setTextSize(2);
    display.println(F("WLEDTubes S3 smoke"));
    display.setTextColor(RGB565_WHITE);
    display.setTextSize(2);
    display.setCursor(12, 62);
    display.print(F("Display  OK   BRI "));
    display.println(displayBrightness);
    display.setCursor(12, 104);
    display.print(F("Touch    "));
    display.print(touchReady ? F("OK") : F("FAIL"));
    display.print(F("   "));
    display.print(touchX);
    display.print(F(","));
    display.println(touchY);
    display.setCursor(12, 146);
    display.print(F("PMU      "));
    display.print(pmuReady ? F("OK") : F("FAIL"));
    display.print(F("   "));
    display.print(batteryMv);
    display.println(F(" mV"));
    display.setCursor(12, 188);
    display.print(F("USB      "));
    display.print(usbPresent ? F("YES") : F("NO"));
    display.print(F("   CHG "));
    display.println(charging ? F("YES") : F("NO"));
    display.setCursor(12, 230);
    display.print(F("IMU      "));
    display.println(imuReady ? F("OK") : F("FAIL"));
    display.setCursor(12, 272);
    display.print(F("ACC X "));
    display.println(accelX, 2);
    display.setCursor(12, 314);
    display.print(F("ACC Y "));
    display.println(accelY, 2);
    display.setCursor(12, 356);
    display.print(F("ACC Z "));
    display.println(accelZ, 2);
    display.setTextSize(1);
    display.setTextColor(RGB565_YELLOW);
    display.setCursor(12, 414);
    display.println(F("TOUCH: COORDINATES ONLY"));
    display.setCursor(12, 438);
    display.println(F("No LED output. No smoke-test radio TX."));
  }

public:
  void setup() override {
    Wire.begin(PERIPHERAL_SDA, PERIPHERAL_SCL);

    displayReady = display.begin();
    if (displayReady) {
      display.setBrightness(displayBrightness);
      display.setTextWrap(false);
    }

    pinMode(TOUCH_RESET, OUTPUT);
    digitalWrite(TOUCH_RESET, LOW);
    delay(10);
    digitalWrite(TOUCH_RESET, HIGH);
    delay(50);
    pinMode(TOUCH_IRQ, INPUT_PULLUP);
    touchReady = touch.begin(Wire, CST92XX_SLAVE_ADDRESS, PERIPHERAL_SDA, PERIPHERAL_SCL);
    if (touchReady) {
      touch.setMaxCoordinates(DISPLAY_WIDTH, DISPLAY_HEIGHT);
      touchInterruptPending = false;
      attachInterrupt(TOUCH_IRQ, handleTouchInterrupt, FALLING);
    }

    pmuReady = pmu.begin(Wire, AXP2101_SLAVE_ADDRESS, PERIPHERAL_SDA, PERIPHERAL_SCL);
    if (pmuReady) {
      pmu.enableBattVoltageMeasure();
      pmu.enableVbusVoltageMeasure();
    }

    imuReady = imu.begin(Wire, QMI8658_L_SLAVE_ADDRESS, PERIPHERAL_SDA, PERIPHERAL_SCL);
    if (imuReady) {
      imu.configAccelerometer(SensorQMI8658::ACC_RANGE_2G, SensorQMI8658::ACC_ODR_31_25Hz);
      imu.enableAccelerometer();
    }

    samplePeripherals();
    drawStatus();
  }

  void loop() override {
    sampleTouch();
    const uint32_t now = millis();
    if (now - lastSample < SAMPLE_INTERVAL_MS) return;
    lastSample = now;
    samplePeripherals();
    drawStatus();
  }

  void addToJsonInfo(JsonObject &root) override {
    JsonObject user = root[F("u")];
    if (user.isNull()) user = root.createNestedObject(F("u"));
    JsonArray smoke = user.createNestedArray(F("S3 peripheral smoke"));
    smoke.add(displayReady ? F("display OK") : F("display FAIL"));
    smoke.add(touchReady ? F("touch OK") : F("touch FAIL"));
    smoke.add(pmuReady ? F("PMU OK") : F("PMU FAIL"));
    smoke.add(imuReady ? F("IMU OK") : F("IMU FAIL"));

    JsonArray battery = user.createNestedArray(F("S3 battery"));
    battery.add(batteryMv);
    battery.add(F(" mV"));
    JsonArray power = user.createNestedArray(F("S3 power"));
    power.add(usbPresent ? F("USB") : F("battery"));
    power.add(charging ? F(", charging") : F(""));
  }
};

static WaveshareS3PeripheralSmoke waveshareS3PeripheralSmoke;
REGISTER_USERMOD(waveshareS3PeripheralSmoke);
#endif
} // namespace

// Forced-link anchor for the board-specific PlatformIO environment.
extern "C" void waveshareS3TubesRemoteLinkAnchor() {}
// AI: end

#endif
