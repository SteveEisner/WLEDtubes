#pragma once

#include <stddef.h>
#include <stdint.h>
#include <string.h>

#include "firmware_image_source.h"

// AI: below section was generated by an AI
enum FirmwareUpdateState : uint8_t {
  FirmwareUpdateIdle = CanonicalUpdateIdle,
  FirmwareUpdateTargetSelected = CanonicalUpdateTargetSelected,
  FirmwareUpdateTransferring = CanonicalUpdateTransferring,
  FirmwareUpdateAwaitingHealth = CanonicalUpdateAwaitingHealth,
  FirmwareUpdateHealthy = CanonicalUpdateHealthy,
  FirmwareUpdateComplete = CanonicalUpdateComplete,
  FirmwareUpdateFailed = CanonicalUpdateFailed,
};

enum FirmwareUpdateFailure : uint8_t {
  FirmwareUpdateNoFailure = 0,
  FirmwareUpdateLeaseExpired,
  FirmwareUpdateTransferHashMismatch,
  FirmwareUpdateHealthMismatch,
};

struct FirmwareUpdateHealthProof {
  FirmwareTargetContract target;
  uint32_t releaseHash = 0;
  uint8_t imageSha256[32] = {0};
  bool runtimeConfigurationPreserved = false;
  bool meshRejoined = false;
  bool stable = false;
};

// Typed, artifact-bound evidence emitted only after this session reaches its
// terminal healthy state. Consumers still validate every field fail closed.
class FirmwareUpdateCompletionProof {
public:
  FirmwareUpdateCompletionProof() = default;
  bool isComplete() const { return _complete; }
  bool targetIs(const uint8_t mac[6]) const {
    return mac && memcmp(mac, _targetMac, sizeof(_targetMac)) == 0;
  }
  const FirmwareImageArtifact& artifact() const { return _artifact; }
  uint32_t sessionNonce() const { return _sessionNonce; }

private:
  friend class FirmwareUpdateSession;
  uint8_t _targetMac[6] = {0};
  FirmwareImageArtifact _artifact;
  uint32_t _sessionNonce = 0;
  bool _complete = false;
};

// Coordinates one sender, one exact target, and one immutable application
// artifact. This is an internal state machine only: it deliberately defines no
// packet layout and never enables autonomous forwarding.
class FirmwareUpdateSession {
public:
  bool select(
      const uint8_t senderMac[6],
      const uint8_t targetMac[6],
      const FirmwareImageArtifact& artifact,
      const FirmwareTargetContract& receiverTarget,
      const FirmwareUpdateDestination& destination,
      uint32_t now,
      uint32_t leaseDuration,
      uint32_t sessionNonce = 0
  ) {
    if (_state != FirmwareUpdateIdle
        || !macIsKnown(senderMac)
        || !macIsKnown(targetMac)
        || memcmp(senderMac, targetMac, 6) == 0
        || leaseDuration == 0
        || leaseDuration > 0x7FFFFFFFU
        || !firmwareArtifactMatchesCanonical(artifact)
        || artifact.kind != CanonicalArtifactApplicationImage
        || artifact.transport != CanonicalTransportOta
        || !firmwareArtifactFitsInactiveSlot(receiverTarget, destination,
            artifact.imageLengthBytes)
        || matchFirmwareArtifactTarget(artifact.target, receiverTarget)
            != FirmwareTargetMatchExact)
      return false;

    memcpy(_senderMac, senderMac, sizeof(_senderMac));
    memcpy(_targetMac, targetMac, sizeof(_targetMac));
    _artifact = artifact;
    _leaseDeadline = now + leaseDuration;
    _sessionNonce = sessionNonce;
    _transferredBytes = 0;
    _failure = FirmwareUpdateNoFailure;
    _state = FirmwareUpdateTargetSelected;
    return true;
  }

  bool startTransfer(const uint8_t targetMac[6], uint32_t now) {
    if (_state != FirmwareUpdateTargetSelected || !isTarget(targetMac))
      return false;
    if (!leaseIsActive(now))
      return fail(FirmwareUpdateLeaseExpired);
    _state = FirmwareUpdateTransferring;
    return true;
  }

  bool recordProgress(const uint8_t targetMac[6], size_t transferredBytes, uint32_t now) {
    if (_state != FirmwareUpdateTransferring || !isTarget(targetMac))
      return false;
    if (!leaseIsActive(now))
      return fail(FirmwareUpdateLeaseExpired);
    if (transferredBytes < _transferredBytes
        || transferredBytes > _artifact.imageLengthBytes)
      return false;
    _transferredBytes = transferredBytes;
    return true;
  }

  bool verifyTransfer(const uint8_t targetMac[6], const uint8_t imageSha256[32], uint32_t now) {
    if (_state != FirmwareUpdateTransferring || !isTarget(targetMac))
      return false;
    if (!leaseIsActive(now))
      return fail(FirmwareUpdateLeaseExpired);
    if (_transferredBytes != _artifact.imageLengthBytes
        || !imageSha256
        || memcmp(imageSha256, _artifact.imageSha256, sizeof(_artifact.imageSha256)) != 0)
      return fail(FirmwareUpdateTransferHashMismatch);
    _state = FirmwareUpdateAwaitingHealth;
    return true;
  }

  bool proveHealthy(
      const uint8_t targetMac[6],
      const FirmwareUpdateHealthProof& proof,
      uint32_t now
  ) {
    if (_state != FirmwareUpdateAwaitingHealth || !isTarget(targetMac))
      return false;
    if (!leaseIsActive(now))
      return fail(FirmwareUpdateLeaseExpired);
    if (matchFirmwareArtifactTarget(_artifact.target, proof.target) != FirmwareTargetMatchExact
        || proof.releaseHash != _artifact.releaseHash
        || memcmp(proof.imageSha256, _artifact.imageSha256,
            sizeof(_artifact.imageSha256)) != 0
        || !proof.runtimeConfigurationPreserved
        || !proof.meshRejoined
        || !proof.stable)
      return fail(FirmwareUpdateHealthMismatch);
    _state = FirmwareUpdateHealthy;
    return true;
  }

  bool complete(const uint8_t targetMac[6]) {
    if (_state != FirmwareUpdateHealthy || !isTarget(targetMac))
      return false;
    _state = FirmwareUpdateComplete;
    return true;
  }

  void reset() {
    memset(_senderMac, 0, sizeof(_senderMac));
    memset(_targetMac, 0, sizeof(_targetMac));
    _artifact = FirmwareImageArtifact();
    _leaseDeadline = 0;
    _sessionNonce = 0;
    _transferredBytes = 0;
    _failure = FirmwareUpdateNoFailure;
    _state = FirmwareUpdateIdle;
  }

  FirmwareUpdateState state() const { return _state; }
  FirmwareUpdateFailure failure() const { return _failure; }
  size_t transferredBytes() const { return _transferredBytes; }
  bool batonReady() const { return _state == FirmwareUpdateComplete; }
  bool completedTargetIs(const uint8_t targetMac[6]) const {
    return batonReady() && isTarget(targetMac);
  }
  bool completionProof(FirmwareUpdateCompletionProof& proof) const {
    proof = FirmwareUpdateCompletionProof();
    if (!batonReady() || _sessionNonce == 0) return false;
    memcpy(proof._targetMac, _targetMac, sizeof(proof._targetMac));
    proof._artifact = _artifact;
    proof._sessionNonce = _sessionNonce;
    proof._complete = true;
    return true;
  }
  bool forwardingEnabled() const { return false; }

private:
  static bool macIsKnown(const uint8_t mac[6]) {
    if (!mac)
      return false;
    uint8_t combined = 0;
    for (size_t index = 0; index < 6; index++)
      combined |= mac[index];
    return combined != 0;
  }

  static bool hashIsKnown(const uint8_t hash[32]) {
    uint8_t combined = 0;
    for (size_t index = 0; index < 32; index++)
      combined |= hash[index];
    return combined != 0;
  }

  bool isTarget(const uint8_t mac[6]) const {
    return mac && memcmp(mac, _targetMac, sizeof(_targetMac)) == 0;
  }

  bool leaseIsActive(uint32_t now) const {
    return static_cast<int32_t>(_leaseDeadline - now) > 0;
  }

  bool fail(FirmwareUpdateFailure failure) {
    _failure = failure;
    _state = FirmwareUpdateFailed;
    return false;
  }

  uint8_t _senderMac[6] = {0};
  uint8_t _targetMac[6] = {0};
  FirmwareImageArtifact _artifact;
  uint32_t _leaseDeadline = 0;
  uint32_t _sessionNonce = 0;
  size_t _transferredBytes = 0;
  FirmwareUpdateFailure _failure = FirmwareUpdateNoFailure;
  FirmwareUpdateState _state = FirmwareUpdateIdle;
};
// AI: end
