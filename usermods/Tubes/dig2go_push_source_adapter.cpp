#include "dig2go_push_source_adapter.h"

#if TUBES_ENABLE_DIG2GO_PUSH_BRIDGE

#include "wled.h"
#include <WiFiClient.h>
#include <errno.h>

namespace tubes_p2p {
namespace {

// AI: below section was generated by an AI
const IPAddress DIG2GO_UPDATE_HOST(4, 3, 2, 1);
static constexpr uint16_t DIG2GO_UPDATE_PORT = 80;
static constexpr uint32_t DIG2GO_HTTP_TIMEOUT_MS = 5000;

bool deadlineActive(uint32_t deadline) {
  return static_cast<int32_t>(deadline - millis()) > 0;
}

bool writeExact(WiFiClient& client, const uint8_t* data, size_t length) {
  return data && length > 0 && client.write(data, length) == length;
}

bool parseHttpStatus(const char* line, int& status) {
  if (!line || strncmp(line, "HTTP/1.", 7) != 0
      || (line[7] != '0' && line[7] != '1') || line[8] != ' ')
    return false;
  if (line[9] < '0' || line[9] > '9'
      || line[10] < '0' || line[10] > '9'
      || line[11] < '0' || line[11] > '9'
      || (line[12] != ' ' && line[12] != '\r' && line[12] != '\0'))
    return false;
  status = (line[9] - '0') * 100 + (line[10] - '0') * 10 + line[11] - '0';
  return true;
}

bool parseMac(const char* text, uint8_t mac[6]) {
  if (!text || !mac || strnlen(text, 18) != 12)
    return false;
  for (size_t index = 0; index < 6; index++) {
    uint8_t value = 0;
    for (size_t nibble = 0; nibble < 2; nibble++) {
      const char c = text[index * 2 + nibble];
      uint8_t digit;
      if (c >= '0' && c <= '9') digit = c - '0';
      else if (c >= 'a' && c <= 'f') digit = c - 'a' + 10;
      else if (c >= 'A' && c <= 'F') digit = c - 'A' + 10;
      else return false;
      value = uint8_t((value << 4) | digit);
    }
    mac[index] = value;
  }
  return true;
}

bool readDig2GoConfigFacts(JsonObjectConst root, Dig2GoJsonFacts& facts) {
  JsonObjectConst led = root["hw"]["led"];
  JsonArrayConst outputs = led["ins"];
  if (led.isNull() || !led.containsKey("total") || outputs.isNull())
    return false;
  facts.ledTotal = led["total"].as<uint16_t>();
  facts.outputCount = outputs.size();
  // Migration-era Dig2Go builds relied on the compiled GPIO-16 bus and stored
  // no explicit output. The existing laptop updater recognizes the same
  // empty-bus/300-pixel shape before installing the modern explicit profile.
  if (outputs.size() == 0) return true;
  if (outputs.size() != 1) return false;
  JsonObjectConst output = outputs[0];
  JsonArrayConst pins = output["pin"];
  if (output.isNull()
      || !output.containsKey("start") || !output.containsKey("len")
      || !output.containsKey("pin") || !output.containsKey("type")
      || !output.containsKey("order") || !output.containsKey("rev")
      || !output.containsKey("skip") || pins.size() != 1)
    return false;
  facts.outputLength = output["len"].as<uint16_t>();
  facts.pin = pins[0].as<uint8_t>();
  facts.type = output["type"].as<uint8_t>();
  facts.order = output["order"].as<uint8_t>();
  facts.start = output["start"].as<uint8_t>();
  facts.skip = output["skip"].as<uint8_t>();
  facts.reversed = output["rev"].as<bool>();
  return true;
}

#if !defined(TUBES_DIG2GO_STEP3_DIAGNOSTIC) && !defined(TUBES_DIG2GO_READINESS_DELAY_TEST) && !defined(TUBES_DIG2GO_INSPECTION_ONLY_TEST)
class WiFiClientFirmwarePostTransport : public FirmwarePostTransport {
public:
  bool begin(size_t contentLength, const char* contentType) override {
    Serial.printf("TUBE_PUSH_HTTP begin bytes=%u wifi=%d ip=%s gateway=%s\n",
        static_cast<unsigned>(contentLength), static_cast<int>(WiFi.status()),
        WiFi.localIP().toString().c_str(), WiFi.gatewayIP().toString().c_str());
    if (!contentType || !_client.connect(DIG2GO_UPDATE_HOST, DIG2GO_UPDATE_PORT)) {
      Serial.printf("TUBE_PUSH_HTTP connect_failed errno=%d wifi=%d\n",
          errno, static_cast<int>(WiFi.status()));
      return false;
    }
    char header[256];
    const int length = snprintf(header, sizeof(header),
        "POST /update HTTP/1.1\r\nHost: 4.3.2.1\r\nConnection: close\r\n"
        "Content-Type: %s\r\nContent-Length: %u\r\n\r\n",
        contentType, static_cast<unsigned>(contentLength));
    const bool sent = length > 0 && static_cast<size_t>(length) < sizeof(header)
        && writeExact(_client, reinterpret_cast<const uint8_t*>(header), length);
    Serial.printf("TUBE_PUSH_HTTP header=%s\n", sent ? "sent" : "failed");
    return sent;
  }

  size_t write(const uint8_t* data, size_t length) override {
    if (!data || length == 0) return 0;
    size_t written = 0;
    uint32_t deadline = millis() + DIG2GO_HTTP_TIMEOUT_MS;
    while (written < length && deadlineActive(deadline)) {
      const size_t count = _client.write(data + written, length - written);
      if (count > 0) {
        written += count;
        // A successful partial write is progress: give the legacy receiver a
        // fresh bounded window to drain TCP and commit its OTA flash chunk.
        deadline = millis() + DIG2GO_HTTP_TIMEOUT_MS;
        continue;
      }
      if (!_client.connected()) break;
      delay(1);
    }
    // WLED 0.14.x receives OTA data and writes flash on the same constrained
    // async stack. An unpaced ESP32 sender can fill its roughly 8 KiB TCP
    // window before flash erase/write catches up, after which the legacy peer
    // closes the connection. Yield a bounded commit window per 1 KiB write.
    if (written == length) delay(25);
    _totalWritten += written;
    if (_totalWritten >= _nextProgress) {
      Serial.printf("TUBE_PUSH_HTTP progress=%u connected=%d wifi=%d rssi=%d\n",
          static_cast<unsigned>(_totalWritten), _client.connected() ? 1 : 0,
          static_cast<int>(WiFi.status()), WiFi.RSSI());
      _nextProgress += 65536;
    }
    if (written != length) {
      Serial.printf("TUBE_PUSH_HTTP write_failed requested=%u wrote=%u total=%u errno=%d connected=%d wifi=%d\n",
          static_cast<unsigned>(length), static_cast<unsigned>(written),
          static_cast<unsigned>(_totalWritten), errno, _client.connected() ? 1 : 0,
          static_cast<int>(WiFi.status()));
    }
    return written;
  }

  int finish() override {
    char line[96] = {0};
    size_t used = 0;
    const uint32_t deadline = millis() + DIG2GO_HTTP_TIMEOUT_MS;
    while (deadlineActive(deadline)) {
      while (_client.available()) {
        const int value = _client.read();
        if (value < 0) break;
        if (value == '\n') {
          line[used] = '\0';
          int status = 0;
          _client.stop();
          const bool parsed = parseHttpStatus(line, status);
          Serial.printf("TUBE_PUSH_HTTP response=%s status=%d total=%u\n",
              parsed ? "parsed" : "invalid", parsed ? status : 0,
              static_cast<unsigned>(_totalWritten));
          return parsed ? status : 0;
        }
        if (used + 1 >= sizeof(line)) {
          _client.stop();
          return 0;
        }
        line[used++] = static_cast<char>(value);
      }
      if (!_client.connected()) break;
      delay(1);
    }
    _client.stop();
    Serial.printf("TUBE_PUSH_HTTP response_missing total=%u errno=%d wifi=%d\n",
        static_cast<unsigned>(_totalWritten), errno, static_cast<int>(WiFi.status()));
    return 0;
  }

private:
  WiFiClient _client;
  size_t _totalWritten = 0;
  size_t _nextProgress = 65536;
};
#endif
// AI: end

} // namespace

bool Dig2GoPushSourceAdapter::probeReachability() {
  WiFiClient client;
  if (!client.connect(DIG2GO_UPDATE_HOST, DIG2GO_UPDATE_PORT)) return false;
  static constexpr char REQUEST[] =
      "GET /json/info HTTP/1.1\r\nHost: 4.3.2.1\r\nConnection: close\r\n\r\n";
  if (!writeExact(client, reinterpret_cast<const uint8_t*>(REQUEST), sizeof(REQUEST) - 1)) {
    client.stop();
    return false;
  }
  char line[64] = {0};
  size_t used = 0;
  const uint32_t deadline = millis() + DIG2GO_HTTP_TIMEOUT_MS;
  while (deadlineActive(deadline)) {
    while (client.available()) {
      const int value = client.read();
      if (value < 0) continue;
      if (value == '\n') {
        line[used] = '\0';
        int status = 0;
        client.stop();
        return parseHttpStatus(line, status) && status >= 200 && status < 300;
      }
      if (used + 1 >= sizeof(line)) { client.stop(); return false; }
      line[used++] = static_cast<char>(value);
    }
    if (!client.connected()) break;
    delay(1);
  }
  client.stop();
  return false;
}

bool Dig2GoPushSourceAdapter::fetchJson(const char* path, size_t& bodyLength) {
  bodyLength = 0;
  _lastHttpStatus = 0;
  WiFiClient client;
  if (!path || path[0] != '/' || !client.connect(DIG2GO_UPDATE_HOST, DIG2GO_UPDATE_PORT))
    return false;
  char request[128];
  const int requestLength = snprintf(request, sizeof(request),
      "GET %s HTTP/1.1\r\nHost: 4.3.2.1\r\nConnection: close\r\n\r\n", path);
  if (requestLength <= 0 || static_cast<size_t>(requestLength) >= sizeof(request)
      || !writeExact(client, reinterpret_cast<const uint8_t*>(request), requestLength)) {
    client.stop();
    return false;
  }

  char line[96] = {0};
  size_t used = 0;
  int status = 0;
  size_t contentLength = 0;
  bool haveContentLength = false;
  const uint32_t deadline = millis() + DIG2GO_HTTP_TIMEOUT_MS;
  while (deadlineActive(deadline)) {
    if (!client.available()) {
      if (!client.connected()) break;
      delay(1);
      continue;
    }
    const int value = client.read();
    if (value < 0) continue;
    if (value != '\n') {
      if (used + 1 >= sizeof(line)) { client.stop(); return false; }
      line[used++] = static_cast<char>(value);
      continue;
    }
    line[used] = '\0';
    if (status == 0 && !parseHttpStatus(line, status)) { client.stop(); return false; }
    if (strncmp(line, "Content-Length:", 15) == 0) {
      char* end = nullptr;
      const unsigned long parsed = strtoul(line + 15, &end, 10);
      if (end == line + 15 || parsed > JSON_BODY_CAPACITY) { client.stop(); return false; }
      contentLength = parsed;
      haveContentLength = true;
    }
    if (used == 1 && line[0] == '\r') break;
    used = 0;
  }
  if (status < 200 || status >= 300 || !haveContentLength || contentLength == 0) {
    _lastHttpStatus = status;
    client.stop();
    return false;
  }
  _lastHttpStatus = status;
  size_t received = 0;
  while (received < contentLength && deadlineActive(deadline)) {
    const int count = client.read(reinterpret_cast<uint8_t*>(_jsonBody + received), contentLength - received);
    if (count > 0) received += static_cast<size_t>(count);
    else if (!client.connected()) break;
    else delay(1);
  }
  client.stop();
  if (received != contentLength) return false;
  _jsonBody[received] = '\0';
  bodyLength = received;
  return true;
}

Dig2GoSourceAdapterResult Dig2GoPushSourceAdapter::inspectTarget(
    const Dig2GoTargetAdmission& admission,
    LegacyDig2GoEvidence& evidence
) {
  evidence = LegacyDig2GoEvidence();
  memcpy(evidence.enrolledMac, admission.enrolledMac, sizeof(evidence.enrolledMac));
  evidence.release = admission.legacyRelease;
  evidence.apSsid = DIG2GO_UPDATE_SSID;
  evidence.apIpv4 = DIG2GO_UPDATE_IPV4;

  size_t length = 0;
  if (!fetchJson("/json/si", length)) return Dig2GoSourceAdapterHttpFailed;
  StaticJsonDocument<192> infoFilter;
  infoFilter["info"]["arch"] = true;
  infoFilter["info"]["mac"] = true;
  // Some legacy WLED variants return the info object without the usual
  // state/info wrapper. Retain both shapes without allocating for effects,
  // palettes, network telemetry, or the rest of /json/si.
  infoFilter["arch"] = true;
  infoFilter["mac"] = true;
  DynamicJsonDocument infoDoc(1536);
  if (deserializeJson(infoDoc, _jsonBody, length,
      DeserializationOption::Filter(infoFilter)))
    return Dig2GoSourceAdapterJsonInvalid;
  JsonObjectConst info = infoDoc["info"];
  if (info.isNull()) info = infoDoc.as<JsonObjectConst>();
  const char* arch = info["arch"] | "";
  Dig2GoJsonFacts facts;
  // WLED v0.14.3 does not expose the later wifi.ap selected-AP telemetry.
  // The successful connection to 4.3.2.1 is the AP admission proof here;
  // keep /json/si limited to identity and architecture checks.
  if (!parseMac(info["mac"] | "", facts.observedMac)
      || strcmp(arch, "esp32") != 0)
    return Dig2GoSourceAdapterIdentityRejected;
  memcpy(evidence.observedMac, facts.observedMac, sizeof(evidence.observedMac));
  facts.classicEsp32 = true;
  facts.selectedUpdateState = true;
  evidence.hardwareFamily = TubeHardwareDig2Go;
  evidence.reportFresh = true;
  evidence.selectedForUpdate = true;
  if (memcmp(evidence.enrolledMac, evidence.observedMac, 6) != 0)
    return Dig2GoSourceAdapterIdentityRejected;

  if (!fetchJson("/json/cfg", length)) {
    if (!useLegacyConfigFallback(_lastHttpStatus) || !fetchJson("/cfg.json", length))
      return Dig2GoSourceAdapterHttpFailed;
  }
  StaticJsonDocument<384> configFilter;
  configFilter["hw"]["led"]["total"] = true;
  JsonObject outputFilter = configFilter["hw"]["led"]["ins"][0].to<JsonObject>();
  outputFilter["start"] = true;
  outputFilter["len"] = true;
  outputFilter["pin"] = true;
  outputFilter["type"] = true;
  outputFilter["order"] = true;
  outputFilter["skip"] = true;
  outputFilter["rev"] = true;
  DynamicJsonDocument configDoc(2560);
  if (deserializeJson(configDoc, _jsonBody, length,
      DeserializationOption::Filter(configFilter)))
    return Dig2GoSourceAdapterJsonInvalid;
  const bool configurationAccepted = readDig2GoConfigFacts(
      configDoc.as<JsonObjectConst>(), facts) && admitDig2GoJsonFacts(admission, facts);
#if defined(TUBES_DIG2GO_EXACT_ENROLLMENT_PROFILE)
  // The bounded A->B hardware proof uses an exact, physically identified MAC
  // as the profile authority. Legacy B's stored bus schema is advisory because
  // it predates explicit WLED outputs; the application-only OTA preserves it.
  (void)configurationAccepted;
#else
  if (!configurationAccepted)
    return Dig2GoSourceAdapterConfigurationRejected;
#endif
  return exactLegacyDig2GoUpdateTarget(evidence)
      ? Dig2GoSourceAdapterAccepted : Dig2GoSourceAdapterIdentityRejected;
}

#if !defined(TUBES_DIG2GO_STEP3_DIAGNOSTIC) && !defined(TUBES_DIG2GO_READINESS_DELAY_TEST) && !defined(TUBES_DIG2GO_INSPECTION_ONLY_TEST)
FirmwarePostResult Dig2GoPushSourceAdapter::uploadRunningImage(
    const FirmwareTargetContract& artifactTarget
) {
  RunningFirmwareImageSource source(artifactTarget);
  WiFiClientFirmwarePostTransport transport;
  return postFirmwareMultipart(source, transport, 1024);
}
#endif

} // namespace tubes_p2p

#endif
