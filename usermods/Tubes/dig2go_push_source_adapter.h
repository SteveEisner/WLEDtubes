#pragma once

#ifndef TUBES_ENABLE_DIG2GO_PUSH_BRIDGE
#define TUBES_ENABLE_DIG2GO_PUSH_BRIDGE 0
#endif

#if defined(TUBES_DIG2GO_PUSH_AUTO_TRIGGER) && !TUBES_ENABLE_DIG2GO_PUSH_BRIDGE
#error "Auto-trigger requires the Dig2Go push bridge"
#endif

#if defined(TUBES_DIG2GO_PUSH_AUTO_TRIGGER) && !defined(TUBES_DIG2GO_PUSH_PRIME_MAC)
#error "Auto-trigger requires TUBES_DIG2GO_PUSH_PRIME_MAC"
#endif

#if defined(TUBES_DIG2GO_READINESS_DELAY_TEST) && !TUBES_ENABLE_DIG2GO_PUSH_BRIDGE
#error "Readiness-delay test requires the Dig2Go push bridge"
#endif

#if defined(TUBES_DIG2GO_INSPECTION_ONLY_TEST) && !TUBES_ENABLE_DIG2GO_PUSH_BRIDGE
#error "Inspection-only test requires the Dig2Go push bridge"
#endif

#if TUBES_ENABLE_DIG2GO_PUSH_BRIDGE && !defined(TUBES_DIG2GO_DYNAMIC_ENROLLMENT) && !defined(TUBES_DIG2GO_PUSH_ENROLLED_MAC)
#error "Flag-on Dig2Go push builds require TUBES_DIG2GO_PUSH_ENROLLED_MAC as 12 hexadecimal digits"
#endif

#if defined(TUBES_DIG2GO_LEGACY_PULL_HOST) && !defined(TUBES_DIG2GO_DYNAMIC_ENROLLMENT) && !defined(TUBES_DIG2GO_PUSH_ENROLLED_DEVICE_ID)
#error "Legacy pull host requires the enrolled receiver DeviceId for a non-self-targeted fleet offer"
#endif

#if defined(TUBES_DIG2GO_LEGACY_BOOT_FALLBACK_TEST) \
    && (!defined(TUBES_DIG2GO_LEGACY_PULL_HOST) || !defined(TUBES_DIG2GO_DYNAMIC_ENROLLMENT))
#error "Legacy boot fallback test requires the legacy pull host and dynamic enrollment"
#endif

#if TUBES_ENABLE_DIG2GO_PUSH_BRIDGE && !defined(TUBES_DIG2GO_DYNAMIC_ENROLLMENT)
constexpr bool tubesDig2GoHex(char c) {
  return (c >= '0' && c <= '9') || (c >= 'A' && c <= 'F')
      || (c >= 'a' && c <= 'f');
}
constexpr bool tubesDig2GoEnrollmentIsValid(const char* value, int index = 0) {
  return !value ? false : (index == 12 ? value[index] == '\0'
      : tubesDig2GoHex(value[index]) && tubesDig2GoEnrollmentIsValid(value, index + 1));
}
static_assert(tubesDig2GoEnrollmentIsValid(TUBES_DIG2GO_PUSH_ENROLLED_MAC),
              "TUBES_DIG2GO_PUSH_ENROLLED_MAC must be exactly 12 hexadecimal digits");
#if defined(TUBES_DIG2GO_PUSH_PRIME_MAC)
static_assert(tubesDig2GoEnrollmentIsValid(TUBES_DIG2GO_PUSH_PRIME_MAC),
              "TUBES_DIG2GO_PUSH_PRIME_MAC must be exactly 12 hexadecimal digits");
#endif
#endif

#if TUBES_ENABLE_DIG2GO_PUSH_BRIDGE

#if defined(TUBES_DIG2GO_PUSH_AUTO_TRIGGER) && !TUBES_ENABLE_DIG2GO_PUSH_BRIDGE
#error "Auto-trigger requires the Dig2Go push bridge"
#endif

#include "dig2go_push_bridge.h"
#include "running_image_source.h"

namespace tubes_p2p {

// AI: below section was generated by an AI
enum Dig2GoSourceAdapterResult : uint8_t {
  Dig2GoSourceAdapterAccepted,
  Dig2GoSourceAdapterHttpFailed,
  Dig2GoSourceAdapterResponseTooLarge,
  Dig2GoSourceAdapterJsonInvalid,
  Dig2GoSourceAdapterIdentityRejected,
  Dig2GoSourceAdapterConfigurationRejected,
};

struct Dig2GoTargetAdmission {
  uint8_t enrolledMac[6] = {0};
  uint8_t legacyRelease = 0;
};

constexpr uint8_t DIG2GO_SELECTION_BROADCAST_ATTEMPTS = 8;
constexpr uint16_t DIG2GO_SELECTION_BROADCAST_INTERVAL_MS = 250;

// Test-only boot gate: readiness must be observed after the delay, and the
// callback is latched before invocation so failures and timeouts cannot retry.
class Dig2GoAutoTrigger {
public:
  explicit Dig2GoAutoTrigger(uint32_t delayMs = 15000) : _delayMs(delayMs) {}
  bool maybeStart(uint32_t now, bool meshReady, bool& attempted) {
    if (_attempted || attempted || !meshReady || static_cast<int32_t>(now - _bootAt) < static_cast<int32_t>(_delayMs)) return false;
    _attempted = true;
    attempted = true;
    return true;
  }
  void booted(uint32_t now) { _bootAt = now; _attempted = false; }
  bool attempted() const { return _attempted; }
private:
  uint32_t _bootAt = 0;
  uint32_t _delayMs;
  bool _attempted = false;
};

struct Dig2GoJsonFacts {
  uint8_t observedMac[6] = {0};
  bool selectedUpdateState = false;
  bool classicEsp32 = false;
  uint16_t ledTotal = 0;
  uint16_t outputLength = 0;
  uint8_t outputCount = 0;
  uint8_t pin = 0xFF;
  uint8_t type = 0;
  uint8_t order = 0xFF;
  uint8_t start = 0xFF;
  uint8_t skip = 0xFF;
  bool reversed = true;
};

inline bool admitDig2GoJsonFacts(
    const Dig2GoTargetAdmission& admission,
    const Dig2GoJsonFacts& facts
) {
  const bool knownLegacyImplicitBus = facts.outputCount == 0 && facts.ledTotal == 300;
  const bool explicitDig2GoBus = facts.outputCount == 1
      && (facts.ledTotal == 112 || facts.ledTotal == 150)
      && facts.outputLength == facts.ledTotal
      && facts.pin == 16 && facts.type == 22 && facts.order == 0
      && facts.start == 0 && facts.skip == 0 && !facts.reversed;
  return admission.legacyRelease == 13
      && memcmp(admission.enrolledMac, facts.observedMac, 6) == 0
      && facts.selectedUpdateState && facts.classicEsp32
      && (knownLegacyImplicitBus || explicitDig2GoBus);
}

inline bool useLegacyConfigFallback(int primaryStatus) {
  return primaryStatus == 404 || primaryStatus == 405;
}

class Dig2GoPushBridgeHooks {
public:
  virtual ~Dig2GoPushBridgeHooks() = default;
  virtual uint32_t now() const = 0;
  virtual bool sendLegacyV15Selection(const uint8_t targetMac[6]) = 0;
  virtual bool pauseTubesRadio() = 0;
  // Lease WLED's existing station owner; never call WiFi.begin here.
  virtual bool beginExclusiveWledJoin() = 0;
  virtual bool joinOwnerExclusive() const { return false; }
  virtual bool updateAccessPointConnected() const = 0;
  virtual bool updateAccessPointHasLocalIp() const { return updateAccessPointConnected(); }
  virtual bool updateAccessPointHasGateway() const { return updateAccessPointConnected(); }
  virtual bool probeUpdateAccessPointReachability() = 0;
  virtual Dig2GoSourceAdapterResult inspectSelectedTarget(
      const Dig2GoTargetAdmission& admission,
      LegacyDig2GoEvidence& evidence) = 0;
  virtual FirmwarePostResult uploadActiveImage() = 0;
  virtual bool restoreTubesRadio() = 0;
};

// Bounded, non-autonomous orchestration for exactly one operator-enrolled target.
// All exits after pause pass through restoration before exposing failure.
class Dig2GoPushBridgeRuntime {
public:
  explicit Dig2GoPushBridgeRuntime(Dig2GoPushBridgeHooks& hooks) : _hooks(hooks) {}

  bool joinPassed() const { return _joinPassed; }
  bool httpPassed() const { return _gatewayPassed; }
  Dig2GoSourceAdapterResult inspectionResult() const { return _inspectionResult; }

  bool arm(const uint8_t targetMac[6], uint32_t timeoutMs) {
    if (_state != PushBridgeIdle || !knownMac(targetMac) || timeoutMs == 0
        || timeoutMs > 0x7FFFFFFFU)
      return false;
    memcpy(_admission.enrolledMac, targetMac, 6);
    _admission.legacyRelease = 13;
    _deadline = _hooks.now() + timeoutMs;
    _state = PushBridgeTargetAdmitted;
    if (!_hooks.sendLegacyV15Selection(targetMac)) return fail(false);
#if defined(TUBES_DIG2GO_READINESS_DELAY_TEST)
    _readyAt = _hooks.now() + 5000;
    _state = PushBridgeReadinessDelay;
#endif
    return true;
  }

  void update() {
    if (_state == PushBridgeIdle || _state == PushBridgeHealthy || _state == PushBridgeFailed)
      return;
    if (!active()) { fail(_paused); return; }
#if defined(TUBES_DIG2GO_READINESS_DELAY_TEST)
    if (_state == PushBridgeReadinessDelay) {
      if (static_cast<int32_t>(_readyAt - _hooks.now()) > 0) return;
      _state = PushBridgeTargetAdmitted;
    }
#endif
    switch (_state) {
      case PushBridgeTargetAdmitted:
        if (!_hooks.pauseTubesRadio()) { fail(false); return; }
        _paused = true;
        _state = PushBridgeMeshPaused;
        if (!_hooks.beginExclusiveWledJoin()) fail(true);
        return;
      case PushBridgeMeshPaused:
        if (!_hooks.updateAccessPointConnected()) return;
        _joinPassed = true;
        _state = PushBridgeApJoined;
#if defined(TUBES_DIG2GO_READINESS_DELAY_TEST)
        _associated = true;
        _localIpPassed = _hooks.updateAccessPointHasLocalIp();
        _gatewayPassed = _hooks.updateAccessPointHasGateway();
        if (_localIpPassed && _gatewayPassed) {
          _joinPassed = true;
          _diagnosticSuccessPending = true;
          _state = PushBridgeRestoringMesh;
          restore(false);
        }
        return;
#elif defined(TUBES_DIG2GO_STEP3_DIAGNOSTIC)
        // Diagnostic compatibility path is intentionally not used by the test.
        _joinPassed = _hooks.updateAccessPointConnected();
        if (!_joinPassed) { fail(true); return; }
        _diagnosticSuccessPending = true;
        _state = PushBridgeRestoringMesh;
        restore(false);
        return;
#else
        _inspectionDeadline = _hooks.now() + 15000;
        _nextInspectionAt = _hooks.now();
        return;
#endif
      case PushBridgeApJoined:
#if !defined(TUBES_DIG2GO_READINESS_DELAY_TEST) && !defined(TUBES_DIG2GO_STEP3_DIAGNOSTIC)
        if (static_cast<int32_t>(_nextInspectionAt - _hooks.now()) > 0) return;
        _inspectionResult = _hooks.inspectSelectedTarget(_admission, _evidence);
        if (_inspectionResult == Dig2GoSourceAdapterHttpFailed
            && static_cast<int32_t>(_inspectionDeadline - _hooks.now()) > 0) {
          _nextInspectionAt = _hooks.now() + 1000;
          return;
        }
        if (_inspectionResult != Dig2GoSourceAdapterAccepted) { fail(true); return; }
        _gatewayPassed = true;
#if defined(TUBES_DIG2GO_INSPECTION_ONLY_TEST)
        _diagnosticSuccessPending = true;
        _state = PushBridgeRestoringMesh;
        restore(false);
        return;
#else
        _state = PushBridgeUploading;
        if (_hooks.uploadActiveImage() != FirmwarePostAccepted) { fail(true); return; }
        _uploadFinishedAt = _hooks.now();
        _state = PushBridgeRestoringMesh;
        restore(false);
        return;
#endif
#endif
        return;
      case PushBridgeRestoringMesh:
        restore(false);
        return;
      default:
        return;
    }
  }

  bool observeFreshV15Health(const uint8_t mac[6], uint32_t observedAt) {
    if (_state != PushBridgeAwaitingHealth || !mac
        || memcmp(mac, _admission.enrolledMac, 6) != 0
        || static_cast<int32_t>(observedAt - _uploadFinishedAt) <= 0
        || !active())
      return false;
    _state = PushBridgeHealthy;
    return true;
  }

  PushBridgeState state() const { return _state; }
  bool batonReady() const { return _state == PushBridgeHealthy; }
  PushBridgeOverlay overlay() const {
    if (_state == PushBridgeTargetAdmitted || _state == PushBridgeMeshPaused || _state == PushBridgeApJoined)
      return PushOverlayReady;
    if (_state == PushBridgeUploading || _state == PushBridgeRestoringMesh || _state == PushBridgeAwaitingHealth)
      return PushOverlayTransfer;
    if (_state == PushBridgeHealthy) return PushOverlayComplete;
    if (_state == PushBridgeFailed) return PushOverlayFailed;
    return PushOverlayNone;
  }

private:
  static bool knownMac(const uint8_t mac[6]) {
    if (!mac) return false;
    uint8_t combined = 0;
    for (size_t index = 0; index < 6; index++) combined |= mac[index];
    return combined != 0;
  }
  bool active() const { return static_cast<int32_t>(_deadline - _hooks.now()) > 0; }
  bool fail(bool restoreRequired) {
    if (restoreRequired) {
      _failurePending = true;
      _state = PushBridgeRestoringMesh;
      restore(true);
    } else {
      _state = PushBridgeFailed;
    }
    return false;
  }
  void restore(bool failed) {
    if (!_paused || _hooks.restoreTubesRadio()) {
      _paused = false;
      const bool finalFailure = failed || _failurePending;
      _failurePending = false;
      const bool diagnosticSuccess = _diagnosticSuccessPending;
      _diagnosticSuccessPending = false;
      _state = finalFailure ? PushBridgeFailed
          : diagnosticSuccess ? PushBridgeHealthy : PushBridgeAwaitingHealth;
    }
  }

  Dig2GoPushBridgeHooks& _hooks;
  Dig2GoTargetAdmission _admission;
  LegacyDig2GoEvidence _evidence;
  uint32_t _deadline = 0;
#if defined(TUBES_DIG2GO_READINESS_DELAY_TEST)
  uint32_t _readyAt = 0;
#endif
  uint32_t _uploadFinishedAt = 0;
#if !defined(TUBES_DIG2GO_READINESS_DELAY_TEST) && !defined(TUBES_DIG2GO_STEP3_DIAGNOSTIC)
  uint32_t _inspectionDeadline = 0;
  uint32_t _nextInspectionAt = 0;
#endif
  PushBridgeState _state = PushBridgeIdle;
  Dig2GoSourceAdapterResult _inspectionResult = Dig2GoSourceAdapterHttpFailed;
  bool _paused = false;
  bool _failurePending = false;
  bool _diagnosticSuccessPending = false;
  bool _joinPassed = false;
#if defined(TUBES_DIG2GO_READINESS_DELAY_TEST)
  bool _associated = false;
  bool _localIpPassed = false;
  bool _gatewayPassed = false;
#else
  bool _gatewayPassed = false;
#endif
};

// Performs the source-side HTTP operations after the owning controller has
// paused Tubes radio traffic and joined the selected receiver's update AP.
class Dig2GoPushSourceAdapter {
public:
  bool probeReachability();
  Dig2GoSourceAdapterResult inspectTarget(
      const Dig2GoTargetAdmission& admission,
      LegacyDig2GoEvidence& evidence
  );
  FirmwarePostResult uploadRunningImage(const FirmwareTargetContract& artifactTarget);

private:
  static constexpr size_t JSON_BODY_CAPACITY = 4096;
  bool fetchJson(const char* path, size_t& bodyLength);

  char _jsonBody[JSON_BODY_CAPACITY + 1] = {0};
  int _lastHttpStatus = 0;
};
// AI: end

} // namespace tubes_p2p

#endif
