#pragma once
#include "wled.h"
#include "timer.h"
#include "rubber_band_beat_clock.h"

#define DEFAULT_BPM  120

typedef uint32_t BeatFrame_24_8;  // 24:8 bitwise float

// Regulates the beat counter, running patterns at 256 "fracs" per beat
class BeatController {
  public:
    accum88 bpm = 0;
    BeatFrame_24_8 frac = 0;

  void setup()
  {
    // Starts in phrase 1
    reset(DEFAULT_BPM << 8, 0);
  }

  void update()
  {
    clock.advance(globalTimer.delta_micros);
    frac = clock.frame();
  }

  // AI: below section was generated by an AI
  // Selects a tempo and phase goal without moving the current beat frame. The
  // clock converges through bounded rate changes during later updates.
  void sync(accum88 b, BeatFrame_24_8 f) {
    if (b < 40<<8) return;

    accum88 last_bpm = bpm;
    if (!clock.setGoal(b, f)) return;
    bpm = clock.goalBpm();

    if (last_bpm != bpm)
      print_bpm();
  }

  // Changes the tempo goal while preserving the current phase.
  void set_bpm(accum88 b) {
    if (b < 40<<8) return;
    accum88 last_bpm = bpm;
    if (!clock.setTempoGoal(b)) return;
    bpm = clock.goalBpm();
    if (last_bpm != bpm)
      print_bpm();
  }

  void adjust_bpm(saccum78 b) {
    set_bpm(bpm + b);
  }

  // An explicit phrase restart is allowed to reposition the frame immediately.
  void start_phrase() {
    reset(bpm, frac & -0xFFF);
  }
  // AI: end

  void print_bpm() const {
    Serial.print(bpm >> 8);
    uint8_t frac = scale8(100, bpm & 0xFF);
    Serial.print(F("."));
    if (frac < 10)
      Serial.print(F("0"));
    Serial.print(frac);
    Serial.println(F("bpm"));
  }

  protected:
    RubberBandBeatClock clock;

    // Establishes the initial or explicitly reset clock state immediately.
    void reset(accum88 b, BeatFrame_24_8 f) {
      if (!clock.reset(b, f)) return;
      bpm = clock.goalBpm();
      frac = clock.frame();
    }
};
