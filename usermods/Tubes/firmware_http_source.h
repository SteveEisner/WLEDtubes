#pragma once

#include <limits.h>
#include <stddef.h>
#include <stdint.h>
#include <string.h>

#include "firmware_image_source.h"

// AI: below section was generated by an AI
enum FirmwareHttpMethod : uint8_t {
  FirmwareHttpMethodGet = 0,
  FirmwareHttpMethodHead,
};

// Host-testable response core for serving one immutable firmware artifact.
// The web-server adapter owns header emission and calls read() as its body
// producer; this class accepts only a single bounded HTTP byte range.
class FirmwareHttpSource {
public:
  explicit FirmwareHttpSource(FirmwareImageSource& source) : _source(source) {}

  bool begin(FirmwareHttpMethod method, const char* rangeHeader) {
    reset();
    if (!_source.inspect(_artifact) || _artifact.imageLengthBytes == 0) {
      _status = 503;
      return false;
    }

    _imageLength = _artifact.imageLengthBytes;
    _contentLength = _imageLength;
    if (rangeHeader && rangeHeader[0] != '\0') {
      if (!parseRange(rangeHeader, _imageLength, _contentOffset, _contentLength)) {
        _status = 416;
        _contentOffset = 0;
        _contentLength = 0;
        return false;
      }
      _status = 206;
    } else {
      _status = 200;
    }

    _headOnly = method == FirmwareHttpMethodHead;
    _ready = true;
    return true;
  }

  size_t read(uint8_t* destination, size_t capacity) {
    if (!_ready || _headOnly || _failed || !destination || capacity == 0)
      return 0;
    const size_t remaining = _contentLength - _bytesRead;
    if (remaining == 0)
      return 0;
    const size_t length = capacity < remaining ? capacity : remaining;
    if (!_source.read(_contentOffset + _bytesRead, destination, length)) {
      _failed = true;
      return 0;
    }
    _bytesRead += length;
    return length;
  }

  uint16_t status() const { return _status; }
  const FirmwareImageArtifact& artifact() const { return _artifact; }
  size_t imageLength() const { return _imageLength; }
  size_t contentOffset() const { return _contentOffset; }
  size_t contentLength() const { return _contentLength; }
  bool complete() const { return _ready && (_headOnly || _bytesRead == _contentLength); }
  bool failed() const { return _failed; }

private:
  static bool parseDecimal(const char*& cursor, const char* end, size_t& value) {
    if (cursor == end || *cursor < '0' || *cursor > '9')
      return false;
    value = 0;
    while (cursor != end && *cursor >= '0' && *cursor <= '9') {
      const size_t digit = static_cast<size_t>(*cursor - '0');
      if (value > (SIZE_MAX - digit) / 10)
        return false;
      value = value * 10 + digit;
      cursor++;
    }
    return true;
  }

  static bool parseRange(
      const char* header,
      size_t imageLength,
      size_t& offset,
      size_t& length
  ) {
    constexpr size_t MAX_RANGE_HEADER_LENGTH = 64;
    const size_t headerLength = strnlen(header, MAX_RANGE_HEADER_LENGTH + 1);
    if (headerLength == 0 || headerLength > MAX_RANGE_HEADER_LENGTH)
      return false;
    const char* cursor = header;
    const char* end = header + headerLength;
    constexpr char PREFIX[] = "bytes=";
    constexpr size_t PREFIX_LENGTH = sizeof(PREFIX) - 1;
    if (headerLength <= PREFIX_LENGTH || memcmp(cursor, PREFIX, PREFIX_LENGTH) != 0)
      return false;
    cursor += PREFIX_LENGTH;

    size_t first = 0;
    if (!parseDecimal(cursor, end, first) || cursor == end || *cursor != '-')
      return false;
    cursor++;
    size_t last = imageLength - 1;
    if (cursor != end && !parseDecimal(cursor, end, last))
      return false;
    if (cursor != end || first > last || last >= imageLength)
      return false;
    offset = first;
    length = last - first + 1;
    return true;
  }

  void reset() {
    _status = 500;
    _artifact = FirmwareImageArtifact();
    _imageLength = 0;
    _contentOffset = 0;
    _contentLength = 0;
    _bytesRead = 0;
    _ready = false;
    _headOnly = false;
    _failed = false;
  }

  FirmwareImageSource& _source;
  FirmwareImageArtifact _artifact;
  uint16_t _status = 500;
  size_t _imageLength = 0;
  size_t _contentOffset = 0;
  size_t _contentLength = 0;
  size_t _bytesRead = 0;
  bool _ready = false;
  bool _headOnly = false;
  bool _failed = false;
};
// AI: end
