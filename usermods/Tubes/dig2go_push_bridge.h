#pragma once

#include <stddef.h>
#include <stdint.h>
#include <string.h>

#include "firmware_image_source.h"
#include "firmware_update_session.h"

namespace tubes_p2p {

// AI: below section was generated by an AI
static constexpr char DIG2GO_UPDATE_SSID[] = "WLED-UPDATE";
static constexpr char DIG2GO_UPDATE_PASSWORD[] = "update1234";
static constexpr uint32_t DIG2GO_UPDATE_IPV4 = 0x04030201U; // 4.3.2.1 in network byte order.

struct LegacyDig2GoEvidence {
  uint8_t enrolledMac[6] = {0};
  uint8_t observedMac[6] = {0};
  uint8_t release = 0;
  uint8_t hardwareFamily = TubeHardwareUnknown;
  uint32_t apIpv4 = 0;
  const char* apSsid = nullptr;
  bool reportFresh = false;
  bool selectedForUpdate = false;
};

// Legacy JSON is normalized by the live adapter. Missing or ambiguous fields
// remain zero/false and therefore fail closed here before the receiver is written.
inline bool exactLegacyDig2GoUpdateTarget(const LegacyDig2GoEvidence& evidence) {
  uint8_t known = 0;
  for (uint8_t value : evidence.enrolledMac) known |= value;
  return known != 0
      && memcmp(evidence.enrolledMac, evidence.observedMac, sizeof(evidence.enrolledMac)) == 0
      && evidence.release == 13
      && evidence.hardwareFamily == TubeHardwareDig2Go
      && evidence.reportFresh
      && evidence.selectedForUpdate
      && evidence.apSsid
      && strcmp(evidence.apSsid, DIG2GO_UPDATE_SSID) == 0
      && evidence.apIpv4 == DIG2GO_UPDATE_IPV4;
}

enum PushBridgeState : uint8_t {
  PushBridgeIdle,
  PushBridgeTargetAdmitted,
#if defined(TUBES_DIG2GO_READINESS_DELAY_TEST)
  PushBridgeReadinessDelay,
#endif
  PushBridgeMeshPaused,
  PushBridgeApJoined,
  PushBridgeUploading,
  PushBridgeRestoringMesh,
  PushBridgeAwaitingHealth,
  PushBridgeHealthy,
  PushBridgeFailed,
};

enum PushBridgeOverlay : uint8_t {
  PushOverlayNone,
  PushOverlayReady,
  PushOverlayTransfer,
  PushOverlayComplete,
  PushOverlayFailed,
};

class PushBridgeHandoff {
public:
  bool admit(const LegacyDig2GoEvidence& evidence) {
    if (_state != PushBridgeIdle || !exactLegacyDig2GoUpdateTarget(evidence)) return false;
    _state = PushBridgeTargetAdmitted;
    return true;
  }
  bool meshPaused() { return advance(PushBridgeTargetAdmitted, PushBridgeMeshPaused); }
  bool apJoined() { return advance(PushBridgeMeshPaused, PushBridgeApJoined); }
  bool uploadStarted() { return advance(PushBridgeApJoined, PushBridgeUploading); }
  bool uploadFinished(bool accepted) {
    if (_state != PushBridgeUploading) return false;
    _state = accepted ? PushBridgeRestoringMesh : PushBridgeFailed;
    return accepted;
  }
  bool meshRestored() { return advance(PushBridgeRestoringMesh, PushBridgeAwaitingHealth); }
  bool healthFinished(bool healthy) {
    if (_state != PushBridgeAwaitingHealth) return false;
    _state = healthy ? PushBridgeHealthy : PushBridgeFailed;
    return healthy;
  }
  void fail() { _state = PushBridgeFailed; }
  PushBridgeState state() const { return _state; }
  // Scheduler callers may grant a propagation baton only after fresh new-boot
  // health has driven this handoff to Healthy.
  bool batonReady() const { return _state == PushBridgeHealthy; }
  PushBridgeOverlay overlay() const {
    if (_state == PushBridgeTargetAdmitted || _state == PushBridgeMeshPaused || _state == PushBridgeApJoined)
      return PushOverlayReady;
    if (_state == PushBridgeUploading || _state == PushBridgeRestoringMesh || _state == PushBridgeAwaitingHealth)
      return PushOverlayTransfer;
    if (_state == PushBridgeHealthy) return PushOverlayComplete;
    if (_state == PushBridgeFailed) return PushOverlayFailed;
    return PushOverlayNone;
  }
private:
  bool advance(PushBridgeState expected, PushBridgeState next) {
    if (_state != expected) return false;
    _state = next;
    return true;
  }
  PushBridgeState _state = PushBridgeIdle;
};

class FirmwarePostTransport {
public:
  virtual ~FirmwarePostTransport() = default;
  virtual bool begin(size_t contentLength, const char* contentType) = 0;
  virtual size_t write(const uint8_t* data, size_t length) = 0;
  virtual int finish() = 0;
};

enum FirmwarePostResult : uint8_t {
  FirmwarePostAccepted,
  FirmwarePostInvalidArtifact,
  FirmwarePostLengthOverflow,
  FirmwarePostBeginFailed,
  FirmwarePostShortWrite,
  FirmwarePostHttpRejected,
};

inline bool checkedAddSize(size_t& total, size_t value) {
  if (value > SIZE_MAX - total) return false;
  total += value;
  return true;
}

// Streams the immutable application image directly from its verified source;
// no slot-sized padding or merged-image components are included.
inline FirmwarePostResult postFirmwareMultipart(
    FirmwareImageSource& source,
    FirmwarePostTransport& transport,
    size_t chunkSize = 1024
) {
  static constexpr char BOUNDARY[] = "tubes-dig2go-v1";
  static constexpr char PREFIX[] =
      "--tubes-dig2go-v1\r\n"
      "Content-Disposition: form-data; name=\"update\"; filename=\"firmware.bin\"\r\n"
      "Content-Type: application/octet-stream\r\n\r\n";
  static constexpr char SUFFIX[] = "\r\n--tubes-dig2go-v1--\r\n";
  FirmwareImageArtifact artifact;
  if (chunkSize == 0 || !source.inspect(artifact) || artifact.imageLengthBytes == 0)
    return FirmwarePostInvalidArtifact;
  size_t contentLength = sizeof(PREFIX) - 1;
  if (!checkedAddSize(contentLength, artifact.imageLengthBytes)
      || !checkedAddSize(contentLength, sizeof(SUFFIX) - 1)) return FirmwarePostLengthOverflow;
  char contentType[64] = "multipart/form-data; boundary=";
  strncat(contentType, BOUNDARY, sizeof(contentType) - strlen(contentType) - 1);
  if (!transport.begin(contentLength, contentType)) return FirmwarePostBeginFailed;
  if (transport.write(reinterpret_cast<const uint8_t*>(PREFIX), sizeof(PREFIX) - 1) != sizeof(PREFIX) - 1)
    return FirmwarePostShortWrite;
  uint8_t buffer[1024];
  if (chunkSize > sizeof(buffer)) chunkSize = sizeof(buffer);
  size_t offset = 0;
  while (offset < artifact.imageLengthBytes) {
    const size_t remaining = artifact.imageLengthBytes - offset;
    const size_t length = remaining < chunkSize ? remaining : chunkSize;
    if (!source.read(offset, buffer, length) || transport.write(buffer, length) != length)
      return FirmwarePostShortWrite;
    offset += length;
  }
  if (transport.write(reinterpret_cast<const uint8_t*>(SUFFIX), sizeof(SUFFIX) - 1) != sizeof(SUFFIX) - 1)
    return FirmwarePostShortWrite;
  const int status = transport.finish();
  // safe_ota.py treats only WLED's normal 200 response as success.  Do not
  // broaden admission to arbitrary 2xx responses from another endpoint.
  return status == 200 ? FirmwarePostAccepted : FirmwarePostHttpRejected;
}
// AI: end

} // namespace tubes_p2p
