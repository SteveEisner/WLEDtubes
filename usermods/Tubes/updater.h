#pragma once

#include "wled.h"
#include <WiFi.h>
#include <WiFiClient.h>
#include <HTTPUpdate.h>
#include <Update.h>
#include "timer.h"
#include "device_report_protocol.h"
#include "fleet_update_protocol.h"
#include "modern_propagation_lease_storage.h"
#include "legacy_auto_update_wire.h"

#ifndef RELEASE_VERSION
#define RELEASE_VERSION 51
#endif

// AI: below section was generated by an AI
// The pull server reads this marker from the binary before authorizing a wave.
static const volatile FleetFirmwareIdentity fleetFirmwareIdentity __attribute__((used)) = {
    {'T', 'U', 'B', 'E', 'U', 'P', '1', '\0'},
    FLEET_UPDATE_PROTOCOL_VERSION,
    uint8_t(TUBES_HARDWARE_FAMILY),
    uint8_t(TUBES_FIRMWARE_VARIANT),
    RELEASE_VERSION,
    {0, 0, 0},
};
// AI: end

// Utility to extract header value from headers
String getHeaderValue(String header, String headerName) {
  return header.substring(strlen(headerName.c_str()));
}

typedef enum UpdateWorkflowStatus: uint8_t {
  Idle=0,
  Ready=10,
  Started=50,
  Connected=60,
  Received=80,
  Complete=100,
  Failed=101,
} UpdateWorkflowStatus;

typedef struct AutoUpdateOffer {
    int version = RELEASE_VERSION;
    char ssid[25] = "Fish Tank";
    char password[25] = "Fish Tank";
    IPAddress host = IPAddress(192,168,0,146);
} AutoUpdateOffer;


class AutoUpdater {
  public:
    AutoUpdateOffer current_version;

    // For now, hardcode it all
    String host_name = "brcac.com";
    String path = "/firmware.bin";
    int port = 80;

    long fileSize = 0;

    String _storedSSID = "";
    String _storedPass = "";
    String _storedAPSSID = "";
    String _storedAPPass = "";
    bool _storedOtaSameSubnet = true;
    bool _selectionOverridesActive = false;

    int progress = 0;

    WiFiClient _client;
    UpdateWorkflowStatus status = Idle;
    TubesTimer timeoutTimer;
    TubesTimer displayStatusTimer;

    // AI: below section was generated by an AI
    FleetUpdateOffer fleetOffer;
    bool fleetUpdateActive = false;
    uint32_t fleetStartsAt = 0;
    uint32_t fleetNetworkDeadline = 0;
    uint32_t lastFleetNonce = 0;
    bool fleetUsingOfferedNetwork = false;
    // AI: end

    void update() {
        // AI: below section was generated by an AI
        if (fleetUpdateActive) {
            updateFleetDownload();
            return;
        }
        // AI: end
        switch (this->status) {
            case Complete:
                if (this->displayStatusTimer.ended()) {
                    doReboot = true;
                    this->status = Idle;
                }
                return;

            case Failed:
                if (this->displayStatusTimer.ended())
                    this->status = Idle;
                return;

            case Ready:
            case Idle:
            case Received:
                return;

            case Started:
                this->do_connect();
                return;

            case Connected:
                this->do_request();
                return;
        }
    }

    void start(AutoUpdateOffer *new_version = nullptr) {
        if (this->status != Idle) {
            log("update already in progress.");
            return;
        }

        if (new_version && new_version->version <= current_version.version) {
            log("don't need to update to that version.");
            return;
        }

        // The auto-update process might break the current connection
        _storedSSID = String(multiWiFi[0].clientSSID);
        _storedPass = String(multiWiFi[0].clientPass);
        _storedAPSSID = String(apSSID);
        _storedAPPass = String(apPass);
#if WLED_WATCHDOG_TIMEOUT > 0
        WLED::instance().disableWatchdog();
#endif
        otaLock = false;
        if (new_version) {
            memcpy((byte*)&this->current_version, new_version, sizeof(this->current_version));
        }
        log("starting autoupdate");
        this->status = Started;
        this->displayStatusTimer.stop();
    }

    // AI: below section was generated by an AI
    // Schedules one integrity-checked pull from the installation LAN. The offer
    // changes neither stored Wi-Fi credentials nor the selected-device AP state.
    bool startFleet(const FleetUpdateOffer& offer) {
        const bool identityValid = fleetFirmwareIdentity.tubesVersion == RELEASE_VERSION;
        const bool offerValid = isValidFleetUpdateOffer(offer);
        const bool idle = status == Idle;
        const bool freshNonce = offer.nonce != lastFleetNonce;
        const bool releaseAccepted = (offer.flags & FleetUpdateForce)
            || offer.tubesVersion > RELEASE_VERSION;
        if (!identityValid || !offerValid || !idle || !freshNonce || !releaseAccepted) {
            Serial.printf("FLEET_OTA reject identity=%u offer=%u idle=%u nonce=%u release=%u current=%u offered=%u\n",
                identityValid, offerValid, idle, freshNonce, releaseAccepted,
                RELEASE_VERSION, offer.tubesVersion);
            return false;
        }

        uint8_t deviceMac[6];
        WiFi.macAddress(deviceMac);
        _storedSSID = String(multiWiFi[0].clientSSID);
        _storedPass = String(multiWiFi[0].clientPass);
        _storedAPSSID = String(apSSID);
        _storedAPPass = String(apPass);
        fleetUsingOfferedNetwork = false;
        // Offered credentials live only in RAM. A successful reboot reloads the
        // stored profile; failure restores the original strings explicitly.
        if (offer.ssidLength) {
            char offeredSSID[FLEET_UPDATE_CREDENTIAL_BYTES + 1] = {0};
            char offeredPassword[FLEET_UPDATE_CREDENTIAL_BYTES + 1] = {0};
            memcpy(offeredSSID, offer.credentials, offer.ssidLength);
            memcpy(
                offeredPassword,
                offer.credentials + offer.ssidLength,
                offer.passwordLength
            );
            strlcpy(multiWiFi[0].clientSSID, offeredSSID, sizeof(multiWiFi[0].clientSSID));
            strlcpy(multiWiFi[0].clientPass, offeredPassword, sizeof(multiWiFi[0].clientPass));
            memset(offeredPassword, 0, sizeof(offeredPassword));
            fleetUsingOfferedNetwork = true;
        }
        // WLED normally leaves station association idle while ESP-NOW owns the radio.
        // Trigger its normal reconnect path for both offered and already-stored profiles.
        WiFi.disconnect(false, true);
        fleetOffer = offer;
        lastFleetNonce = offer.nonce;
        fleetStartsAt = millis() + fleetUpdateStartDelay(offer, deviceMac);
        fleetNetworkDeadline = fleetStartsAt + 60000;
        fleetUpdateActive = true;
        status = Started;
        displayStatusTimer.stop();
        Serial.printf(
            "FLEET_OTA scheduled nonce=%08lX delay=%lu target=%u\n",
            (unsigned long)offer.nonce,
            (unsigned long)(fleetStartsAt - millis()),
            offer.tubesVersion
        );
        return true;
    }
    // AI: end

    void ready() {
        if (this->status == Ready)
            return;
        _storedSSID = String(multiWiFi[0].clientSSID);
        _storedPass = String(multiWiFi[0].clientPass);
        _storedAPSSID = String(apSSID);
        _storedAPPass = String(apPass);
        _storedOtaSameSubnet = otaSameSubnet;
        _selectionOverridesActive = true;
        log("ready for update - turning on updater AP");
        // AI: below section was generated by an AI
        // The selected AP is intentionally outside the station subnet. Permit
        // OTA from that local AP only while the physical selection is active.
        otaSameSubnet = false;
        // AI: end
        strcpy(apSSID, "WLED-UPDATE");
        strcpy(apPass, "update1234");
        auto tmp = apBehavior;
        apBehavior = AP_BEHAVIOR_ALWAYS;
        WLED::instance().initAP();
        apBehavior = tmp;
        this->status = Ready;
    }

    void stop() {
        if (this->status == Idle && !_selectionOverridesActive)
            return;
        this->_client.stop();
        // AI: below section was generated by an AI
        fleetUpdateActive = false;
        fleetUsingOfferedNetwork = false;
        memset(fleetOffer.credentials, 0, sizeof(fleetOffer.credentials));
        // AI: end
        strcpy(multiWiFi[0].clientSSID, _storedSSID.c_str());
        strcpy(multiWiFi[0].clientPass, _storedPass.c_str());
        strcpy(apSSID, _storedAPSSID.c_str());
        strcpy(apPass, _storedAPPass.c_str());
        if (_selectionOverridesActive) {
            otaSameSubnet = _storedOtaSameSubnet;
            _selectionOverridesActive = false;
        }
        WiFi.softAPdisconnect(true);
        apActive = false;
        // AI: below section was generated by an AI
        // AP_START stops ESP-NOW. Cycling back through STA mode produces the
        // STA_START event that restarts the mesh after selection is canceled.
        WiFi.mode(WIFI_OFF);
        WiFi.mode(WIFI_STA);
        WiFi.disconnect(false, true);
        // AI: end
#if WLED_WATCHDOG_TIMEOUT > 0
        WLED::instance().enableWatchdog();
#endif
        this->status = Idle;
    }

    void handleOverlayDraw() {
        CRGB c;
        switch (this->status) {
            case Ready:
                // Once the updater connects, no need to show ready
                if (WiFi.softAPgetStationNum())
                    return;
                c = CRGB::Purple;
                break;

            case Started:
            case Connected:
            case Received:
                c = CRGB::Yellow;
                if (millis() % 1000 < 500) {
                    c = CRGB::Black;
                }
                break;

            case Failed:
                c = CRGB::Red;
                break;

            case Complete:
                c = CRGB::Green;
                break;

            case Idle:
            default:
                return;
        }
        for (int i = 0; i < 10; i++) {
            strip.setPixelColor(i, c);
        }
    }

  private:
    void log(const char *message) {
        Serial.printf("OTA: %s\n", message);
    }

    void log(String message) {
        log(message.c_str());
    }

    void abort(const char *message) {
        log(message);
        this->stop();
        this->status = Failed;
        this->displayStatusTimer.start(30000);
    }

    // AI: below section was generated by an AI
    // Downloads the board-specific image from a trusted local server. HTTPUpdate
    // requires `x-MD5` and exact content length before it activates the OTA slot.
    void updateFleetDownload() {
        int32_t untilStart = int32_t(fleetStartsAt - millis());
        if (untilStart > 0)
            return;
        if (WiFi.status() != WL_CONNECTED) {
            if (int32_t(fleetNetworkDeadline - millis()) > 0)
                return;
            failFleetDownload("configured Wi-Fi did not connect");
            return;
        }

        uint8_t deviceMac[6];
        WiFi.macAddress(deviceMac);
        char path[192];
        snprintf(
            path,
            sizeof(path),
            "/tubes/firmware.bin?nonce=%08lX&release=%u&family=%u&variant=%u&mac=%02x%02x%02x%02x%02x%02x",
            (unsigned long)fleetOffer.nonce,
            fleetOffer.tubesVersion,
            uint8_t(TUBES_HARDWARE_FAMILY),
            uint8_t(TUBES_FIRMWARE_VARIANT),
            deviceMac[0], deviceMac[1], deviceMac[2],
            deviceMac[3], deviceMac[4], deviceMac[5]
        );
        IPAddress host(
            fleetOffer.serverAddress[0],
            fleetOffer.serverAddress[1],
            fleetOffer.serverAddress[2],
            fleetOffer.serverAddress[3]
        );
        Serial.printf("FLEET_OTA downloading http://%s:%u%s\n",
            host.toString().c_str(), fleetOffer.serverPort, path);

#if WLED_WATCHDOG_TIMEOUT > 0
        WLED::instance().disableWatchdog();
#endif
        HTTPUpdate fleetHttpUpdate(20000);
        fleetHttpUpdate.rebootOnUpdate(false);
        t_httpUpdate_return result = fleetHttpUpdate.update(
            _client,
            host.toString(),
            fleetOffer.serverPort,
            path,
            String(RELEASE_VERSION)
        );
        _client.stop();
        if (result != HTTP_UPDATE_OK) {
            String error = fleetHttpUpdate.getLastErrorString();
            failFleetDownload(error.c_str());
            return;
        }

        if (shouldArmModernPropagationLease(fleetOffer, RELEASE_VERSION)) {
            const ModernPropagationLeaseRecord lease =
                makeModernPropagationLease(fleetOffer);
            if (!writeModernPropagationLease(lease)) {
                // HTTPUpdate has already verified the body and selected the
                // next boot partition. Propagation is additive; failure to arm
                // it must not misreport or strand an otherwise valid OTA.
                Serial.println(F("FLEET_PROPAGATION disabled: lease persistence failed"));
            } else {
                Serial.printf("FLEET_PROPAGATION armed release=%u source=%08lX\n",
                    lease.tubesVersion, (unsigned long)lease.sourceNonce);
            }
        }

        Serial.println(F("FLEET_OTA complete; rebooting"));
        memset(fleetOffer.credentials, 0, sizeof(fleetOffer.credentials));
        fleetUpdateActive = false;
        status = Complete;
        displayStatusTimer.start(1500);
    }

    void failFleetDownload(const char *message) {
        Serial.printf("FLEET_OTA failed: %s\n", message);
        _client.stop();
#if WLED_WATCHDOG_TIMEOUT > 0
        WLED::instance().enableWatchdog();
#endif
        if (fleetUsingOfferedNetwork) {
            strlcpy(multiWiFi[0].clientSSID, _storedSSID.c_str(), sizeof(multiWiFi[0].clientSSID));
            strlcpy(multiWiFi[0].clientPass, _storedPass.c_str(), sizeof(multiWiFi[0].clientPass));
            WiFi.disconnect(false, true);
            fleetUsingOfferedNetwork = false;
        }
        memset(fleetOffer.credentials, 0, sizeof(fleetOffer.credentials));
        fleetUpdateActive = false;
        status = Failed;
        // A fanout host intentionally retires after two complete bodies. A
        // third receiver may already have joined that AP and receive a 403 as
        // the second slot closes. Keep the failure visible briefly, then make
        // the receiver eligible for a newly migrated peer's distinct offer.
        // The nonce guard still prevents it from retrying the retired host.
        displayStatusTimer.start(1500);
    }
    // AI: end

    void do_connect() {
        auto s = WiFi.status();
        switch (s) {
            case WL_DISCONNECTED:
                if (!strlen(multiWiFi[0].clientSSID)) {
                    log("connecting to autoupdate server");
                    strcpy(multiWiFi[0].clientSSID, this->current_version.ssid);
                    strcpy(multiWiFi[0].clientPass, this->current_version.password);
                }
                return;

            case WL_NO_SSID_AVAIL:
                abort("Invalid auto-update SSID");
                return;

            case WL_CONNECT_FAILED:
                abort("Invalid auto-update password");
                return;

            case WL_CONNECTED:
                if (WiFi.SSID() != String(this->current_version.ssid)) {
                    log("disconnecting from WiFi");
                    WiFi.softAPdisconnect(true);
                    WiFi.disconnect(false, true);
                    apBehavior = AP_BEHAVIOR_BUTTON_ONLY;
                    return;
                }

                log("WiFi connected");
                this->status = Connected;
                return;

            case WL_IDLE_STATUS:
                EVERY_N_MILLIS(300) {
                    Serial.print("...");
                }
                break;

            default:
                Serial.printf("OTA: wifi %d", (int)s);
                break;
        }
    }

    void do_request() {
#if WLED_WATCHDOG_TIMEOUT > 0
        WLED::instance().disableWatchdog();
#endif
        log("connecting");
        if (!this->_client.connect(this->host_name.c_str(), this->port)) { //  this->current_version.host
            abort("connect failed");
            return;
        }

        // Get the contents of the bin file
        log("requesting update package");
        auto request = String("GET ") + this->path + " HTTP/1.1\r\n" +
            "Host: " + this->host_name + "\r\n" +
            "Cache-Control: no-cache\r\n\r\n";
        Serial.println(request);
        this->_client.print(request);

        log("awaiting response");
        timeoutTimer.start(5000);
        while (!this->_client.available()) {
            vTaskDelay( 400 );
            if (timeoutTimer.ended()) {
                abort("timed out waiting for response");
                return;
            }
            log("waiting...");
        }

        String contentType = "";

        log("reading response");
        while (this->_client.available()) {
            // read line till /n - if the line is empty, it's the end of the headers.
            String line = this->_client.readStringUntil('\n');
            line.trim();
            if (!line.length()) break;

            // Check if the HTTP Response is 200
            if (line.startsWith("HTTP/")) {
                if (line.indexOf("200") < 0) {
                    abort(line.c_str());
                    return;
                }
            }

            // Read the file size from Content-Length
            if (line.startsWith("Content-Length: ")) {
                fileSize = atol((getHeaderValue(line, "Content-Length: ")).c_str());
                log(line.c_str());
            }

            // Read the content type from Content-Type
            if (line.startsWith("Content-Type: ")) {
                contentType = getHeaderValue(line, "Content-Type: ");
                log(line.c_str());
            }
            if (line.startsWith("Content-type: ")) {
                contentType = getHeaderValue(line, "Content-type: ");
                log(line.c_str());
            }

        }

        if (fileSize == 0 || contentType != "application/octet-stream") {
            abort("Must get a valid Content-Type and Content-Length header.");
            return;
        }

        log("found a valid OTA BIN");

        this->status = Received;
        this->do_update(this->_client);
    }

    void do_update(WiFiClient client) {
        if (!Update.begin(fileSize)) {
            abort("no room for the update");
            return;
        };

#if WLED_WATCHDOG_TIMEOUT > 0
        WLED::instance().disableWatchdog();
#endif
        this->progress = 0;
        vTaskDelay(500);
        uint8_t buf[4096];
        uint32_t streamDeadline = millis() + 20000;
        while (this->progress < fileSize) {
            const int lr = client.read(buf, min(sizeof(buf), size_t(fileSize - this->progress)));
            if (lr <= 0) {
                // An empty read is ordinary TCP backpressure, especially when a
                // Dig2Go host is feeding two receivers. It is not end-of-file;
                // Content-Length is the authoritative completion boundary.
                if ((!client.connected() && !client.available())
                    || static_cast<int32_t>(millis() - streamDeadline) >= 0) {
                    Update.abort();
                    abort("firmware stream ended before Content-Length");
                    return;
                }
                vTaskDelay(10);
                continue;
            }
            const size_t written = Update.write(buf, size_t(lr));
            if (written != size_t(lr)) {
                Update.abort();
                abort("firmware flash write was incomplete");
                return;
            }

            this->progress += written;
            streamDeadline = millis() + 20000;
            Serial.printf(" %d of %ld\n", this->progress, fileSize);

            // Give the server time to send some more data
            if (!client.available())
                vTaskDelay(100);
        }

        if (!Update.end()) {
            Serial.println("Error #: " + String(Update.getError()));
            abort("Error during streaming");
            return;
        }

        if (!Update.isFinished()) {
            abort("Error during finishing");
            return;
        }

        log("update successfully completed. Rebooting.");
        this->stop();
        this->status = Complete;
        this->displayStatusTimer.start(10000);
    }

};
