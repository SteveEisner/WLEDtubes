#pragma once

#include "controller.h"
#include "node.h"
#include "wled.h"

std::string formatted_time(long ms) {
  long secs = ms / 1000; // set the seconds remaining
  long mins = secs / 60; //convert seconds to minutes
  long hours = mins / 60; //convert minutes to hours
  long days = hours / 24; //convert hours to days

  secs = secs % 60;
  mins = mins % 60;
  hours = hours % 24;

  char buffer[100];
  if (days > 0)
    sprintf(buffer, "%ld %02ld:%02ld:%02ld", days, hours, mins, secs);
  else
    sprintf(buffer, "%02ld:%02ld:%02ld", hours, mins, secs);
  return std::string(buffer);
}

class DebugController {
  public:
    const PatternController& controller;
    uint32_t lastPhraseTime;
    uint32_t lastFrame;
    // AI: below section was generated by an AI
    static constexpr uint8_t RENDER_SAMPLE_COUNT = 16;
    CRGB customRenderSamples[RENDER_SAMPLE_COUNT];
    CRGB wledRenderSamples[RENDER_SAMPLE_COUNT];
    CRGB previousFinalSamples[RENDER_SAMPLE_COUNT];
    uint32_t lastRenderReportAt = 0;
    uint16_t maximumRenderDelta = 0;
    uint16_t blackRenderFrames = 0;
    uint16_t snapRenderFrames = 0;
    uint16_t capturedWledFader = 0;
    bool haveRenderInputs = false;
    bool havePreviousFinalSamples = false;
    uint8_t quietHeartbeatDots = 0;
    uint32_t lastSoundTraceAt = 0;
    // AI: end

  DebugController(const PatternController& c) : controller(c) {}

  void setup()
  {
    lastPhraseTime = globalTimer.now_micros;
    lastFrame = (uint32_t)-1;
    // AI: below section was generated by an AI
    lastRenderReportAt = millis();
    // AI: end
  }

  void update()
  {
    if (!controller.node.serialTraceEnabled()) {
      // AI: below section was generated by an AI
      // A tiny idle heartbeat proves serial liveness without building verbose messages.
      EVERY_N_MILLISECONDS( 1000 ) {
        Serial.print('.');
        if (++quietHeartbeatDots >= 50) {
          Serial.println(F(" [press enter]"));
          quietHeartbeatDots = 0;
        }
      }
      // AI: end
      return;
    }

    // AI: below section was generated by an AI
    if (millis() - lastSoundTraceAt >= 500) {
      lastSoundTraceAt = millis();
      traceSoundLayer();
    }
    // AI: end

    EVERY_N_MILLISECONDS( 10000 ) {
      // Dump internal status
      auto knownSsid = apActive ? WiFi.softAPSSID() : WiFi.SSID();
      auto knownIp = apActive ? IPAddress(4, 3, 2, 1) : WiFi.localIP();
      Serial.printf("\n=== %s%s    WiFi[ch%d] %s IP: %u.%u.%u.%u   Free memory: %d  space: %u/%u  Uptime: %s\n",
        controller.node.node_name,
        controller.node.status_code(),
        WiFi.channel(),
        knownSsid.c_str(),
        knownIp[0],
        knownIp[1],
        knownIp[2],
        knownIp[3],
        freeMemory(),
        WLED_FS.usedBytes(),
        WLED_FS.totalBytes(),
        formatted_time(millis()).c_str()
      );

      Serial.printf("=== Controller: ");
      if (controller.isMasterRole()) {
        Serial.print("PRIMARY ");
      }
      if (controller.sound.active) {
        Serial.print("SOUND ");
      }
      if (controller.node.isLeading()) {
        Serial.print("LEADING ");
      }
      if (controller.node.isFollowing()) {
        Serial.print("FOLLLOWING ");
      }
      Serial.printf("role=%d power_save=%d\n",
        controller.role,
        controller.power_save
      );

      // Dump WLED status
      char mode_name[50];
      char palette_name[50];
      auto seg = strip.getMainSegment();
      extractModeName(seg.mode, JSON_mode_names, mode_name, 50);
      extractModeName(seg.palette, JSON_palette_names, palette_name, 50);
      Serial.printf("=== WLED: %d LEDs, buses:%u segs:%u main:%u-%u/%u bri:%u/%u/%u abl:%u/%u/%u, %s(%u) %s(%u) speed:%u intensity:%u",
        strip.getLengthTotal(),
        BusManager::getNumBusses(),
        strip.getSegmentsNum(),
        seg.start,
        seg.stop,
        seg.length(),
        bri,
        briT,
        briLast,
        BusManager::currentMilliamps(),
        BusManager::ablMilliampsMax(),
        BusManager::isABLActive(),
        mode_name,
        seg.mode,
        palette_name,
        seg.palette,
        seg.speed,
        seg.intensity
      );
      if (controller.patternOverride) {
        Serial.printf(" (PATTERN %d)", controller.patternOverride);
      } else {
        Serial.printf(" at %d", controller.wled_fader);
      }
      if (controller.paletteOverride) {
        Serial.printf(" (PALETTE %d)", controller.paletteOverride);
      }
      Serial.println();

      // AI: below section was generated by an AI
      // Report the reserved sound layer independently so live tests can verify both effects.
      if (strip.getSegmentsNum() > PatternController::SOUND_OVERLAY_SEGMENT_ID) {
        const Segment& soundSegment = strip.getSegment(PatternController::SOUND_OVERLAY_SEGMENT_ID);
        char soundModeName[50];
        extractModeName(soundSegment.mode, JSON_mode_names, soundModeName, sizeof(soundModeName));
        Serial.printf(
            "=== SOUND_LAYER: base=%s active=%u on=%u range=%u-%u/%u group=%u+%u opacity=%u mode=%s(%u) blend=%u\n",
            controller.isShowingWled() ? "WLED" : "Tubes",
            soundSegment.isActive(),
            soundSegment.on,
            soundSegment.start,
            soundSegment.stop,
            soundSegment.length(),
            soundSegment.grouping,
            soundSegment.spacing,
            soundSegment.opacity,
            soundModeName,
            soundSegment.mode,
            soundSegment.blendMode
        );
      }
      // AI: end

      Serial.printf("=== firmware: v%d "
#ifdef TUBES_AUTOUPDATER
        "from SSID %s %u.%u.%u.%u "
#endif
        "OTA=%d\n\n",
        controller.updater.current_version.version,
#ifdef TUBES_AUTOUPDATER
        controller.updater.current_version.ssid,
        controller.updater.current_version.host[0],
        controller.updater.current_version.ssid[1],
        controller.updater.current_version.ssid[2],
        controller.updater.current_version.ssid[3],
#endif
        controller.updater.status
      );
    }
  }

  // AI: below section was generated by an AI
  // Correlates microphone input, peak detection, and the private segment-1 render buffer.
  void traceSoundLayer() const {
    if (!controller.sound.overlay && !controller.sound.tempoTracking)
      return;

    if (controller.sound.tempoTracking) {
      const TempoDiagnostics& tempo = controller.sound.tempoDiagnostics();
      Serial.printf(
          "TEMPO_TRACE audio=%u locked=%u bpm=%.2f confidence=%u owner=%u pll=%u error=%dms events=%u "
          "input=%u/%u freq=%.1f fftPeak=%u:%u fft=%lu/%luus onset=%lu/%lums "
          "corr=%.2f held=%.2f/%u challenger=%.2f/%u/%u flux=%u/%u/%u\n",
          controller.sound.active,
          controller.sound.tempoLocked,
          controller.sound.tempoBpmQ8 / 256.0f,
          controller.sound.tempoConfidence,
          controller.sound.isLocalBeatAuthority(),
          controller.sound.tempoPhaseTracked,
          controller.sound.tempoPhaseErrorMs,
          controller.sound.tempoTimingEvents,
          controller.sound.volume,
          controller.sound.volumeRaw,
          controller.sound.majorFrequency,
          controller.sound.strongestBin,
          controller.sound.strongestBinLevel,
          static_cast<unsigned long>(tempo.spectrumFrames),
          static_cast<unsigned long>(tempo.lastSpectrumIntervalUs),
          static_cast<unsigned long>(tempo.onsetCandidates),
          static_cast<unsigned long>(tempo.lastOnsetIntervalUs / 1000U),
          tempo.correlationBpmQ8 / 256.0f,
          tempo.heldBpmQ8 / 256.0f,
          tempo.heldTimingFit,
          tempo.challengerBpmQ8 / 256.0f,
          tempo.challengerScans,
          tempo.challengerTimingFit,
          tempo.kickFlux,
          tempo.snareFlux,
          tempo.broadFlux
      );
    }
    if (!controller.sound.overlay)
      return;

    if (!controller.sound.programActive
        || strip.getSegmentsNum() <= PatternController::SOUND_OVERLAY_SEGMENT_ID) {
      Serial.printf(
          "SOUND_TRACE audio=%u smooth=%u raw=%u peak=%u peaks=%u freq=%.1f mag=%.1f "
          "fft=%u:%u accent=%u/%u/%u layer=internal\n",
          controller.sound.active,
          controller.sound.volume,
          controller.sound.volumeRaw,
          controller.sound.samplePeak,
          controller.sound.samplePeakCount,
          controller.sound.majorFrequency,
          controller.sound.magnitude,
          controller.sound.strongestBin,
          controller.sound.strongestBinLevel,
          controller.sound.kickStrength,
          controller.sound.snareStrength,
          controller.sound.musicStrength
      );
      return;
    }

    const Segment& segment = strip.getSegment(PatternController::SOUND_OVERLAY_SEGMENT_ID);
    uint16_t litPixels = 0;
    uint8_t maximum = 0;
    uint32_t brightnessSum = 0;
    for (uint16_t pixel = 0; pixel < segment.length(); pixel++) {
      uint32_t color = segment.getPixelColor(pixel);
      uint8_t brightness = max(max(R(color), G(color)), max(B(color), W(color)));
      if (brightness)
        litPixels++;
      maximum = max(maximum, brightness);
      brightnessSum += brightness;
    }

    Serial.printf(
        "SOUND_TRACE audio=%u smooth=%u raw=%u peak=%u peaks=%u freq=%.1f mag=%.1f "
        "fft=%u:%u accent=%u/%u/%u seg=%u-%u/%u opacity=%u on=%u call=%u lit=%u max=%u avg=%u\n",
        controller.sound.active,
        controller.sound.volume,
        controller.sound.volumeRaw,
        controller.sound.samplePeak,
        controller.sound.samplePeakCount,
        controller.sound.majorFrequency,
        controller.sound.magnitude,
        controller.sound.strongestBin,
        controller.sound.strongestBinLevel,
        controller.sound.kickStrength,
        controller.sound.snareStrength,
        controller.sound.musicStrength,
        segment.start,
        segment.stop,
        segment.length(),
        segment.opacity,
        segment.on,
        segment.call,
        litPixels,
        maximum,
        segment.length() ? brightnessSum / segment.length() : 0
    );
  }
  // AI: end

  // AI: below section was generated by an AI
  // Samples both sides of the Tubes/WLED crossfade before the final pixel buffer is overwritten.
  void captureRenderInputs()
  {
    if (!controller.node.serialTraceEnabled()) {
      haveRenderInputs = false;
      havePreviousFinalSamples = false;
      return;
    }

    uint16_t length = strip.getLengthTotal();
    if (length == 0) {
      haveRenderInputs = false;
      return;
    }

    capturedWledFader = controller.patternOverride ? UINT16_MAX : controller.wled_fader;
    for (uint8_t sample = 0; sample < RENDER_SAMPLE_COUNT; sample++) {
      uint16_t position = uint32_t(sample) * (length - 1) / (RENDER_SAMPLE_COUNT - 1);
      customRenderSamples[sample] = controller.getBlendedPixelColor(position);
      wledRenderSamples[sample] = strip.getPixelColor(position);
    }
    haveRenderInputs = true;
  }

  // Returns the mean RGB channel value, keeping reports comparable across different strip lengths.
  static uint8_t renderMean(const CRGB samples[RENDER_SAMPLE_COUNT])
  {
    uint16_t total = 0;
    for (uint8_t sample = 0; sample < RENDER_SAMPLE_COUNT; sample++) {
      total += samples[sample].r;
      total += samples[sample].g;
      total += samples[sample].b;
    }
    return total / (RENDER_SAMPLE_COUNT * 3);
  }

  // Observes the final logical pixel buffer and emits compact reports without logging every frame.
  void observeRenderedOutput()
  {
    if (!haveRenderInputs || !controller.node.serialTraceEnabled())
      return;

    uint16_t length = strip.getLengthTotal();
    if (length == 0)
      return;

    CRGB finalSamples[RENDER_SAMPLE_COUNT];
    uint16_t frameDelta = 0;
    for (uint8_t sample = 0; sample < RENDER_SAMPLE_COUNT; sample++) {
      uint16_t position = uint32_t(sample) * (length - 1) / (RENDER_SAMPLE_COUNT - 1);
      CRGB color = strip.getPixelColor(position);
      finalSamples[sample] = color;
      if (havePreviousFinalSamples) {
        frameDelta += abs(int(color.r) - int(previousFinalSamples[sample].r));
        frameDelta += abs(int(color.g) - int(previousFinalSamples[sample].g));
        frameDelta += abs(int(color.b) - int(previousFinalSamples[sample].b));
      }
      previousFinalSamples[sample] = color;
    }

    if (havePreviousFinalSamples)
      frameDelta /= RENDER_SAMPLE_COUNT * 3;
    havePreviousFinalSamples = true;
    maximumRenderDelta = max(maximumRenderDelta, frameDelta);

    uint16_t litPixels = 0;
    uint32_t redSum = 0;
    uint32_t greenSum = 0;
    uint32_t blueSum = 0;
    uint32_t luminanceSum = 0;
    uint8_t maximumLuminance = 0;
    uint8_t minimumRed = UINT8_MAX;
    uint8_t minimumGreen = UINT8_MAX;
    uint8_t minimumBlue = UINT8_MAX;
    uint8_t maximumRed = 0;
    uint8_t maximumGreen = 0;
    uint8_t maximumBlue = 0;
    for (uint16_t position = 0; position < length; position++) {
      CRGB color = strip.getPixelColor(position);
      if (color.r || color.g || color.b)
        litPixels++;
      redSum += color.r;
      greenSum += color.g;
      blueSum += color.b;
      minimumRed = min(minimumRed, color.r);
      minimumGreen = min(minimumGreen, color.g);
      minimumBlue = min(minimumBlue, color.b);
      maximumRed = max(maximumRed, color.r);
      maximumGreen = max(maximumGreen, color.g);
      maximumBlue = max(maximumBlue, color.b);
      uint8_t luminance = uint16_t(54 * color.r + 183 * color.g + 19 * color.b + 128) >> 8;
      luminanceSum += luminance;
      maximumLuminance = max(maximumLuminance, luminance);
    }
    if (litPixels == 0)
      blackRenderFrames++;

    bool activeFade = false;
    for (uint8_t layer = 0; layer < NUM_VSTRIPS; layer++) {
      VirtualStripFade fade = controller.vstrips[layer]->fade;
      activeFade |= fade == FadeIn || fade == FadeOut;
    }
    if (activeFade && frameDelta >= 80)
      snapRenderFrames++;

    uint32_t now = millis();
    uint16_t reportPeriod = activeFade ? 250 : 1000;
    if (now - lastRenderReportAt < reportPeriod)
      return;
    lastRenderReportAt = now;

    Serial.printf("RENDER t=%lu id=%04X state=%u/%u frame=%lu fade=%u src=%u/%u out=%u lit=%u/%u "
      "rgb=%lu/%lu/%lu luma=%lu/%u range=%u-%u/%u-%u/%u-%u "
      "delta=%u black=%u snap=%u abl=%u/%u layers=",
      now,
      controller.node.header.id,
      controller.current_state.pattern_id,
      controller.current_state.palette_id,
      (unsigned long)controller.current_state.beat_frame,
      capturedWledFader,
      renderMean(customRenderSamples),
      renderMean(wledRenderSamples),
      renderMean(finalSamples),
      litPixels,
      length,
      (unsigned long)(redSum / length),
      (unsigned long)(greenSum / length),
      (unsigned long)(blueSum / length),
      (unsigned long)(luminanceSum / length),
      maximumLuminance,
      minimumRed,
      maximumRed,
      minimumGreen,
      maximumGreen,
      minimumBlue,
      maximumBlue,
      maximumRenderDelta,
      blackRenderFrames,
      snapRenderFrames,
      BusManager::currentMilliamps(),
      BusManager::ablMilliampsMax()
    );
    for (uint8_t layer = 0; layer < NUM_VSTRIPS; layer++) {
      const VirtualStrip *vstrip = controller.vstrips[layer];
      Serial.printf("%s%u:%u/%u/%c",
        layer ? "," : "",
        layer,
        uint8_t(vstrip->fade),
        vstrip->fader,
        vstrip->isWled() ? 'W' : 'C'
      );
    }
    Serial.println();
    maximumRenderDelta = 0;
    blackRenderFrames = 0;
    snapRenderFrames = 0;
  }
  // AI: end

  void handleOverlayDraw()
  {
    // Show the beat on the master OR if debugging
    // AI: below section was generated by an AI
    uint16_t overlays = controller.activeDebugOverlayMask();
    if (overlays) {
      uint16_t num_leds = strip.getLengthTotal();
      if (num_leds == 0)
        return;

      if (overlays & V3DebugBeat) {
        uint8_t p1 = (controller.current_state.beat_frame >> 8) % 16;
        strip.setPixelColor(p1, CRGB::White);
      }

      uint8_t p2 = scale8(protocolLocalValueFromId(controller.node.header.id) >> 4, num_leds-1);
      if (overlays & V3DebugNode)
        strip.setPixelColor(p2, CRGB::Yellow);

      if (overlays & V3DebugLeader) {
        uint8_t p3 = scale8(protocolLocalValueFromId(controller.node.header.uplinkId) >> 4, num_leds-1);
        if (p3 == p2) {
          strip.setPixelColor(p3, CRGB::Green);
        } else {
          strip.setPixelColor(p3, CRGB::Blue);
        }
      }

      if ((overlays & V3DebugRelay) && controller.node.isLeading())
        strip.setPixelColor(num_leds > 1 ? 1 : 0, CRGB::Purple);

      if (overlays & V3DebugRole) {
        uint16_t rolePixel = scale8(controller.role, num_leds - 1);
        strip.setPixelColor(rolePixel, CRGB::Orange);
      }

      if (overlays & V3DebugRadioQuality) {
        int16_t normalizedRssi = constrain(int16_t(controller.node.lastRssi) + 100, 0, 60);
        uint8_t quality = uint16_t(normalizedRssi) * 255 / 60;
        strip.setPixelColor(num_leds > 2 ? 2 : 0, CRGB(255 - quality, quality, 0));
      }

      if (overlays & V3DebugPositionQuality) {
        uint8_t quality = controller.activePositionConfidence();
        strip.setPixelColor(num_leds > 3 ? 3 : 0, CRGB(255 - quality, 0, quality));
      }
    }
    // AI: end

  }
};
