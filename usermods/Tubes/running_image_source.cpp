#include "running_image_source.h"

#if defined(ARDUINO_ARCH_ESP32)

#include "wled.h"
#include <esp_image_format.h>
#include <esp_ota_ops.h>
#include <esp_partition.h>
#include <mbedtls/sha256.h>
#include <stdio.h>
#include <string.h>

namespace {

// AI: below section was generated by an AI
void setRunningImageError(char* error, size_t errorLength, const char* message) {
  if (!error || errorLength == 0)
    return;
  snprintf(error, errorLength, "%s", message);
}

bool hashRunningImage(
    const esp_partition_t* partition,
    uint32_t imageLength,
    uint8_t digest[32]
) {
  mbedtls_sha256_context context;
  mbedtls_sha256_init(&context);
  if (mbedtls_sha256_starts_ret(&context, 0) != 0) {
    mbedtls_sha256_free(&context);
    return false;
  }

  uint8_t buffer[1024];
  uint32_t offset = 0;
  while (offset < imageLength) {
    const size_t remaining = imageLength - offset;
    const size_t length = remaining < sizeof(buffer) ? remaining : sizeof(buffer);
    if (esp_partition_read(partition, offset, buffer, length) != ESP_OK
        || mbedtls_sha256_update_ret(&context, buffer, length) != 0) {
      mbedtls_sha256_free(&context);
      return false;
    }
    offset += length;
    yield();
  }

  const bool success = mbedtls_sha256_finish_ret(&context, digest) == 0;
  mbedtls_sha256_free(&context);
  return success;
}
// AI: end

} // namespace

bool inspectRunningImage(RunningImageInfo& info, char* error, size_t errorLength) {
  info = RunningImageInfo();
  const esp_partition_t* partition = esp_ota_get_running_partition();
  if (!partition || partition->type != ESP_PARTITION_TYPE_APP) {
    setRunningImageError(error, errorLength, "running application partition unavailable");
    return false;
  }

  const esp_partition_pos_t position = {partition->address, partition->size};
  esp_image_metadata_t metadata = {};
  metadata.start_addr = partition->address;
  if (esp_image_verify(ESP_IMAGE_VERIFY_SILENT, &position, &metadata) != ESP_OK) {
    setRunningImageError(error, errorLength, "running application image failed verification");
    return false;
  }
  if (metadata.image_len == 0 || metadata.image_len > partition->size) {
    setRunningImageError(error, errorLength, "running application image length is invalid");
    return false;
  }

  info.partitionAddress = partition->address;
  info.partitionSizeBytes = partition->size;
  info.imageLengthBytes = metadata.image_len;
  info.releaseHash = WLED_BUILD_DESCRIPTION.hash;
  info.hardwareFamily = TUBES_HARDWARE_FAMILY;
  info.firmwareVariant = TUBES_FIRMWARE_VARIANT;
  if (!hashRunningImage(partition, info.imageLengthBytes, info.imageSha256)) {
    info = RunningImageInfo();
    setRunningImageError(error, errorLength, "running application image hash failed");
    return false;
  }
  setRunningImageError(error, errorLength, "");
  return true;
}

bool readRunningImageChunk(
    const RunningImageInfo& info,
    size_t offset,
    uint8_t* destination,
    size_t length,
    char* error,
    size_t errorLength
) {
  if (!destination || !runningImageRangeIsValid(info.imageLengthBytes, offset, length)) {
    setRunningImageError(error, errorLength, "running image range is invalid");
    return false;
  }

  const esp_partition_t* partition = esp_ota_get_running_partition();
  if (!partition
      || partition->address != info.partitionAddress
      || partition->size != info.partitionSizeBytes) {
    setRunningImageError(error, errorLength, "running application partition changed");
    return false;
  }
  if (esp_partition_read(partition, offset, destination, length) != ESP_OK) {
    setRunningImageError(error, errorLength, "running image read failed");
    return false;
  }
  setRunningImageError(error, errorLength, "");
  return true;
}

// AI: below section was generated by an AI
bool RunningFirmwareImageSource::inspect(FirmwareImageArtifact& artifact) {
  char error[96];
  _inspected = inspectRunningImage(_runningInfo, error, sizeof(error));
  if (!_inspected)
    return false;
  const CanonicalArtifactRecord& canonical = CANONICAL_ARTIFACT_DIG2GO_V14_OTA_APPLICATION;
  if (_artifactTarget.targetId != canonical.targetId
      || _runningInfo.imageLengthBytes != canonical.lengthBytes
      || memcmp(_runningInfo.imageSha256, canonical.sha256,
          sizeof(_runningInfo.imageSha256)) != 0) {
    _inspected = false;
    return false;
  }
  artifact = firmwareArtifactFromCanonical(
      canonical, _artifactTarget, _runningInfo.releaseHash);
  return true;
}

bool RunningFirmwareImageSource::read(size_t offset, uint8_t* destination, size_t length) {
  if (!_inspected)
    return false;
  char error[96];
  return readRunningImageChunk(
      _runningInfo, offset, destination, length, error, sizeof(error));
}
// AI: end

#endif
