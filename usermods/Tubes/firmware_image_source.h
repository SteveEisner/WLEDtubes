#pragma once

#include <stddef.h>
#include <stdint.h>
#include <limits.h>
#include <stdio.h>

#include "firmware_target_contract.h"

// AI: below section was generated by an AI
// Describes one application artifact independently of the device carrying it.
// The target is the receiver contract the artifact was built for, not the
// hardware identity of the carrier serving these bytes.
struct FirmwareImageArtifact {
  FirmwareTargetContract target;
  size_t imageLengthBytes = 0;
  uint32_t releaseHash = 0;
  uint8_t imageMd5[16] = {0};
  uint8_t imageSha256[32] = {0};
};

inline bool firmwareImageRangeIsValid(size_t imageLength, size_t offset, size_t length) {
  return imageLength > 0
      && length > 0
      && offset < imageLength
      && length <= imageLength - offset;
}

// Read-only byte source for a verified application artifact. Implementations
// must reject empty and out-of-range reads before touching their backing store.
class FirmwareImageSource {
public:
  virtual ~FirmwareImageSource() = default;
  virtual bool inspect(FirmwareImageArtifact& artifact) = 0;
  virtual bool read(size_t offset, uint8_t* destination, size_t length) = 0;
};

class MemoryFirmwareImageSource : public FirmwareImageSource {
public:
  MemoryFirmwareImageSource(
      const uint8_t* bytes,
      size_t length,
      const FirmwareImageArtifact& artifact
  ) : _bytes(bytes), _length(length), _artifact(artifact) {}

  bool inspect(FirmwareImageArtifact& artifact) override {
    if (!_bytes || _length == 0 || _artifact.imageLengthBytes != _length)
      return false;
    artifact = _artifact;
    return true;
  }

  bool read(size_t offset, uint8_t* destination, size_t length) override {
    if (!_bytes || !destination || !firmwareImageRangeIsValid(_length, offset, length))
      return false;
    for (size_t index = 0; index < length; index++)
      destination[index] = _bytes[offset + index];
    return true;
  }

private:
  const uint8_t* _bytes;
  size_t _length;
  FirmwareImageArtifact _artifact;
};

// Host-testable file seam for an S3 carrier catalog. The caller owns the FILE
// and must keep it open for the source lifetime; this class never writes it.
class FileFirmwareImageSource : public FirmwareImageSource {
public:
  FileFirmwareImageSource(FILE* file, const FirmwareImageArtifact& artifact)
      : _file(file), _artifact(artifact) {}

  bool inspect(FirmwareImageArtifact& artifact) override {
    if (!_file || _artifact.imageLengthBytes == 0)
      return false;
    const long originalOffset = ftell(_file);
    if (originalOffset < 0 || fseek(_file, 0, SEEK_END) != 0)
      return false;
    const long fileLength = ftell(_file);
    const bool restored = fseek(_file, originalOffset, SEEK_SET) == 0;
    if (!restored || fileLength < 0
        || static_cast<size_t>(fileLength) != _artifact.imageLengthBytes)
      return false;
    artifact = _artifact;
    return true;
  }

  bool read(size_t offset, uint8_t* destination, size_t length) override {
    if (!_file || !destination
        || !firmwareImageRangeIsValid(_artifact.imageLengthBytes, offset, length)
        || offset > static_cast<size_t>(LONG_MAX))
      return false;
    if (fseek(_file, static_cast<long>(offset), SEEK_SET) != 0)
      return false;
    return fread(destination, 1, length, _file) == length;
  }

private:
  FILE* _file;
  FirmwareImageArtifact _artifact;
};
// AI: end
