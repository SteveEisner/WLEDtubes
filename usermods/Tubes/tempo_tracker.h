#pragma once

#include <math.h>
#include <stdint.h>
#include <string.h>

#include "downbeat_tracker.h"

// AI: below section was generated by an AI

struct TempoEstimate {
  bool locked = false;
  uint16_t bpmQ8 = 0;
  uint8_t confidence = 0;
  uint8_t beatPhase = 0;
  bool phaseTracked = false;
  int16_t phaseErrorMs = 0;
  uint8_t timingEvents = 0;
  bool barTracked = false;
  uint8_t beatInBar = 0;
  uint8_t barConfidence = 0;

  // Makes the detected kick beat 1 while preserving the current phrase number.
  uint32_t beatOneFrame(uint32_t currentFrame) const {
    return (currentFrame & ~0xFFFU) | beatPhase;
  }

  // Moves the existing clock to the nearest beat carrying the measured phase.
  uint32_t nearestBeatFrame(uint32_t currentFrame) const {
    uint32_t candidate = (currentFrame & ~0xFFU) | beatPhase;
    int32_t difference = int32_t(candidate - currentFrame);
    if (difference > 128)
      candidate -= 256;
    else if (difference < -128)
      candidate += 256;
    return candidate;
  }

  // Selects the nearest equivalent clock frame whose integer beat has the
  // detected position in the four-beat bar. The running clock approaches this
  // target through RubberBandBeatClock rather than stepping to it.
  uint32_t nearestBarFrame(uint32_t currentFrame) const {
    uint32_t candidate = nearestBeatFrame(currentFrame);
    uint8_t candidateBeatInBar = uint8_t((candidate >> 8) & 3U);
    int8_t beatDifference = int8_t(beatInBar) - int8_t(candidateBeatInBar);
    if (beatDifference > 2)
      beatDifference -= 4;
    else if (beatDifference < -2)
      beatDifference += 4;
    if (beatDifference < 0)
      candidate -= uint32_t(-beatDifference) << 8;
    else
      candidate += uint32_t(beatDifference) << 8;
    return candidate;
  }
};

struct TempoDiagnostics {
  uint32_t spectrumFrames = 0;
  uint32_t lastSpectrumIntervalUs = 0;
  uint32_t onsetCandidates = 0;
  uint32_t lastOnsetIntervalUs = 0;
  uint16_t correlationBpmQ8 = 0;
  uint8_t kickFlux = 0;
  uint8_t snareFlux = 0;
  uint8_t broadFlux = 0;
  uint16_t heldBpmQ8 = 0;
  uint16_t challengerBpmQ8 = 0;
  uint8_t challengerScans = 0;
  uint8_t heldTimingFit = 0;
  uint8_t challengerTimingFit = 0;
};

// Estimates a stable dance-music tempo from WLED's existing 16-band FFT frames.
// The tracker owns fixed storage and performs no FFT or dynamic allocation.
class TempoTracker {
  public:
    static constexpr uint8_t SPECTRUM_BINS = 16;
    static constexpr float SPECTRUM_FRAMES_PER_SECOND = 22050.0f / 512.0f;
    static constexpr float SPECTRUM_FRAME_PERIOD_US = 1000000.0f / SPECTRUM_FRAMES_PER_SECOND;
    static constexpr uint8_t MINIMUM_BPM = 60;
    static constexpr uint8_t MAXIMUM_BPM = 180;

    void reset() {
      memset(previousSpectrum, 0, sizeof(previousSpectrum));
      memset(onsetHistory, 0, sizeof(onsetHistory));
      memset(tempoHistogram, 0, sizeof(tempoHistogram));
      historyWriteIndex = 0;
      historyCount = 0;
      framesProcessed = 0;
      framesSinceEvidence = UINT16_MAX;
      previousSpectrumReady = false;
      estimate = TempoEstimate();
      estimatePending = false;
      lastPublishedBpmQ8 = 0;
      lastPublishedFrame = 0;
      heldTempoBpm = 0.0f;
      tempoLockCenterBpm = 0.0f;
      challengerTempoBpm = 0.0f;
      challengerScans = 0;
      lastSpectrumTimestampUs = 0;
      spectrumTimestampReady = false;
      spectrumFramePeriodUs = SPECTRUM_FRAME_PERIOD_US;
      spectrumIntervalSamples = 0;
      previousPhaseOnset = 0.0f;
      previousPreviousPhaseOnset = 0.0f;
      previousPhaseKick = 0.0f;
      previousPhaseSnare = 0.0f;
      previousPhaseNovelty = 0.0f;
      previousPhaseOnsetTimestampUs = 0;
      phaseOnsetWindowReady = false;
      lastPhaseCandidateTimestampUs = 0;
      lastPhaseCandidateStrength = 0.0f;
      lastPhaseCandidateKick = 0.0f;
      lastPhaseCandidateSnare = 0.0f;
      lastPhaseCandidateNovelty = 0.0f;
      recentCandidateCount = 0;
      diagnostics = TempoDiagnostics();
      resetPhaseClock();
    }

    // Consumes one complete FFT frame. `missingFrames` preserves elapsed time when
    // the firmware could not observe one or more AudioReactive updates.
    void addSpectrum(const uint8_t* spectrum, uint8_t missingFrames = 0) {
      uint32_t timestampUs = spectrumTimestampReady
          ? lastSpectrumTimestampUs
              + uint32_t((missingFrames + 1) * SPECTRUM_FRAME_PERIOD_US + 0.5f)
          : uint32_t((framesProcessed + missingFrames + 1) * SPECTRUM_FRAME_PERIOD_US + 0.5f);
      addSpectrumAt(spectrum, timestampUs, missingFrames);
    }

    // Uses the AudioReactive completion timestamp so loop jitter cannot bias BPM.
    void addSpectrumAt(const uint8_t* spectrum, uint32_t timestampUs, uint8_t missingFrames = 0) {
      addSpectrumValuesAt(spectrum, timestampUs, missingFrames);
    }

    // Raw FFT mappings retain narrow transients that WLED's visual smoothing removes.
    void addSpectrumAt(const float* spectrum, uint32_t timestampUs, uint8_t missingFrames = 0) {
      addSpectrumValuesAt(spectrum, timestampUs, missingFrames);
    }

    bool takeEstimate(TempoEstimate& result) {
      if (!estimatePending)
        return false;
      result = estimate;
      estimatePending = false;
      return true;
    }

    const TempoEstimate& currentEstimate() const {
      return estimate;
    }

    const TempoDiagnostics& currentDiagnostics() const {
      return diagnostics;
    }

  private:
    // Computes positive spectral flux from either WLED's byte results or its raw
    // floating-point FFT mapping without changing the estimator downstream.
    template<typename SpectrumValue>
    void addSpectrumValuesAt(const SpectrumValue* spectrum, uint32_t timestampUs,
        uint8_t missingFrames) {
      if (!spectrum)
        return;

      if (!previousSpectrumReady || missingFrames > MAXIMUM_RECOVERABLE_GAP) {
        copySpectrum(spectrum);
        previousSpectrumReady = true;
        if (missingFrames > MAXIMUM_RECOVERABLE_GAP) {
          clearSignalHistory();
          resetPhaseClock();
        }
        lastSpectrumTimestampUs = timestampUs;
        spectrumTimestampReady = true;
        return;
      }

      // Missing frames carry time but no invented onset; the next real spectrum
      // becomes the new baseline because its unobserved transition is ambiguous.
      if (missingFrames) {
        const uint32_t previousTimestampUs = lastSpectrumTimestampUs;
        uint32_t intervalUs = uint32_t(timestampUs - previousTimestampUs) / (missingFrames + 1);
        for (uint8_t frame = 0; frame <= missingFrames; frame++)
          appendOnset(0.0f, previousTimestampUs + intervalUs * (frame + 1));
        copySpectrum(spectrum);
        lastSpectrumTimestampUs = timestampUs;
        return;
      }

      float kickFlux = 0.0f;
      float snareFlux = 0.0f;
      float broadFlux = 0.0f;
      float focusedFlux = 0.0f;
      for (uint8_t bin = 0; bin < SPECTRUM_BINS; bin++) {
        float current = float(spectrum[bin]);
        float change = current > previousSpectrum[bin]
            ? current - previousSpectrum[bin]
            : 0.0f;
        previousSpectrum[bin] = current;
        broadFlux += change;
        focusedFlux = maxFloat(focusedFlux, change);
        if (bin == 0)
          kickFlux += change * 5.0f;
        else if (bin == 1)
          kickFlux += change * 10.0f;
        else if (bin == 2)
          kickFlux += change * 7.0f;
        if (bin >= 9 && bin <= 13)
          snareFlux += change;
      }
      kickFlux /= 22.0f;
      snareFlux /= 5.0f;
      broadFlux /= SPECTRUM_BINS;

      // Percussive bands dominate timing evidence. Broad flux contributes enough
      // to bridge unusual instrumentation. A concentrated transient in any one
      // band also counts, so regular clicks do not depend on their exact pitch.
      float phaseOnset = maxFloat(maxFloat(kickFlux, snareFlux * 0.7f), focusedFlux * 0.35f);
      float onset = phaseOnset + broadFlux * 0.12f;
      diagnostics.kickFlux = uint8_t(fminf(kickFlux, 255.0f));
      diagnostics.snareFlux = uint8_t(fminf(snareFlux, 255.0f));
      diagnostics.broadFlux = uint8_t(fminf(broadFlux, 255.0f));
      observePhaseOnset(phaseOnset, kickFlux, snareFlux, broadFlux, timestampUs);
      appendOnset(onset, timestampUs);
      lastSpectrumTimestampUs = timestampUs;
      spectrumTimestampReady = true;
    }

    template<typename SpectrumValue>
    void copySpectrum(const SpectrumValue* spectrum) {
      for (uint8_t bin = 0; bin < SPECTRUM_BINS; bin++)
        previousSpectrum[bin] = float(spectrum[bin]);
    }

    static constexpr uint16_t HISTORY_LENGTH = 256;
    static constexpr uint16_t MINIMUM_HISTORY = 172;
    static constexpr uint8_t SCAN_INTERVAL_FRAMES = 8;
    static constexpr uint8_t MAXIMUM_RECOVERABLE_GAP = 8;
    static constexpr uint8_t TEMPO_STEPS_PER_BPM = 2;
    static constexpr uint16_t TEMPO_BINS =
        (MAXIMUM_BPM - MINIMUM_BPM) * TEMPO_STEPS_PER_BPM + 1;
    static constexpr float MINIMUM_ONSET = 4.0f;
    static constexpr float MINIMUM_CREST_FACTOR = 3.0f;
    static constexpr float HISTOGRAM_DECAY = 0.96f;
    static constexpr float MINIMUM_CORRELATION = 0.16f;
    static constexpr float MINIMUM_LOCK_EVIDENCE = 1.1f;
    static constexpr float MINIMUM_PEAK_RATIO = 1.2f;
    static constexpr uint16_t EVIDENCE_TIMEOUT_FRAMES =
        uint16_t(SPECTRUM_FRAMES_PER_SECOND * 6.0f);
    static constexpr uint8_t TIMING_HISTORY_LENGTH = 32;
    static constexpr uint8_t CANDIDATE_HISTORY_LENGTH = 16;
    static constexpr uint8_t MINIMUM_MATCHED_INTERVALS = 6;
    static constexpr uint8_t MINIMUM_TIMING_EVENTS = 6;
    static constexpr uint32_t MINIMUM_ONSET_INTERVAL_US = 180000;
    static constexpr float MAXIMUM_PHASE_ERROR = 0.22f;
    static constexpr float PHASE_CORRECTION_GAIN = 0.20f;
    static constexpr int32_t MAXIMUM_PHASE_CORRECTION_US = 8000;
    static constexpr uint32_t MINIMUM_PHASE_TIMEOUT_US = 2000000;
    static constexpr uint32_t MAXIMUM_PHASE_TIMEOUT_US = 5000000;
    static constexpr float LOCK_REFINEMENT_RANGE_BPM = 1.5f;
    static constexpr float MAXIMUM_LOCK_REFINEMENT_BPM = 0.75f;
    static constexpr float HALF_TEMPO_CANONICAL_LIMIT_BPM = 75.0f;
    static constexpr float CHALLENGER_TOLERANCE_BPM = 2.0f;
    static constexpr uint8_t CHALLENGER_REQUIRED_SCANS = 96;
    static constexpr float HELD_TEMPO_ADAPTATION = 0.04f;
    static constexpr float CHALLENGER_TIMING_FIT_RATIO = 1.25f;
    static constexpr float MINIMUM_CHALLENGER_TIMING_FIT = 2.5f;
    static constexpr float MAXIMUM_PLL_TEMPO_DEVIATION = 0.02f;
    static constexpr float TRACKED_PERIOD_ADAPTATION = 0.05f;

    float previousSpectrum[SPECTRUM_BINS] = {0.0f};
    float onsetHistory[HISTORY_LENGTH] = {0.0f};
    float tempoHistogram[TEMPO_BINS] = {0.0f};
    uint16_t historyWriteIndex = 0;
    uint16_t historyCount = 0;
    uint32_t framesProcessed = 0;
    uint16_t framesSinceEvidence = UINT16_MAX;
    bool previousSpectrumReady = false;
    TempoEstimate estimate;
    bool estimatePending = false;
    uint16_t lastPublishedBpmQ8 = 0;
    uint32_t lastPublishedFrame = 0;
    float heldTempoBpm = 0.0f;
    float tempoLockCenterBpm = 0.0f;
    float challengerTempoBpm = 0.0f;
    uint8_t challengerScans = 0;
    uint32_t lastSpectrumTimestampUs = 0;
    bool spectrumTimestampReady = false;
    float spectrumFramePeriodUs = SPECTRUM_FRAME_PERIOD_US;
    uint8_t spectrumIntervalSamples = 0;
    float previousPhaseOnset = 0.0f;
    float previousPreviousPhaseOnset = 0.0f;
    float previousPhaseKick = 0.0f;
    float previousPhaseSnare = 0.0f;
    float previousPhaseNovelty = 0.0f;
    uint32_t previousPhaseOnsetTimestampUs = 0;
    bool phaseOnsetWindowReady = false;
    uint32_t lastPhaseCandidateTimestampUs = 0;
    float lastPhaseCandidateStrength = 0.0f;
    float lastPhaseCandidateKick = 0.0f;
    float lastPhaseCandidateSnare = 0.0f;
    float lastPhaseCandidateNovelty = 0.0f;
    uint32_t recentCandidateTimestampsUs[CANDIDATE_HISTORY_LENGTH] = {0};
    uint8_t recentCandidateCount = 0;
    bool phaseClockActive = false;
    float trackedPeriodUs = 0.0f;
    uint32_t phaseAnchorTimestampUs = 0;
    uint32_t timingTimestampsUs[TIMING_HISTORY_LENGTH] = {0};
    uint32_t timingBeatOrdinals[TIMING_HISTORY_LENGTH] = {0};
    uint8_t timingCount = 0;
    uint32_t timingBeatOrdinal = 0;
    uint32_t lastAcceptedPhaseTimestampUs = 0;
    int16_t lastPhaseErrorMs = 0;
    uint32_t phaseRevision = 0;
    uint32_t lastPublishedPhaseRevision = 0;
    uint16_t lastPublishedBarRevision = 0;
    DownbeatTracker downbeatTracker;
    TempoDiagnostics diagnostics;

    static float maxFloat(float left, float right) {
      return left > right ? left : right;
    }

    void clearSignalHistory() {
      memset(onsetHistory, 0, sizeof(onsetHistory));
      historyWriteIndex = 0;
      historyCount = 0;
      framesSinceEvidence = UINT16_MAX;
      if (estimate.locked) {
        estimate = TempoEstimate();
        estimatePending = true;
      }
      heldTempoBpm = 0.0f;
      tempoLockCenterBpm = 0.0f;
      challengerTempoBpm = 0.0f;
      challengerScans = 0;
      diagnostics.heldBpmQ8 = 0;
      diagnostics.challengerBpmQ8 = 0;
      diagnostics.challengerScans = 0;
      diagnostics.heldTimingFit = 0;
      diagnostics.challengerTimingFit = 0;
    }

    void appendOnset(float onset, uint32_t timestampUs) {
      if (spectrumTimestampReady) {
        const uint32_t intervalUs = uint32_t(timestampUs - lastSpectrumTimestampUs);
        diagnostics.lastSpectrumIntervalUs = intervalUs;
        // AudioReactive's real completion cadence depends on sample rate, slot
        // count, and FFT cost. Average timestamps so autocorrelation converts a
        // lag to BPM using the device's measured cadence instead of 22.05 kHz mono.
        const float minimumCadenceInterval = spectrumFramePeriodUs * 0.6f;
        const float maximumCadenceInterval = spectrumFramePeriodUs * 1.5f;
        if (intervalUs >= minimumCadenceInterval
            && intervalUs <= maximumCadenceInterval) {
          if (spectrumIntervalSamples < 32) {
            spectrumFramePeriodUs =
                (spectrumFramePeriodUs * spectrumIntervalSamples + intervalUs)
                / (spectrumIntervalSamples + 1);
            spectrumIntervalSamples++;
          } else {
            spectrumFramePeriodUs += (intervalUs - spectrumFramePeriodUs) * 0.02f;
          }
        }
      }
      diagnostics.spectrumFrames++;
      onsetHistory[historyWriteIndex] = onset;
      historyWriteIndex = (historyWriteIndex + 1) % HISTORY_LENGTH;
      if (historyCount < HISTORY_LENGTH)
        historyCount++;
      framesProcessed++;
      if (framesSinceEvidence < UINT16_MAX)
        framesSinceEvidence++;
      lastSpectrumTimestampUs = timestampUs;
      spectrumTimestampReady = true;
      if (historyCount >= MINIMUM_HISTORY
          && framesProcessed % SCAN_INTERVAL_FRAMES == 0)
        updateTempoEstimate();
    }

    void resetPhaseClock() {
      phaseClockActive = false;
      trackedPeriodUs = 0.0f;
      phaseAnchorTimestampUs = 0;
      timingCount = 0;
      timingBeatOrdinal = 0;
      lastAcceptedPhaseTimestampUs = 0;
      lastPhaseErrorMs = 0;
      phaseRevision = 0;
      lastPublishedPhaseRevision = 0;
      lastPublishedBarRevision = 0;
      downbeatTracker.reset();
    }

    // Selects local maxima from kick or snare flux as timing observations.
    void observePhaseOnset(float onset, float kick, float snare, float novelty,
        uint32_t timestampUs) {
      if (phaseOnsetWindowReady
          && previousPhaseOnset >= MINIMUM_ONSET
          && previousPhaseOnset >= previousPreviousPhaseOnset
          && previousPhaseOnset > onset) {
        acceptPhaseCandidate(
            previousPhaseOnsetTimestampUs,
            previousPhaseOnset,
            previousPhaseKick,
            previousPhaseSnare,
            previousPhaseNovelty
        );
      }
      previousPreviousPhaseOnset = previousPhaseOnset;
      previousPhaseOnset = onset;
      previousPhaseKick = kick;
      previousPhaseSnare = snare;
      previousPhaseNovelty = novelty;
      previousPhaseOnsetTimestampUs = timestampUs;
      phaseOnsetWindowReady = true;
    }

    void acceptPhaseCandidate(uint32_t timestampUs, float strength,
        float kick, float snare, float novelty) {
      uint32_t intervalUs = lastPhaseCandidateTimestampUs
          ? uint32_t(timestampUs - lastPhaseCandidateTimestampUs)
          : 0;
      if (lastPhaseCandidateTimestampUs
          && intervalUs < MINIMUM_ONSET_INTERVAL_US) {
        if (strength > lastPhaseCandidateStrength) {
          lastPhaseCandidateTimestampUs = timestampUs;
          lastPhaseCandidateStrength = strength;
          lastPhaseCandidateKick = kick;
          lastPhaseCandidateSnare = snare;
          lastPhaseCandidateNovelty = novelty;
        }
        return;
      }
      diagnostics.lastOnsetIntervalUs = intervalUs;
      diagnostics.onsetCandidates++;
      lastPhaseCandidateTimestampUs = timestampUs;
      lastPhaseCandidateStrength = strength;
      lastPhaseCandidateKick = kick;
      lastPhaseCandidateSnare = snare;
      lastPhaseCandidateNovelty = novelty;
      appendRecentCandidate(timestampUs);
      if (phaseClockActive)
        trackPhaseCandidate(timestampUs, kick, snare, novelty);
    }

    void appendRecentCandidate(uint32_t timestampUs) {
      if (recentCandidateCount == CANDIDATE_HISTORY_LENGTH) {
        for (uint8_t index = 1; index < recentCandidateCount; index++)
          recentCandidateTimestampsUs[index - 1] = recentCandidateTimestampsUs[index];
        recentCandidateCount--;
      }
      recentCandidateTimestampsUs[recentCandidateCount++] = timestampUs;
    }

    // Sparse unrelated transients can correlate strongly by accident. A lock is
    // credible only when several observed intervals fit the candidate beat grid.
    bool candidateHasTimingEvidence(float bpm) const {
      if (recentCandidateCount < MINIMUM_MATCHED_INTERVALS + 1 || bpm <= 0.0f)
        return false;
      float periodUs = 60000000.0f / bpm;
      uint8_t matched = 0;
      uint32_t matchedSpanUs = 0;
      for (uint8_t index = 1; index < recentCandidateCount; index++) {
        uint32_t intervalUs = uint32_t(
            recentCandidateTimestampsUs[index] - recentCandidateTimestampsUs[index - 1]
        );
        float halfPeriodUs = periodUs * 0.5f;
        uint8_t halfBeats = uint8_t(intervalUs / halfPeriodUs + 0.5f);
        if (!halfBeats || halfBeats > 8)
          continue;
        float expectedUs = halfBeats * halfPeriodUs;
        if (fabsf(float(intervalUs) - expectedUs) > expectedUs * MAXIMUM_PHASE_ERROR)
          continue;
        matched++;
        matchedSpanUs += intervalUs;
      }
      return matched >= MINIMUM_MATCHED_INTERVALS && matchedSpanUs >= periodUs * 3.0f;
    }

    void initializePhaseClock(float bpm) {
      if (!lastPhaseCandidateTimestampUs || bpm <= 0.0f)
        return;
      phaseClockActive = true;
      trackedPeriodUs = 60000000.0f / bpm;
      phaseAnchorTimestampUs = lastPhaseCandidateTimestampUs;
      timingCount = 1;
      timingBeatOrdinal = 0;
      timingTimestampsUs[0] = lastPhaseCandidateTimestampUs;
      timingBeatOrdinals[0] = 0;
      lastAcceptedPhaseTimestampUs = lastPhaseCandidateTimestampUs;
      lastPhaseErrorMs = 0;
      phaseRevision++;
      downbeatTracker.reset();
      downbeatTracker.observe(
          0,
          lastPhaseCandidateKick,
          lastPhaseCandidateSnare,
          lastPhaseCandidateNovelty
      );
    }

    void appendTimingObservation(uint32_t timestampUs, uint32_t beatOrdinal) {
      if (timingCount == TIMING_HISTORY_LENGTH) {
        for (uint8_t index = 1; index < timingCount; index++) {
          timingTimestampsUs[index - 1] = timingTimestampsUs[index];
          timingBeatOrdinals[index - 1] = timingBeatOrdinals[index];
        }
        timingCount--;
      }
      timingTimestampsUs[timingCount] = timestampUs;
      timingBeatOrdinals[timingCount] = beatOrdinal;
      timingCount++;
    }

    // Fits elapsed microphone time against matched beat numbers across many onsets.
    float fittedPeriodUs() const {
      if (timingCount < MINIMUM_TIMING_EVENTS)
        return 0.0f;
      uint32_t baseTimestamp = timingTimestampsUs[0];
      uint32_t baseBeat = timingBeatOrdinals[0];
      float sumX = 0.0f;
      float sumY = 0.0f;
      float sumXX = 0.0f;
      float sumXY = 0.0f;
      for (uint8_t index = 0; index < timingCount; index++) {
        float x = float(timingBeatOrdinals[index] - baseBeat);
        float y = float(uint32_t(timingTimestampsUs[index] - baseTimestamp));
        sumX += x;
        sumY += y;
        sumXX += x * x;
        sumXY += x * y;
      }
      float denominator = timingCount * sumXX - sumX * sumX;
      if (denominator <= 0.0f)
        return 0.0f;
      return (timingCount * sumXY - sumX * sumY) / denominator;
    }

    // Rejects off-beat activity and gently corrects period and phase from matched onsets.
    void trackPhaseCandidate(uint32_t timestampUs, float kick, float snare,
        float novelty) {
      int32_t elapsedUs = int32_t(timestampUs - phaseAnchorTimestampUs);
      if (elapsedUs <= 0 || trackedPeriodUs <= 0.0f)
        return;
      int32_t elapsedBeats = int32_t(elapsedUs / trackedPeriodUs + 0.5f);
      if (elapsedBeats < 1)
        return;
      float predictedTimestamp = phaseAnchorTimestampUs + elapsedBeats * trackedPeriodUs;
      int32_t phaseErrorUs = int32_t(timestampUs - uint32_t(predictedTimestamp + 0.5f));
      if (abs(phaseErrorUs) > int32_t(trackedPeriodUs * MAXIMUM_PHASE_ERROR))
        return;

      timingBeatOrdinal += elapsedBeats;
      appendTimingObservation(timestampUs, timingBeatOrdinal);
      downbeatTracker.observe(timingBeatOrdinal, kick, snare, novelty);
      lastAcceptedPhaseTimestampUs = timestampUs;
      float fitted = fittedPeriodUs();
      float minimumPeriod = 60000000.0f / MAXIMUM_BPM;
      float maximumPeriod = 60000000.0f / MINIMUM_BPM;
      if (fitted >= minimumPeriod && fitted <= maximumPeriod) {
        // Once tempo is locked, onset timing is a phase observation rather than
        // an independent tempo estimator. Bound its period correction around the
        // held autocorrelation lock so subdivisions cannot drag the PLL away.
        if (heldTempoBpm > 0.0f) {
          float heldPeriod = 60000000.0f / heldTempoBpm;
          float minimumHeldPeriod = heldPeriod * (1.0f - MAXIMUM_PLL_TEMPO_DEVIATION);
          float maximumHeldPeriod = heldPeriod * (1.0f + MAXIMUM_PLL_TEMPO_DEVIATION);
          if (fitted < minimumHeldPeriod)
            fitted = minimumHeldPeriod;
          else if (fitted > maximumHeldPeriod)
            fitted = maximumHeldPeriod;
        }
        trackedPeriodUs += (fitted - trackedPeriodUs) * TRACKED_PERIOD_ADAPTATION;
      }

      int32_t phaseCorrectionUs = int32_t(phaseErrorUs * PHASE_CORRECTION_GAIN);
      if (phaseCorrectionUs > MAXIMUM_PHASE_CORRECTION_US)
        phaseCorrectionUs = MAXIMUM_PHASE_CORRECTION_US;
      else if (phaseCorrectionUs < -MAXIMUM_PHASE_CORRECTION_US)
        phaseCorrectionUs = -MAXIMUM_PHASE_CORRECTION_US;
      phaseAnchorTimestampUs = uint32_t(predictedTimestamp + phaseCorrectionUs);
      lastPhaseErrorMs = int16_t(phaseErrorUs / 1000);
      phaseRevision++;
    }

    float historyValue(uint16_t chronologicalIndex) const {
      uint16_t oldest = historyCount < HISTORY_LENGTH ? 0 : historyWriteIndex;
      return onsetHistory[(oldest + chronologicalIndex) % HISTORY_LENGTH];
    }

    // Normalized correlation makes candidate scores insensitive to microphone gain.
    float correlationAtLag(float lag) const {
      uint16_t first = uint16_t(ceilf(lag));
      float correlation = 0.0f;
      float currentEnergy = 0.0f;
      float delayedEnergy = 0.0f;
      for (uint16_t index = first; index < historyCount; index++) {
        float delayedPosition = index - lag;
        uint16_t delayedIndex = uint16_t(delayedPosition);
        float fraction = delayedPosition - delayedIndex;
        float delayed = historyValue(delayedIndex);
        if (fraction > 0.0f && delayedIndex + 1 < historyCount)
          delayed += (historyValue(delayedIndex + 1) - delayed) * fraction;
        float current = historyValue(index);
        correlation += current * delayed;
        currentEnergy += current * current;
        delayedEnergy += delayed * delayed;
      }
      float energy = sqrtf(currentEnergy * delayedEnergy);
      return energy > 0.0f ? correlation / energy : 0.0f;
    }

    float candidateScore(float bpm) const {
      const float measuredFramesPerSecond = 1000000.0f / spectrumFramePeriodUs;
      float lag = measuredFramesPerSecond * 60.0f / bpm;
      float score = correlationAtLag(lag);
      if (lag * 2.0f < historyCount)
        score += correlationAtLag(lag * 2.0f) * 0.45f;

      // A pulse at twice this candidate tempo makes every second beat correlate
      // at `lag`, which otherwise looks like a convincing half-tempo solution.
      // Penalize that slower interpretation only when its intervening pulses are
      // themselves regular and the doubled tempo remains in the supported range.
      if (bpm * 2.0f <= MAXIMUM_BPM)
        score -= correlationAtLag(lag * 0.5f) * 0.65f;

      // A weak 120 BPM prior resolves half/double ambiguities without overruling
      // repeated evidence elsewhere in the supported dance-music range.
      float distance = (bpm - 120.0f) / 45.0f;
      return score * (0.9f + 0.1f * expf(-0.5f * distance * distance));
    }

    bool historyHasPercussiveEvidence() const {
      float maximum = 0.0f;
      float total = 0.0f;
      for (uint16_t index = 0; index < historyCount; index++) {
        float value = historyValue(index);
        total += value;
        if (value > maximum)
          maximum = value;
      }
      float mean = historyCount ? total / historyCount : 0.0f;
      return maximum >= MINIMUM_ONSET
          && (mean <= 0.0f || maximum >= mean * MINIMUM_CREST_FACTOR);
    }

    void decayTempoHistogram() {
      for (uint16_t index = 0; index < TEMPO_BINS; index++)
        tempoHistogram[index] *= HISTOGRAM_DECAY;
    }

    void addTempoEvidence(uint16_t candidateIndex, float strength) {
      int16_t first = int16_t(candidateIndex) - 8;
      int16_t last = int16_t(candidateIndex) + 8;
      if (first < 0)
        first = 0;
      if (last >= int16_t(TEMPO_BINS))
        last = TEMPO_BINS - 1;
      for (int16_t index = first; index <= last; index++) {
        float distance = (index - int16_t(candidateIndex)) / 3.4f;
        tempoHistogram[index] += strength * expf(-0.5f * distance * distance);
      }
    }

    uint16_t strongestTempoIndex() const {
      uint16_t strongest = 0;
      for (uint16_t index = 1; index < TEMPO_BINS; index++)
        if (tempoHistogram[index] > tempoHistogram[strongest])
          strongest = index;
      return strongest;
    }

    float competingTempoEvidence(uint16_t strongest) const {
      float competing = 0.0f;
      for (uint16_t index = 0; index < TEMPO_BINS; index++) {
        int16_t distance = int16_t(index) - int16_t(strongest);
        if (distance >= -10 && distance <= 10)
          continue;
        if (tempoHistogram[index] > competing)
          competing = tempoHistogram[index];
      }
      return competing;
    }

    float interpolateTempo(uint16_t strongest) const {
      float index = strongest;
      if (strongest > 0 && strongest + 1 < TEMPO_BINS) {
        float left = tempoHistogram[strongest - 1];
        float center = tempoHistogram[strongest];
        float right = tempoHistogram[strongest + 1];
        float denominator = left - 2.0f * center + right;
        if (fabsf(denominator) > 0.0001f) {
          float offset = 0.5f * (left - right) / denominator;
          if (offset >= -0.5f && offset <= 0.5f)
            index += offset;
        }
      }
      return MINIMUM_BPM + index / TEMPO_STEPS_PER_BPM;
    }

    // Scores how precisely recent onsets fit a candidate's half-beat grid. This
    // rejects a persistent autocorrelation alias while the incumbent clock still
    // explains the observed timing better.
    float candidateTimingFit(float bpm) const {
      if (recentCandidateCount < 2 || bpm <= 0.0f)
        return 0.0f;
      float halfPeriodUs = 30000000.0f / bpm;
      float score = 0.0f;
      for (uint8_t index = 1; index < recentCandidateCount; index++) {
        uint32_t intervalUs = uint32_t(
            recentCandidateTimestampsUs[index] - recentCandidateTimestampsUs[index - 1]
        );
        uint8_t halfBeats = uint8_t(intervalUs / halfPeriodUs + 0.5f);
        if (!halfBeats || halfBeats > 8)
          continue;
        float expectedUs = halfBeats * halfPeriodUs;
        float relativeError = fabsf(float(intervalUs) - expectedUs) / expectedUs;
        if (relativeError < MAXIMUM_PHASE_ERROR)
          score += 1.0f - relativeError / MAXIMUM_PHASE_ERROR;
      }
      return score;
    }

    // Keeps acquisition fast while requiring an unrelated tempo to remain the
    // clear winner for several seconds before it can replace a mature lock.
    static float canonicalTempo(float candidate) {
      if (candidate < HALF_TEMPO_CANONICAL_LIMIT_BPM
          && candidate * 2.0f <= MAXIMUM_BPM)
        return candidate * 2.0f;
      return candidate;
    }

    float updateHeldTempo(float candidate, float instantaneousCandidate, bool& switched) {
      switched = false;
      // A regular pulse train cannot distinguish 60 from 120 BPM by timing
      // alone. Prefer the conventional dance-tempo octave for this narrow
      // ambiguous range so every other kick cannot establish a false slow lock.
      candidate = canonicalTempo(candidate);
      instantaneousCandidate = canonicalTempo(instantaneousCandidate);
      if (heldTempoBpm <= 0.0f) {
        heldTempoBpm = candidate;
        tempoLockCenterBpm = candidate;
        challengerTempoBpm = 0.0f;
        challengerScans = 0;
      } else {
        float adjustedCandidate = candidate;
        float halfCandidate = candidate * 0.5f;
        float doubleCandidate = candidate * 2.0f;
        if (halfCandidate >= MINIMUM_BPM
            && fabsf(halfCandidate - heldTempoBpm) < fabsf(adjustedCandidate - heldTempoBpm))
          adjustedCandidate = halfCandidate;
        if (doubleCandidate <= MAXIMUM_BPM
            && fabsf(doubleCandidate - heldTempoBpm) < fabsf(adjustedCandidate - heldTempoBpm))
          adjustedCandidate = doubleCandidate;

        if (fabsf(adjustedCandidate - tempoLockCenterBpm) <= LOCK_REFINEMENT_RANGE_BPM) {
          heldTempoBpm += (adjustedCandidate - heldTempoBpm) * HELD_TEMPO_ADAPTATION;
          float minimumHeld = tempoLockCenterBpm - MAXIMUM_LOCK_REFINEMENT_BPM;
          float maximumHeld = tempoLockCenterBpm + MAXIMUM_LOCK_REFINEMENT_BPM;
          if (heldTempoBpm < minimumHeld)
            heldTempoBpm = minimumHeld;
          else if (heldTempoBpm > maximumHeld)
            heldTempoBpm = maximumHeld;
          challengerTempoBpm = 0.0f;
          challengerScans = 0;
        } else {
          bool instantaneousSupport = fabsf(
              instantaneousCandidate - challengerTempoBpm
          ) <= CHALLENGER_TOLERANCE_BPM;
          if (challengerScans
              && fabsf(candidate - challengerTempoBpm) <= CHALLENGER_TOLERANCE_BPM) {
            challengerTempoBpm += (candidate - challengerTempoBpm) * 0.10f;
            if (instantaneousSupport && challengerScans < UINT8_MAX) {
              challengerScans++;
            } else if (!instantaneousSupport) {
              challengerScans = challengerScans > 3 ? challengerScans - 3 : 0;
            }
          } else {
            challengerTempoBpm = candidate;
            challengerScans = fabsf(
                instantaneousCandidate - candidate
            ) <= CHALLENGER_TOLERANCE_BPM ? 1 : 0;
          }
          float heldTimingFit = candidateTimingFit(heldTempoBpm);
          float challengerTimingFit = candidateTimingFit(challengerTempoBpm);
          if (challengerScans >= CHALLENGER_REQUIRED_SCANS
              && candidateHasTimingEvidence(challengerTempoBpm)
              && challengerTimingFit >= MINIMUM_CHALLENGER_TIMING_FIT
              && challengerTimingFit >= heldTimingFit * CHALLENGER_TIMING_FIT_RATIO) {
            heldTempoBpm = challengerTempoBpm;
            tempoLockCenterBpm = heldTempoBpm;
            challengerTempoBpm = 0.0f;
            challengerScans = 0;
            switched = true;
          }
        }
      }

      diagnostics.heldBpmQ8 = uint16_t(heldTempoBpm * 256.0f + 0.5f);
      diagnostics.challengerBpmQ8 = challengerScans
          ? uint16_t(challengerTempoBpm * 256.0f + 0.5f)
          : 0;
      diagnostics.challengerScans = challengerScans;
      diagnostics.heldTimingFit = uint8_t(fminf(255.0f, candidateTimingFit(heldTempoBpm) * 16.0f));
      diagnostics.challengerTimingFit = challengerScans
          ? uint8_t(fminf(255.0f, candidateTimingFit(challengerTempoBpm) * 16.0f))
          : 0;
      return heldTempoBpm;
    }

    uint8_t currentBeatPhase(float bpm) const {
      if (!phaseClockActive || bpm <= 0.0f || !spectrumTimestampReady)
        return 0;
      float periodUs = trackedPeriodUs > 0.0f ? trackedPeriodUs : 60000000.0f / bpm;
      float elapsedUs = float(int32_t(lastSpectrumTimestampUs - phaseAnchorTimestampUs));
      float phase = fmodf(elapsedUs, periodUs) / periodUs;
      if (phase < 0.0f)
        phase += 1.0f;
      return uint8_t(phase * 255.0f + 0.5f);
    }

    // Extends the accepted-onset ordinal through the free-running phase clock,
    // including beats for which no sufficiently strong onset was observed.
    uint32_t currentBeatOrdinal() const {
      if (!phaseClockActive || trackedPeriodUs <= 0.0f || !spectrumTimestampReady)
        return timingBeatOrdinal;
      int32_t elapsedUs = int32_t(lastSpectrumTimestampUs - phaseAnchorTimestampUs);
      if (elapsedUs <= 0)
        return timingBeatOrdinal;
      return timingBeatOrdinal + uint32_t(elapsedUs / trackedPeriodUs);
    }

    void updateTempoEstimate() {
      decayTempoHistogram();
      if (!historyHasPercussiveEvidence()) {
        if (framesSinceEvidence >= EVIDENCE_TIMEOUT_FRAMES && estimate.locked) {
          estimate = TempoEstimate();
          estimatePending = true;
          challengerTempoBpm = 0.0f;
          challengerScans = 0;
          diagnostics.challengerBpmQ8 = 0;
          diagnostics.challengerScans = 0;
          diagnostics.challengerTimingFit = 0;
          // Silence withdraws the claim that music is present, but the last good
          // song tempo and phase keep coasting. Resumed noise must challenge that
          // prior instead of receiving an unsafe first-lock shortcut.
        }
        return;
      }

      uint16_t bestCandidate = 0;
      float bestScore = 0.0f;
      for (uint16_t index = 0; index < TEMPO_BINS; index++) {
        float bpm = MINIMUM_BPM + index / float(TEMPO_STEPS_PER_BPM);
        float score = candidateScore(bpm);
        if (score > bestScore) {
          bestScore = score;
          bestCandidate = index;
        }
      }
      float normalizedScore = bestScore / 1.45f;
      diagnostics.correlationBpmQ8 = uint16_t(
          (MINIMUM_BPM + bestCandidate / float(TEMPO_STEPS_PER_BPM)) * 256.0f + 0.5f
      );
      if (normalizedScore >= MINIMUM_CORRELATION) {
        addTempoEvidence(bestCandidate, normalizedScore);
        framesSinceEvidence = 0;
      }

      uint16_t strongest = strongestTempoIndex();
      float peak = tempoHistogram[strongest];
      float competing = competingTempoEvidence(strongest);
      if (peak < MINIMUM_LOCK_EVIDENCE
          || (competing > 0.0f && peak < competing * MINIMUM_PEAK_RATIO))
        return;

      float candidateBpm = interpolateTempo(strongest);
      if (!estimate.locked && !candidateHasTimingEvidence(candidateBpm))
        return;
      bool tempoSwitched = false;
      float instantaneousBpm = MINIMUM_BPM
          + bestCandidate / float(TEMPO_STEPS_PER_BPM);
      float bpm = updateHeldTempo(candidateBpm, instantaneousBpm, tempoSwitched);
      if (tempoSwitched) {
        resetPhaseClock();
        initializePhaseClock(bpm);
      }
      if (!phaseClockActive) {
        initializePhaseClock(bpm);
      } else {
        uint32_t phaseTimeoutUs = uint32_t(trackedPeriodUs * 4.0f);
        if (phaseTimeoutUs < MINIMUM_PHASE_TIMEOUT_US)
          phaseTimeoutUs = MINIMUM_PHASE_TIMEOUT_US;
        else if (phaseTimeoutUs > MAXIMUM_PHASE_TIMEOUT_US)
          phaseTimeoutUs = MAXIMUM_PHASE_TIMEOUT_US;
        bool timingFresh = lastAcceptedPhaseTimestampUs
            && uint32_t(lastSpectrumTimestampUs - lastAcceptedPhaseTimestampUs) <= phaseTimeoutUs;
        // Missing or contradictory onsets make the phase PLL coast. They do not
        // revoke a stable tempo; the parallel challenger above owns that decision.
        if (!timingFresh)
          lastPhaseErrorMs = 0;
      }
      uint16_t bpmQ8 = uint16_t(bpm * 256.0f + 0.5f);
      uint8_t confidence = uint8_t(fminf(
          255.0f,
          peak * 48.0f + (peak - competing) * 64.0f
      ));
      bool firstLock = !estimate.locked;
      estimate.locked = true;
      estimate.bpmQ8 = bpmQ8;
      estimate.confidence = confidence;
      estimate.beatPhase = currentBeatPhase(bpm);
      estimate.phaseTracked = phaseClockActive;
      estimate.phaseErrorMs = lastPhaseErrorMs;
      estimate.timingEvents = timingCount;
      DownbeatEstimate bar = downbeatTracker.estimate(currentBeatOrdinal());
      estimate.barTracked = bar.locked;
      estimate.beatInBar = bar.beatInBar;
      estimate.barConfidence = bar.confidence;

      // Publish immediately on lock, then at most once per second for a material
      // tempo change; the held Beat clock fills every interval in between.
      uint16_t difference = bpmQ8 > lastPublishedBpmQ8
          ? bpmQ8 - lastPublishedBpmQ8
          : lastPublishedBpmQ8 - bpmQ8;
      bool tempoUpdateDue = difference >= 64
          && framesProcessed - lastPublishedFrame >= uint32_t(SPECTRUM_FRAMES_PER_SECOND);
      bool phaseUpdateDue = phaseRevision != lastPublishedPhaseRevision
          && framesProcessed - lastPublishedFrame >= uint32_t(SPECTRUM_FRAMES_PER_SECOND / 2.0f);
      bool barUpdateDue = bar.revision != lastPublishedBarRevision
          && framesProcessed - lastPublishedFrame >= uint32_t(SPECTRUM_FRAMES_PER_SECOND / 2.0f);
      if (firstLock || tempoUpdateDue || phaseUpdateDue || barUpdateDue) {
        estimatePending = true;
        lastPublishedBpmQ8 = bpmQ8;
        lastPublishedFrame = framesProcessed;
        lastPublishedPhaseRevision = phaseRevision;
        lastPublishedBarRevision = bar.revision;
      }
    }
};

// AI: end
