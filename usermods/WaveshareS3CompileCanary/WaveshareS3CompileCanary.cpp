#ifdef WAVESHARE_S3_TUBES_REMOTE

// AI: below section was generated by an AI
// Attribution: uses Arduino_GFX, SensorLib, XPowersLib, and WLED Tubes APIs
// following the Waveshare ESP32-S3-Touch-AMOLED-2.16 vendor documentation.

#include "wled.h"

#undef BLACK
#undef BLUE
#undef GREEN
#undef CYAN
#undef RED
#undef MAGENTA
#undef YELLOW
#undef WHITE
#undef ORANGE
#undef PURPLE
#undef DARKGREY

#include <Arduino_GFX_Library.h>
#include <SensorQMI8658.hpp>
#include <touch/TouchDrvCST92xx.h>
#include <XPowersLib.h>

#ifdef TUBES_S3_FIELD_OS
#include "../Tubes/s3_field_api.h"
#endif

namespace {
constexpr int8_t DISPLAY_CS = 12;
constexpr int8_t DISPLAY_SCLK = 38;
constexpr int8_t DISPLAY_SDIO0 = 4;
constexpr int8_t DISPLAY_SDIO1 = 5;
constexpr int8_t DISPLAY_SDIO2 = 6;
constexpr int8_t DISPLAY_SDIO3 = 7;
constexpr int8_t DISPLAY_RESET = 39;
constexpr int8_t PERIPHERAL_SDA = 15;
constexpr int8_t PERIPHERAL_SCL = 14;
constexpr int8_t TOUCH_IRQ = 11;
constexpr int8_t TOUCH_RESET = 40;
constexpr int16_t DISPLAY_WIDTH = 480;
constexpr int16_t DISPLAY_HEIGHT = 480;
constexpr uint32_t SAMPLE_INTERVAL_MS = 500;
constexpr uint32_t PREVIEW_INTERVAL_MS = 50;
#ifdef TUBES_S3_FIELD_OS
constexpr uint8_t FIELD_OS_DEFAULT_BRIGHTNESS = 255;
#else
constexpr uint8_t SMOKE_DEFAULT_BRIGHTNESS = 160;
#endif

volatile bool touchInterruptPending = false;

void IRAM_ATTR handleTouchInterrupt() {
  touchInterruptPending = true;
}

Arduino_ESP32QSPI displayBus(DISPLAY_CS, DISPLAY_SCLK, DISPLAY_SDIO0, DISPLAY_SDIO1,
                             DISPLAY_SDIO2, DISPLAY_SDIO3);
Arduino_CO5300 display(&displayBus, DISPLAY_RESET, 0, false, DISPLAY_WIDTH, DISPLAY_HEIGHT);
TouchDrvCST92xx touch;
SensorQMI8658 imu;
XPowersPMU pmu;

#ifdef TUBES_S3_FIELD_OS
enum class FieldScreen : uint8_t {
  Home,
  Conductor,
  Surveyor,
  Status
};

class WaveshareS3FieldOs : public Usermod {
private:
  bool displayReady = false;
  bool touchReady = false;
  FieldScreen screen = FieldScreen::Home;
  uint32_t lastPreviewDraw = 0;
  uint32_t lastTelemetryDraw = 0;

  static constexpr uint16_t COLOR_BACKGROUND = 0x0863;
  static constexpr uint16_t COLOR_SURFACE = 0x10E7;
  static constexpr uint16_t COLOR_SURFACE_RAISED = 0x194A;
  static constexpr uint16_t COLOR_PRIMARY = 0x64FF;
  static constexpr uint16_t COLOR_MINT = 0x5F56;
  static constexpr uint16_t COLOR_AMBER = 0xFDC8;
  static constexpr uint16_t COLOR_MUTED = 0x8C51;

  static uint16_t rgb565(uint32_t color) {
    // Production colors stay RGB888 until this existing color-depth conversion.
    // This is not gamma or brightness scaling.
    const uint8_t red = color >> 16;
    const uint8_t green = color >> 8;
    const uint8_t blue = color;
    return static_cast<uint16_t>(((red & 0xF8) << 8) | ((green & 0xFC) << 3) | (blue >> 3));
  }

  void title(const __FlashStringHelper *text) {
    display.fillScreen(COLOR_BACKGROUND);
    display.setTextWrap(false);
    display.setTextColor(RGB565_WHITE);
    display.setTextSize(2);
    display.setCursor(24, 22);
    display.println(text);
  }

  void button(int16_t x, int16_t y, int16_t width, int16_t height, uint16_t color,
              const __FlashStringHelper *label) {
    display.fillRoundRect(x, y, width, height, 20, color);
    display.setTextColor(RGB565_WHITE);
    display.setTextSize(2);
    display.setCursor(x + 16, y + height / 2 - 8);
    display.println(label);
  }

  void drawHome() {
    title(F("Tubes Field OS"));
    display.setTextColor(COLOR_MUTED);
    display.setTextSize(1);
    display.setCursor(25, 51);
    display.println(F("The flock stays live wherever you go"));
    button(20, 84, 210, 164, COLOR_PRIMARY, F("Conductor"));
    button(250, 84, 210, 76, COLOR_SURFACE_RAISED, F("Surveyor"));
    button(250, 172, 210, 76, COLOR_SURFACE_RAISED, F("Status"));
    display.setTextColor(RGB565_WHITE);
    display.setTextSize(1);
    display.setCursor(36, 199);
    display.println(F("Run the show"));
    display.setCursor(266, 143); display.println(F("Nearby Tubes"));
    display.setCursor(266, 231); display.println(F("Read-only health"));
  }

  void drawBack() {
    button(372, 12, 88, 48, COLOR_SURFACE_RAISED, F("Home"));
  }

  // Persistent Strip observes WLED's canonical, completed logical framebuffer.
  // The null bus supplies geometry only; it must not become a second pixel store.
  class Strip {
  public:
    void draw(int16_t x, int16_t y, int16_t width, int16_t height) {
      const int16_t cell = width / 60;
      uint32_t colors[60];
      const bool validTopology = ::strip.getLengthTotal() >= 60;
      // draw() runs periodically, so this samples the previous completed show frame.
      for (uint8_t i = 0; i < 60; i++) colors[i] = validTopology ? ::strip.getPixelColor(i) : 0;
      for (uint8_t i = 0; i < 60; i++) fillCell(x + i * cell, y, cell, height, colors[i]);
    }
  private:
    void fillCell(int16_t x, int16_t y, int16_t w, int16_t h, uint32_t color) {
      display.fillRect(x, y, w - 1, h, rgb565(color));
    }
  };

  Strip stripComponent;

  void drawConductorTelemetry(const TubesS3FieldStatus &status) {
    display.fillRect(20, 68, 440, 87, COLOR_BACKGROUND);
    display.setTextColor(RGB565_WHITE);
    display.setTextSize(3);
    display.setCursor(22, 70);
    display.printf("%s\n", status.patternName);
    display.setTextColor(COLOR_PRIMARY);
    display.setTextSize(1);
    display.setCursor(350, 76);
    display.printf("S3 %03X", status.localNodeId);
    display.setTextColor(COLOR_MUTED);
    display.setTextSize(1);
    display.setCursor(24, 106);
    display.printf("%s  |  %u BPM  |  beat %u\n",
                   status.isMaster ? "LEADING" : status.isFollowing ? "FOLLOWING" : "UNLINKED",
                   status.bpm, status.beat + 1);
    display.setCursor(24, 125);
    const uint16_t phraseDelta = status.nextPatternPhrase - status.currentPatternPhrase;
    const uint32_t nextSeconds = status.bpm == 0 ? 0 : (static_cast<uint32_t>(phraseDelta) * 60000UL + (status.bpm * 8)) / (status.bpm * 16);
    if (!status.radioReady) {
      display.setTextColor(RGB565_RED);
      display.printf("Radio offline  |  channel %u\n", status.radioChannel);
    } else {
      display.setTextColor(COLOR_MINT);
      display.printf("Next in %lus\n", nextSeconds);
    }
  }

  void drawConductor() {
    TubesS3FieldStatus status;
    tubesS3ReadStatus(status);
    title(F("Conductor"));
    drawBack();
    drawConductorTelemetry(status);
    stripComponent.draw(31, 156, 420, 138);
    button(150, 328, 180, 70, COLOR_PRIMARY, F("Next"));
    lastPreviewDraw = millis();
    lastTelemetryDraw = millis();
  }

  static bool surveyorBefore(const TubesS3PeerStatus &candidate, const TubesS3PeerStatus &prior) {
    if (candidate.rssiKnown != prior.rssiKnown) return candidate.rssiKnown;
    if (candidate.rssiKnown && candidate.latestRssi != prior.latestRssi)
      return candidate.latestRssi > prior.latestRssi;
    return candidate.nodeId < prior.nodeId;
  }

  void drawChannelRow(int16_t y, const char *name, const TubesS3ChannelStatus &channel) {
    display.setCursor(24, y);
    if (channel.active)
      display.printf("%s %03X by %03X  %lus\n", name, channel.ownerChannelId,
          channel.ownerControlId, channel.leaseRemainingMs / 1000);
    else
      display.printf("%s local %03X  unclaimed\n", name, channel.localChannelId);
  }

  void drawSurveyor() {
    TubesS3FieldStatus status;
    tubesS3ReadStatus(status);
    title(F("Surveyor"));
    drawBack();
    display.setTextSize(1);
    display.setTextColor(COLOR_MUTED);
    drawChannelRow(72, "BEAT", status.beatChannel);
    drawChannelRow(90, "PAT ", status.patternChannel);
    drawChannelRow(108, "PAL ", status.paletteChannel);

    TubesS3PeerStatus sorted[7];
    size_t shown = 0;
    const uint32_t now = millis();
    for (size_t i = 0; i < status.peerCount; i++) {
      TubesS3PeerStatus candidate;
      if (!tubesS3ReadPeer(i, candidate) || candidate.nodeId == status.localNodeId
          || now - candidate.lastSeenMs > 60000) continue;
      if (shown == 7 && !surveyorBefore(candidate, sorted[6])) continue;
      size_t position = shown < 7 ? shown++ : 6;
      while (position > 0 && surveyorBefore(candidate, sorted[position - 1])) {
        if (position < 7) sorted[position] = sorted[position - 1];
        position--;
      }
      if (position < 7) sorted[position] = candidate;
    }
    display.setTextColor(RGB565_WHITE);
    display.setCursor(24, 142);
    display.printf("LOCAL %03X  follows %03X\n", status.localNodeId, status.uplinkId);
    for (size_t i = 0; i < shown; i++) {
      const TubesS3PeerStatus &peer = sorted[i];
      display.setCursor(24, 172 + i * 30);
      if (peer.rssiKnown)
        display.printf("%03X -> %03X  gen%u  %ddB  age %lus\n", peer.nodeId, peer.uplinkId,
            peer.protocolGeneration, peer.latestRssi, (now - peer.lastSeenMs) / 1000);
      else
        display.printf("%03X -> %03X  gen%u  RSSI --  age %lus\n", peer.nodeId, peer.uplinkId,
            peer.protocolGeneration, (now - peer.lastSeenMs) / 1000);
    }
    lastTelemetryDraw = now;
  }

  void drawStatus() {
    TubesS3FieldStatus status;
    tubesS3ReadStatus(status);
    title(F("Status"));
    drawBack();
    display.setTextColor(RGB565_WHITE);
    display.setTextSize(2);
    display.setCursor(24, 92);
    display.printf("Local S3 %03X\n", status.localNodeId);
    display.setTextSize(1);
    display.setTextColor(COLOR_MUTED);
    display.setCursor(24, 140); display.printf("Role: %s  |  radio: %s\n", status.isMaster ? "leading" : status.isFollowing ? "following" : "unlinked", status.radioReady ? "ready" : "offline");
    display.setCursor(24, 164); display.printf("Channel %u\n", status.radioChannel);
    display.setCursor(24, 188); display.printf("Output: 60 pixels  |  %s\n", status.preview[0] || status.preview[59] ? "active" : "ready");
    display.setCursor(24, 220); display.println(F("Read-only public Tubes state"));
  }

  void draw() {
    if (!displayReady) return;
    switch (screen) {
      case FieldScreen::Home: drawHome(); break;
      case FieldScreen::Conductor: drawConductor(); break;
      case FieldScreen::Surveyor: drawSurveyor(); break;
      case FieldScreen::Status: drawStatus(); break;
    }
  }

  void onTouch(int16_t x, int16_t y) {
    if (screen != FieldScreen::Home && x >= 360 && y <= 75) {
      screen = FieldScreen::Home;
    } else if (screen == FieldScreen::Home) {
      if (y >= 84 && y < 250) {
        if (x < 240) screen = FieldScreen::Conductor;
        else screen = y < 166 ? FieldScreen::Surveyor : FieldScreen::Status;
      }
    } else if (screen == FieldScreen::Conductor && y >= 315 && y <= 415) {
      tubesS3ForceNext();
    }
    draw();
  }

public:
  void setup() override {
    Wire.begin(PERIPHERAL_SDA, PERIPHERAL_SCL);
    displayReady = display.begin();
    if (displayReady) {
      display.setBrightness(
#ifdef TUBES_S3_FIELD_OS
        FIELD_OS_DEFAULT_BRIGHTNESS
#else
        SMOKE_DEFAULT_BRIGHTNESS
#endif
      );
      display.setTextWrap(false);
    }
    pinMode(TOUCH_RESET, OUTPUT);
    digitalWrite(TOUCH_RESET, LOW);
    delay(10);
    digitalWrite(TOUCH_RESET, HIGH);
    delay(50);
    pinMode(TOUCH_IRQ, INPUT_PULLUP);
    touchReady = touch.begin(Wire, CST92XX_SLAVE_ADDRESS, PERIPHERAL_SDA, PERIPHERAL_SCL);
    if (touchReady) {
      touch.setMaxCoordinates(DISPLAY_WIDTH, DISPLAY_HEIGHT);
      touchInterruptPending = false;
      attachInterrupt(TOUCH_IRQ, handleTouchInterrupt, FALLING);
    }
    draw();
  }

  void loop() override {
    if (touchReady && touchInterruptPending) {
      touchInterruptPending = false;
      int16_t x = -1;
      int16_t y = -1;
      if (touch.getPoint(&x, &y, 1) > 0) onTouch(x, y);
    }
    const uint32_t now = millis();
    if (displayReady && screen == FieldScreen::Conductor && now - lastPreviewDraw >= PREVIEW_INTERVAL_MS) {
      lastPreviewDraw = now;
      TubesS3FieldStatus status;
      tubesS3ReadStatus(status);
      stripComponent.draw(31, 156, 420, 138);
    }
    if (displayReady && now - lastTelemetryDraw >= SAMPLE_INTERVAL_MS) {
      if (screen == FieldScreen::Conductor) {
        TubesS3FieldStatus status;
        tubesS3ReadStatus(status);
        drawConductorTelemetry(status);
        lastTelemetryDraw = now;
      } else if (screen == FieldScreen::Surveyor) {
        drawSurveyor();
      }
    }
  }

  void addToJsonInfo(JsonObject &root) override {
    JsonObject user = root[F("u")];
    if (user.isNull()) user = root.createNestedObject(F("u"));
    JsonArray fieldOs = user.createNestedArray(F("S3 field OS"));
    fieldOs.add(displayReady ? F("display OK") : F("display FAIL"));
    fieldOs.add(touchReady ? F("touch OK") : F("touch FAIL"));
  }
};

static WaveshareS3FieldOs waveshareS3FieldOs;
REGISTER_USERMOD(waveshareS3FieldOs);
#else

class WaveshareS3PeripheralSmoke : public Usermod {
private:
  bool displayReady = false;
  bool touchReady = false;
  bool pmuReady = false;
  bool imuReady = false;
  uint8_t displayBrightness =
#ifdef TUBES_S3_FIELD_OS
    FIELD_OS_DEFAULT_BRIGHTNESS;
#else
    SMOKE_DEFAULT_BRIGHTNESS;
#endif
  uint32_t lastSample = 0;
  int16_t touchX = -1;
  int16_t touchY = -1;
  uint16_t batteryMv = 0;
  bool usbPresent = false;
  bool charging = false;
  float accelX = 0.0f;
  float accelY = 0.0f;
  float accelZ = 0.0f;

  // Samples only board-local peripherals and never enters a Tubes transport path.
  void samplePeripherals() {
    if (pmuReady) {
      batteryMv = pmu.getBattVoltage();
      usbPresent = pmu.isVbusIn();
      charging = pmu.isCharging();
    }

    if (imuReady) imu.getAccelerometer(accelX, accelY, accelZ);

  }

  // Consumes the CST9217's falling-edge notification before its short IRQ pulse is lost.
  void sampleTouch() {
    if (!touchReady || !touchInterruptPending) return;
    touchInterruptPending = false;
    int16_t x = -1;
    int16_t y = -1;
    if (touch.getPoint(&x, &y, 1) > 0) {
      touchX = x;
      touchY = y;
    }
  }

  // Paints a stable diagnostic surface intended for first hardware bring-up.
  void drawStatus() {
    if (!displayReady) return;

    display.fillScreen(RGB565_BLACK);
    display.setCursor(12, 14);
    display.setTextColor(RGB565_CYAN);
    display.setTextSize(2);
    display.println(F("WLEDTubes S3 smoke"));
    display.setTextColor(RGB565_WHITE);
    display.setTextSize(2);
    display.setCursor(12, 62);
    display.print(F("Display  OK   BRI "));
    display.println(displayBrightness);
    display.setCursor(12, 104);
    display.print(F("Touch    "));
    display.print(touchReady ? F("OK") : F("FAIL"));
    display.print(F("   "));
    display.print(touchX);
    display.print(F(","));
    display.println(touchY);
    display.setCursor(12, 146);
    display.print(F("PMU      "));
    display.print(pmuReady ? F("OK") : F("FAIL"));
    display.print(F("   "));
    display.print(batteryMv);
    display.println(F(" mV"));
    display.setCursor(12, 188);
    display.print(F("USB      "));
    display.print(usbPresent ? F("YES") : F("NO"));
    display.print(F("   CHG "));
    display.println(charging ? F("YES") : F("NO"));
    display.setCursor(12, 230);
    display.print(F("IMU      "));
    display.println(imuReady ? F("OK") : F("FAIL"));
    display.setCursor(12, 272);
    display.print(F("ACC X "));
    display.println(accelX, 2);
    display.setCursor(12, 314);
    display.print(F("ACC Y "));
    display.println(accelY, 2);
    display.setCursor(12, 356);
    display.print(F("ACC Z "));
    display.println(accelZ, 2);
    display.setTextSize(1);
    display.setTextColor(RGB565_YELLOW);
    display.setCursor(12, 414);
    display.println(F("TOUCH: COORDINATES ONLY"));
    display.setCursor(12, 438);
    display.println(F("No LED output. No smoke-test radio TX."));
  }

public:
  void setup() override {
    Wire.begin(PERIPHERAL_SDA, PERIPHERAL_SCL);

    displayReady = display.begin();
    if (displayReady) {
      display.setBrightness(displayBrightness);
      display.setTextWrap(false);
    }

    pinMode(TOUCH_RESET, OUTPUT);
    digitalWrite(TOUCH_RESET, LOW);
    delay(10);
    digitalWrite(TOUCH_RESET, HIGH);
    delay(50);
    pinMode(TOUCH_IRQ, INPUT_PULLUP);
    touchReady = touch.begin(Wire, CST92XX_SLAVE_ADDRESS, PERIPHERAL_SDA, PERIPHERAL_SCL);
    if (touchReady) {
      touch.setMaxCoordinates(DISPLAY_WIDTH, DISPLAY_HEIGHT);
      touchInterruptPending = false;
      attachInterrupt(TOUCH_IRQ, handleTouchInterrupt, FALLING);
    }

    pmuReady = pmu.begin(Wire, AXP2101_SLAVE_ADDRESS, PERIPHERAL_SDA, PERIPHERAL_SCL);
    if (pmuReady) {
      pmu.enableBattVoltageMeasure();
      pmu.enableVbusVoltageMeasure();
    }

    imuReady = imu.begin(Wire, QMI8658_L_SLAVE_ADDRESS, PERIPHERAL_SDA, PERIPHERAL_SCL);
    if (imuReady) {
      imu.configAccelerometer(SensorQMI8658::ACC_RANGE_2G, SensorQMI8658::ACC_ODR_31_25Hz);
      imu.enableAccelerometer();
    }

    samplePeripherals();
    drawStatus();
  }

  void loop() override {
    sampleTouch();
    const uint32_t now = millis();
    if (now - lastSample < SAMPLE_INTERVAL_MS) return;
    lastSample = now;
    samplePeripherals();
    drawStatus();
  }

  void addToJsonInfo(JsonObject &root) override {
    JsonObject user = root[F("u")];
    if (user.isNull()) user = root.createNestedObject(F("u"));
    JsonArray smoke = user.createNestedArray(F("S3 peripheral smoke"));
    smoke.add(displayReady ? F("display OK") : F("display FAIL"));
    smoke.add(touchReady ? F("touch OK") : F("touch FAIL"));
    smoke.add(pmuReady ? F("PMU OK") : F("PMU FAIL"));
    smoke.add(imuReady ? F("IMU OK") : F("IMU FAIL"));

    JsonArray battery = user.createNestedArray(F("S3 battery"));
    battery.add(batteryMv);
    battery.add(F(" mV"));
    JsonArray power = user.createNestedArray(F("S3 power"));
    power.add(usbPresent ? F("USB") : F("battery"));
    power.add(charging ? F(", charging") : F(""));
  }
};

static WaveshareS3PeripheralSmoke waveshareS3PeripheralSmoke;
REGISTER_USERMOD(waveshareS3PeripheralSmoke);
#endif
} // namespace

// Kept as a forced-link anchor for the board-specific PlatformIO environment.
extern "C" void waveshareS3PeripheralCompileCanary() {}
// AI: end

#endif
